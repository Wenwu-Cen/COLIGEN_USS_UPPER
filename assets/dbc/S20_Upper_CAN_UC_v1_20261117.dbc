VERSION "S20 UPPER CAN v1 20261117"

NS_ :

BS_:

BU_: S20 UPPER

BO_ 1600 S20_Upper_Fragment_00: 64 S20
 SG_ MagicU : 0|8@1+ (1,0) [0|255] "" UPPER
 SG_ MagicC : 8|8@1+ (1,0) [0|255] "" UPPER
 SG_ ProtocolVersion : 16|8@1+ (1,0) [0|255] "" UPPER
 SG_ FragmentIndex : 24|8@1+ (1,0) [0|255] "" UPPER
 SG_ SequenceLow16 : 32|16@1+ (1,0) [0|65535] "" UPPER
 SG_ PacketLength : 48|16@1+ (1,0) [0|65535] "" UPPER
 SG_ PayloadByte00 : 64|8@1+ (1,0) [0|255] "" UPPER
 SG_ PayloadByte01 : 72|8@1+ (1,0) [0|255] "" UPPER
 SG_ PayloadByte02 : 80|8@1+ (1,0) [0|255] "" UPPER
 SG_ PayloadByte03 : 88|8@1+ (1,0) [0|255] "" UPPER
 SG_ PayloadByte04 : 96|8@1+ (1,0) [0|255] "" UPPER
 SG_ PayloadByte05 : 104|8@1+ (1,0) [0|255] "" UPPER
 SG_ PayloadByte06 : 112|8@1+ (1,0) [0|255] "" UPPER
 SG_ PayloadByte07 : 120|8@1+ (1,0) [0|255] "" UPPER
 SG_ PayloadByte08 : 128|8@1+ (1,0) [0|255] "" UPPER
 SG_ PayloadByte09 : 136|8@1+ (1,0) [0|255] "" UPPER
 SG_ PayloadByte10 : 144|8@1+ (1,0) [0|255] "" UPPER
 SG_ PayloadByte11 : 152|8@1+ (1,0) [0|255] "" UPPER
 SG_ PayloadByte12 : 160|8@1+ (1,0) [0|255] "" UPPER
 SG_ PayloadByte13 : 168|8@1+ (1,0) [0|255] "" UPPER
 SG_ PayloadByte14 : 176|8@1+ (1,0) [0|255] "" UPPER
 SG_ PayloadByte15 : 184|8@1+ (1,0) [0|255] "" UPPER
 SG_ PayloadByte16 : 192|8@1+ (1,0) [0|255] "" UPPER
 SG_ PayloadByte17 : 200|8@1+ (1,0) [0|255] "" UPPER
 SG_ PayloadByte18 : 208|8@1+ (1,0) [0|255] "" UPPER
 SG_ PayloadByte19 : 216|8@1+ (1,0) [0|255] "" UPPER
 SG_ PayloadByte20 : 224|8@1+ (1,0) [0|255] "" UPPER
 SG_ PayloadByte21 : 232|8@1+ (1,0) [0|255] "" UPPER
 SG_ PayloadByte22 : 240|8@1+ (1,0) [0|255] "" UPPER
 SG_ PayloadByte23 : 248|8@1+ (1,0) [0|255] "" UPPER
 SG_ PayloadByte24 : 256|8@1+ (1,0) [0|255] "" UPPER
 SG_ PayloadByte25 : 264|8@1+ (1,0) [0|255] "" UPPER
 SG_ PayloadByte26 : 272|8@1+ (1,0) [0|255] "" UPPER
 SG_ PayloadByte27 : 280|8@1+ (1,0) [0|255] "" UPPER
 SG_ PayloadByte28 : 288|8@1+ (1,0) [0|255] "" UPPER
 SG_ PayloadByte29 : 296|8@1+ (1,0) [0|255] "" UPPER
 SG_ PayloadByte30 : 304|8@1+ (1,0) [0|255] "" UPPER
 SG_ PayloadByte31 : 312|8@1+ (1,0) [0|255] "" UPPER
 SG_ PayloadByte32 : 320|8@1+ (1,0) [0|255] "" UPPER
 SG_ PayloadByte33 : 328|8@1+ (1,0) [0|255] "" UPPER
 SG_ PayloadByte34 : 336|8@1+ (1,0) [0|255] "" UPPER
 SG_ PayloadByte35 : 344|8@1+ (1,0) [0|255] "" UPPER
 SG_ PayloadByte36 : 352|8@1+ (1,0) [0|255] "" UPPER
 SG_ PayloadByte37 : 360|8@1+ (1,0) [0|255] "" UPPER
 SG_ PayloadByte38 : 368|8@1+ (1,0) [0|255] "" UPPER
 SG_ PayloadByte39 : 376|8@1+ (1,0) [0|255] "" UPPER
 SG_ PayloadByte40 : 384|8@1+ (1,0) [0|255] "" UPPER
 SG_ PayloadByte41 : 392|8@1+ (1,0) [0|255] "" UPPER
 SG_ PayloadByte42 : 400|8@1+ (1,0) [0|255] "" UPPER
 SG_ PayloadByte43 : 408|8@1+ (1,0) [0|255] "" UPPER
 SG_ PayloadByte44 : 416|8@1+ (1,0) [0|255] "" UPPER
 SG_ PayloadByte45 : 424|8@1+ (1,0) [0|255] "" UPPER
 SG_ PayloadByte46 : 432|8@1+ (1,0) [0|255] "" UPPER
 SG_ PayloadByte47 : 440|8@1+ (1,0) [0|255] "" UPPER
 SG_ PayloadByte48 : 448|8@1+ (1,0) [0|255] "" UPPER
 SG_ PayloadByte49 : 456|8@1+ (1,0) [0|255] "" UPPER
 SG_ PayloadByte50 : 464|8@1+ (1,0) [0|255] "" UPPER
 SG_ PayloadByte51 : 472|8@1+ (1,0) [0|255] "" UPPER
 SG_ PayloadByte52 : 480|8@1+ (1,0) [0|255] "" UPPER
 SG_ PayloadByte53 : 488|8@1+ (1,0) [0|255] "" UPPER
 SG_ PayloadByte54 : 496|8@1+ (1,0) [0|255] "" UPPER
 SG_ PayloadByte55 : 504|8@1+ (1,0) [0|255] "" UPPER

BO_ 1718 S20_Upper_Fragment_01: 64 S20
 SG_ MagicU : 0|8@1+ (1,0) [0|255] "" UPPER
 SG_ MagicC : 8|8@1+ (1,0) [0|255] "" UPPER
 SG_ ProtocolVersion : 16|8@1+ (1,0) [0|255] "" UPPER
 SG_ FragmentIndex : 24|8@1+ (1,0) [0|255] "" UPPER
 SG_ SequenceLow16 : 32|16@1+ (1,0) [0|65535] "" UPPER
 SG_ PacketLength : 48|16@1+ (1,0) [0|65535] "" UPPER
 SG_ PayloadByte00 : 64|8@1+ (1,0) [0|255] "" UPPER
 SG_ PayloadByte01 : 72|8@1+ (1,0) [0|255] "" UPPER
 SG_ PayloadByte02 : 80|8@1+ (1,0) [0|255] "" UPPER
 SG_ PayloadByte03 : 88|8@1+ (1,0) [0|255] "" UPPER
 SG_ PayloadByte04 : 96|8@1+ (1,0) [0|255] "" UPPER
 SG_ PayloadByte05 : 104|8@1+ (1,0) [0|255] "" UPPER
 SG_ PayloadByte06 : 112|8@1+ (1,0) [0|255] "" UPPER
 SG_ PayloadByte07 : 120|8@1+ (1,0) [0|255] "" UPPER
 SG_ PayloadByte08 : 128|8@1+ (1,0) [0|255] "" UPPER
 SG_ PayloadByte09 : 136|8@1+ (1,0) [0|255] "" UPPER
 SG_ PayloadByte10 : 144|8@1+ (1,0) [0|255] "" UPPER
 SG_ PayloadByte11 : 152|8@1+ (1,0) [0|255] "" UPPER
 SG_ PayloadByte12 : 160|8@1+ (1,0) [0|255] "" UPPER
 SG_ PayloadByte13 : 168|8@1+ (1,0) [0|255] "" UPPER
 SG_ PayloadByte14 : 176|8@1+ (1,0) [0|255] "" UPPER
 SG_ PayloadByte15 : 184|8@1+ (1,0) [0|255] "" UPPER
 SG_ PayloadByte16 : 192|8@1+ (1,0) [0|255] "" UPPER
 SG_ PayloadByte17 : 200|8@1+ (1,0) [0|255] "" UPPER
 SG_ PayloadByte18 : 208|8@1+ (1,0) [0|255] "" UPPER
 SG_ PayloadByte19 : 216|8@1+ (1,0) [0|255] "" UPPER
 SG_ PayloadByte20 : 224|8@1+ (1,0) [0|255] "" UPPER
 SG_ PayloadByte21 : 232|8@1+ (1,0) [0|255] "" UPPER
 SG_ PayloadByte22 : 240|8@1+ (1,0) [0|255] "" UPPER
 SG_ PayloadByte23 : 248|8@1+ (1,0) [0|255] "" UPPER
 SG_ PayloadByte24 : 256|8@1+ (1,0) [0|255] "" UPPER
 SG_ PayloadByte25 : 264|8@1+ (1,0) [0|255] "" UPPER
 SG_ PayloadByte26 : 272|8@1+ (1,0) [0|255] "" UPPER
 SG_ PayloadByte27 : 280|8@1+ (1,0) [0|255] "" UPPER
 SG_ PayloadByte28 : 288|8@1+ (1,0) [0|255] "" UPPER
 SG_ PayloadByte29 : 296|8@1+ (1,0) [0|255] "" UPPER
 SG_ PayloadByte30 : 304|8@1+ (1,0) [0|255] "" UPPER
 SG_ PayloadByte31 : 312|8@1+ (1,0) [0|255] "" UPPER
 SG_ PayloadByte32 : 320|8@1+ (1,0) [0|255] "" UPPER
 SG_ PayloadByte33 : 328|8@1+ (1,0) [0|255] "" UPPER
 SG_ PayloadByte34 : 336|8@1+ (1,0) [0|255] "" UPPER
 SG_ PayloadByte35 : 344|8@1+ (1,0) [0|255] "" UPPER
 SG_ PayloadByte36 : 352|8@1+ (1,0) [0|255] "" UPPER
 SG_ PayloadByte37 : 360|8@1+ (1,0) [0|255] "" UPPER
 SG_ PayloadByte38 : 368|8@1+ (1,0) [0|255] "" UPPER
 SG_ PayloadByte39 : 376|8@1+ (1,0) [0|255] "" UPPER
 SG_ PayloadByte40 : 384|8@1+ (1,0) [0|255] "" UPPER
 SG_ PayloadByte41 : 392|8@1+ (1,0) [0|255] "" UPPER
 SG_ PayloadByte42 : 400|8@1+ (1,0) [0|255] "" UPPER
 SG_ PayloadByte43 : 408|8@1+ (1,0) [0|255] "" UPPER
 SG_ PayloadByte44 : 416|8@1+ (1,0) [0|255] "" UPPER
 SG_ PayloadByte45 : 424|8@1+ (1,0) [0|255] "" UPPER
 SG_ PayloadByte46 : 432|8@1+ (1,0) [0|255] "" UPPER
 SG_ PayloadByte47 : 440|8@1+ (1,0) [0|255] "" UPPER
 SG_ PayloadByte48 : 448|8@1+ (1,0) [0|255] "" UPPER
 SG_ PayloadByte49 : 456|8@1+ (1,0) [0|255] "" UPPER
 SG_ PayloadByte50 : 464|8@1+ (1,0) [0|255] "" UPPER
 SG_ PayloadByte51 : 472|8@1+ (1,0) [0|255] "" UPPER
 SG_ PayloadByte52 : 480|8@1+ (1,0) [0|255] "" UPPER
 SG_ PayloadByte53 : 488|8@1+ (1,0) [0|255] "" UPPER
 SG_ PayloadByte54 : 496|8@1+ (1,0) [0|255] "" UPPER
 SG_ PayloadByte55 : 504|8@1+ (1,0) [0|255] "" UPPER

BO_ 1719 S20_Upper_Fragment_02: 64 S20
 SG_ MagicU : 0|8@1+ (1,0) [0|255] "" UPPER
 SG_ MagicC : 8|8@1+ (1,0) [0|255] "" UPPER
 SG_ ProtocolVersion : 16|8@1+ (1,0) [0|255] "" UPPER
 SG_ FragmentIndex : 24|8@1+ (1,0) [0|255] "" UPPER
 SG_ SequenceLow16 : 32|16@1+ (1,0) [0|65535] "" UPPER
 SG_ PacketLength : 48|16@1+ (1,0) [0|65535] "" UPPER
 SG_ PayloadByte00 : 64|8@1+ (1,0) [0|255] "" UPPER
 SG_ PayloadByte01 : 72|8@1+ (1,0) [0|255] "" UPPER
 SG_ PayloadByte02 : 80|8@1+ (1,0) [0|255] "" UPPER
 SG_ PayloadByte03 : 88|8@1+ (1,0) [0|255] "" UPPER
 SG_ PayloadByte04 : 96|8@1+ (1,0) [0|255] "" UPPER
 SG_ PayloadByte05 : 104|8@1+ (1,0) [0|255] "" UPPER
 SG_ PayloadByte06 : 112|8@1+ (1,0) [0|255] "" UPPER
 SG_ PayloadByte07 : 120|8@1+ (1,0) [0|255] "" UPPER
 SG_ PayloadByte08 : 128|8@1+ (1,0) [0|255] "" UPPER
 SG_ PayloadByte09 : 136|8@1+ (1,0) [0|255] "" UPPER
 SG_ PayloadByte10 : 144|8@1+ (1,0) [0|255] "" UPPER
 SG_ PayloadByte11 : 152|8@1+ (1,0) [0|255] "" UPPER
 SG_ PayloadByte12 : 160|8@1+ (1,0) [0|255] "" UPPER
 SG_ PayloadByte13 : 168|8@1+ (1,0) [0|255] "" UPPER
 SG_ PayloadByte14 : 176|8@1+ (1,0) [0|255] "" UPPER
 SG_ PayloadByte15 : 184|8@1+ (1,0) [0|255] "" UPPER
 SG_ PayloadByte16 : 192|8@1+ (1,0) [0|255] "" UPPER
 SG_ PayloadByte17 : 200|8@1+ (1,0) [0|255] "" UPPER
 SG_ PayloadByte18 : 208|8@1+ (1,0) [0|255] "" UPPER
 SG_ PayloadByte19 : 216|8@1+ (1,0) [0|255] "" UPPER
 SG_ PayloadByte20 : 224|8@1+ (1,0) [0|255] "" UPPER
 SG_ PayloadByte21 : 232|8@1+ (1,0) [0|255] "" UPPER
 SG_ PayloadByte22 : 240|8@1+ (1,0) [0|255] "" UPPER
 SG_ PayloadByte23 : 248|8@1+ (1,0) [0|255] "" UPPER
 SG_ PayloadByte24 : 256|8@1+ (1,0) [0|255] "" UPPER
 SG_ PayloadByte25 : 264|8@1+ (1,0) [0|255] "" UPPER
 SG_ PayloadByte26 : 272|8@1+ (1,0) [0|255] "" UPPER
 SG_ PayloadByte27 : 280|8@1+ (1,0) [0|255] "" UPPER
 SG_ PayloadByte28 : 288|8@1+ (1,0) [0|255] "" UPPER
 SG_ PayloadByte29 : 296|8@1+ (1,0) [0|255] "" UPPER
 SG_ PayloadByte30 : 304|8@1+ (1,0) [0|255] "" UPPER
 SG_ PayloadByte31 : 312|8@1+ (1,0) [0|255] "" UPPER
 SG_ PayloadByte32 : 320|8@1+ (1,0) [0|255] "" UPPER
 SG_ PayloadByte33 : 328|8@1+ (1,0) [0|255] "" UPPER
 SG_ PayloadByte34 : 336|8@1+ (1,0) [0|255] "" UPPER
 SG_ PayloadByte35 : 344|8@1+ (1,0) [0|255] "" UPPER
 SG_ PayloadByte36 : 352|8@1+ (1,0) [0|255] "" UPPER
 SG_ PayloadByte37 : 360|8@1+ (1,0) [0|255] "" UPPER
 SG_ PayloadByte38 : 368|8@1+ (1,0) [0|255] "" UPPER
 SG_ PayloadByte39 : 376|8@1+ (1,0) [0|255] "" UPPER
 SG_ PayloadByte40 : 384|8@1+ (1,0) [0|255] "" UPPER
 SG_ PayloadByte41 : 392|8@1+ (1,0) [0|255] "" UPPER
 SG_ PayloadByte42 : 400|8@1+ (1,0) [0|255] "" UPPER
 SG_ PayloadByte43 : 408|8@1+ (1,0) [0|255] "" UPPER
 SG_ PayloadByte44 : 416|8@1+ (1,0) [0|255] "" UPPER
 SG_ PayloadByte45 : 424|8@1+ (1,0) [0|255] "" UPPER
 SG_ PayloadByte46 : 432|8@1+ (1,0) [0|255] "" UPPER
 SG_ PayloadByte47 : 440|8@1+ (1,0) [0|255] "" UPPER
 SG_ PayloadByte48 : 448|8@1+ (1,0) [0|255] "" UPPER
 SG_ PayloadByte49 : 456|8@1+ (1,0) [0|255] "" UPPER
 SG_ PayloadByte50 : 464|8@1+ (1,0) [0|255] "" UPPER
 SG_ PayloadByte51 : 472|8@1+ (1,0) [0|255] "" UPPER
 SG_ PayloadByte52 : 480|8@1+ (1,0) [0|255] "" UPPER
 SG_ PayloadByte53 : 488|8@1+ (1,0) [0|255] "" UPPER
 SG_ PayloadByte54 : 496|8@1+ (1,0) [0|255] "" UPPER
 SG_ PayloadByte55 : 504|8@1+ (1,0) [0|255] "" UPPER

BO_ 1720 S20_Upper_Fragment_03: 64 S20
 SG_ MagicU : 0|8@1+ (1,0) [0|255] "" UPPER
 SG_ MagicC : 8|8@1+ (1,0) [0|255] "" UPPER
 SG_ ProtocolVersion : 16|8@1+ (1,0) [0|255] "" UPPER
 SG_ FragmentIndex : 24|8@1+ (1,0) [0|255] "" UPPER
 SG_ SequenceLow16 : 32|16@1+ (1,0) [0|65535] "" UPPER
 SG_ PacketLength : 48|16@1+ (1,0) [0|65535] "" UPPER
 SG_ PayloadByte00 : 64|8@1+ (1,0) [0|255] "" UPPER
 SG_ PayloadByte01 : 72|8@1+ (1,0) [0|255] "" UPPER
 SG_ PayloadByte02 : 80|8@1+ (1,0) [0|255] "" UPPER
 SG_ PayloadByte03 : 88|8@1+ (1,0) [0|255] "" UPPER
 SG_ PayloadByte04 : 96|8@1+ (1,0) [0|255] "" UPPER
 SG_ PayloadByte05 : 104|8@1+ (1,0) [0|255] "" UPPER
 SG_ PayloadByte06 : 112|8@1+ (1,0) [0|255] "" UPPER
 SG_ PayloadByte07 : 120|8@1+ (1,0) [0|255] "" UPPER
 SG_ PayloadByte08 : 128|8@1+ (1,0) [0|255] "" UPPER
 SG_ PayloadByte09 : 136|8@1+ (1,0) [0|255] "" UPPER
 SG_ PayloadByte10 : 144|8@1+ (1,0) [0|255] "" UPPER
 SG_ PayloadByte11 : 152|8@1+ (1,0) [0|255] "" UPPER
 SG_ PayloadByte12 : 160|8@1+ (1,0) [0|255] "" UPPER
 SG_ PayloadByte13 : 168|8@1+ (1,0) [0|255] "" UPPER
 SG_ PayloadByte14 : 176|8@1+ (1,0) [0|255] "" UPPER
 SG_ PayloadByte15 : 184|8@1+ (1,0) [0|255] "" UPPER
 SG_ PayloadByte16 : 192|8@1+ (1,0) [0|255] "" UPPER
 SG_ PayloadByte17 : 200|8@1+ (1,0) [0|255] "" UPPER
 SG_ PayloadByte18 : 208|8@1+ (1,0) [0|255] "" UPPER
 SG_ PayloadByte19 : 216|8@1+ (1,0) [0|255] "" UPPER
 SG_ PayloadByte20 : 224|8@1+ (1,0) [0|255] "" UPPER
 SG_ PayloadByte21 : 232|8@1+ (1,0) [0|255] "" UPPER
 SG_ PayloadByte22 : 240|8@1+ (1,0) [0|255] "" UPPER
 SG_ PayloadByte23 : 248|8@1+ (1,0) [0|255] "" UPPER
 SG_ PayloadByte24 : 256|8@1+ (1,0) [0|255] "" UPPER
 SG_ PayloadByte25 : 264|8@1+ (1,0) [0|255] "" UPPER
 SG_ PayloadByte26 : 272|8@1+ (1,0) [0|255] "" UPPER
 SG_ PayloadByte27 : 280|8@1+ (1,0) [0|255] "" UPPER
 SG_ PayloadByte28 : 288|8@1+ (1,0) [0|255] "" UPPER
 SG_ PayloadByte29 : 296|8@1+ (1,0) [0|255] "" UPPER
 SG_ PayloadByte30 : 304|8@1+ (1,0) [0|255] "" UPPER
 SG_ PayloadByte31 : 312|8@1+ (1,0) [0|255] "" UPPER
 SG_ PayloadByte32 : 320|8@1+ (1,0) [0|255] "" UPPER
 SG_ PayloadByte33 : 328|8@1+ (1,0) [0|255] "" UPPER
 SG_ PayloadByte34 : 336|8@1+ (1,0) [0|255] "" UPPER
 SG_ PayloadByte35 : 344|8@1+ (1,0) [0|255] "" UPPER
 SG_ PayloadByte36 : 352|8@1+ (1,0) [0|255] "" UPPER
 SG_ PayloadByte37 : 360|8@1+ (1,0) [0|255] "" UPPER
 SG_ PayloadByte38 : 368|8@1+ (1,0) [0|255] "" UPPER
 SG_ PayloadByte39 : 376|8@1+ (1,0) [0|255] "" UPPER
 SG_ PayloadByte40 : 384|8@1+ (1,0) [0|255] "" UPPER
 SG_ PayloadByte41 : 392|8@1+ (1,0) [0|255] "" UPPER
 SG_ PayloadByte42 : 400|8@1+ (1,0) [0|255] "" UPPER
 SG_ PayloadByte43 : 408|8@1+ (1,0) [0|255] "" UPPER
 SG_ PayloadByte44 : 416|8@1+ (1,0) [0|255] "" UPPER
 SG_ PayloadByte45 : 424|8@1+ (1,0) [0|255] "" UPPER
 SG_ PayloadByte46 : 432|8@1+ (1,0) [0|255] "" UPPER
 SG_ PayloadByte47 : 440|8@1+ (1,0) [0|255] "" UPPER
 SG_ PayloadByte48 : 448|8@1+ (1,0) [0|255] "" UPPER
 SG_ PayloadByte49 : 456|8@1+ (1,0) [0|255] "" UPPER
 SG_ PayloadByte50 : 464|8@1+ (1,0) [0|255] "" UPPER
 SG_ PayloadByte51 : 472|8@1+ (1,0) [0|255] "" UPPER
 SG_ PayloadByte52 : 480|8@1+ (1,0) [0|255] "" UPPER
 SG_ PayloadByte53 : 488|8@1+ (1,0) [0|255] "" UPPER
 SG_ PayloadByte54 : 496|8@1+ (1,0) [0|255] "" UPPER
 SG_ PayloadByte55 : 504|8@1+ (1,0) [0|255] "" UPPER

BO_ 1721 S20_Upper_Fragment_04: 64 S20
 SG_ MagicU : 0|8@1+ (1,0) [0|255] "" UPPER
 SG_ MagicC : 8|8@1+ (1,0) [0|255] "" UPPER
 SG_ ProtocolVersion : 16|8@1+ (1,0) [0|255] "" UPPER
 SG_ FragmentIndex : 24|8@1+ (1,0) [0|255] "" UPPER
 SG_ SequenceLow16 : 32|16@1+ (1,0) [0|65535] "" UPPER
 SG_ PacketLength : 48|16@1+ (1,0) [0|65535] "" UPPER
 SG_ PayloadByte00 : 64|8@1+ (1,0) [0|255] "" UPPER
 SG_ PayloadByte01 : 72|8@1+ (1,0) [0|255] "" UPPER
 SG_ PayloadByte02 : 80|8@1+ (1,0) [0|255] "" UPPER
 SG_ PayloadByte03 : 88|8@1+ (1,0) [0|255] "" UPPER
 SG_ PayloadByte04 : 96|8@1+ (1,0) [0|255] "" UPPER
 SG_ PayloadByte05 : 104|8@1+ (1,0) [0|255] "" UPPER
 SG_ PayloadByte06 : 112|8@1+ (1,0) [0|255] "" UPPER
 SG_ PayloadByte07 : 120|8@1+ (1,0) [0|255] "" UPPER
 SG_ PayloadByte08 : 128|8@1+ (1,0) [0|255] "" UPPER
 SG_ PayloadByte09 : 136|8@1+ (1,0) [0|255] "" UPPER
 SG_ PayloadByte10 : 144|8@1+ (1,0) [0|255] "" UPPER
 SG_ PayloadByte11 : 152|8@1+ (1,0) [0|255] "" UPPER
 SG_ PayloadByte12 : 160|8@1+ (1,0) [0|255] "" UPPER
 SG_ PayloadByte13 : 168|8@1+ (1,0) [0|255] "" UPPER
 SG_ PayloadByte14 : 176|8@1+ (1,0) [0|255] "" UPPER
 SG_ PayloadByte15 : 184|8@1+ (1,0) [0|255] "" UPPER
 SG_ PayloadByte16 : 192|8@1+ (1,0) [0|255] "" UPPER
 SG_ PayloadByte17 : 200|8@1+ (1,0) [0|255] "" UPPER
 SG_ PayloadByte18 : 208|8@1+ (1,0) [0|255] "" UPPER
 SG_ PayloadByte19 : 216|8@1+ (1,0) [0|255] "" UPPER
 SG_ PayloadByte20 : 224|8@1+ (1,0) [0|255] "" UPPER
 SG_ PayloadByte21 : 232|8@1+ (1,0) [0|255] "" UPPER
 SG_ PayloadByte22 : 240|8@1+ (1,0) [0|255] "" UPPER
 SG_ PayloadByte23 : 248|8@1+ (1,0) [0|255] "" UPPER
 SG_ PayloadByte24 : 256|8@1+ (1,0) [0|255] "" UPPER
 SG_ PayloadByte25 : 264|8@1+ (1,0) [0|255] "" UPPER
 SG_ PayloadByte26 : 272|8@1+ (1,0) [0|255] "" UPPER
 SG_ PayloadByte27 : 280|8@1+ (1,0) [0|255] "" UPPER
 SG_ PayloadByte28 : 288|8@1+ (1,0) [0|255] "" UPPER
 SG_ PayloadByte29 : 296|8@1+ (1,0) [0|255] "" UPPER
 SG_ PayloadByte30 : 304|8@1+ (1,0) [0|255] "" UPPER
 SG_ PayloadByte31 : 312|8@1+ (1,0) [0|255] "" UPPER
 SG_ PayloadByte32 : 320|8@1+ (1,0) [0|255] "" UPPER
 SG_ PayloadByte33 : 328|8@1+ (1,0) [0|255] "" UPPER
 SG_ PayloadByte34 : 336|8@1+ (1,0) [0|255] "" UPPER
 SG_ PayloadByte35 : 344|8@1+ (1,0) [0|255] "" UPPER
 SG_ PayloadByte36 : 352|8@1+ (1,0) [0|255] "" UPPER
 SG_ PayloadByte37 : 360|8@1+ (1,0) [0|255] "" UPPER
 SG_ PayloadByte38 : 368|8@1+ (1,0) [0|255] "" UPPER
 SG_ PayloadByte39 : 376|8@1+ (1,0) [0|255] "" UPPER
 SG_ PayloadByte40 : 384|8@1+ (1,0) [0|255] "" UPPER
 SG_ PayloadByte41 : 392|8@1+ (1,0) [0|255] "" UPPER
 SG_ PayloadByte42 : 400|8@1+ (1,0) [0|255] "" UPPER
 SG_ PayloadByte43 : 408|8@1+ (1,0) [0|255] "" UPPER
 SG_ PayloadByte44 : 416|8@1+ (1,0) [0|255] "" UPPER
 SG_ PayloadByte45 : 424|8@1+ (1,0) [0|255] "" UPPER
 SG_ PayloadByte46 : 432|8@1+ (1,0) [0|255] "" UPPER
 SG_ PayloadByte47 : 440|8@1+ (1,0) [0|255] "" UPPER
 SG_ PayloadByte48 : 448|8@1+ (1,0) [0|255] "" UPPER
 SG_ PayloadByte49 : 456|8@1+ (1,0) [0|255] "" UPPER
 SG_ PayloadByte50 : 464|8@1+ (1,0) [0|255] "" UPPER
 SG_ PayloadByte51 : 472|8@1+ (1,0) [0|255] "" UPPER
 SG_ PayloadByte52 : 480|8@1+ (1,0) [0|255] "" UPPER
 SG_ PayloadByte53 : 488|8@1+ (1,0) [0|255] "" UPPER
 SG_ PayloadByte54 : 496|8@1+ (1,0) [0|255] "" UPPER
 SG_ PayloadByte55 : 504|8@1+ (1,0) [0|255] "" UPPER

BO_ 1722 S20_Upper_Fragment_05: 64 S20
 SG_ MagicU : 0|8@1+ (1,0) [0|255] "" UPPER
 SG_ MagicC : 8|8@1+ (1,0) [0|255] "" UPPER
 SG_ ProtocolVersion : 16|8@1+ (1,0) [0|255] "" UPPER
 SG_ FragmentIndex : 24|8@1+ (1,0) [0|255] "" UPPER
 SG_ SequenceLow16 : 32|16@1+ (1,0) [0|65535] "" UPPER
 SG_ PacketLength : 48|16@1+ (1,0) [0|65535] "" UPPER
 SG_ PayloadByte00 : 64|8@1+ (1,0) [0|255] "" UPPER
 SG_ PayloadByte01 : 72|8@1+ (1,0) [0|255] "" UPPER
 SG_ PayloadByte02 : 80|8@1+ (1,0) [0|255] "" UPPER
 SG_ PayloadByte03 : 88|8@1+ (1,0) [0|255] "" UPPER
 SG_ PayloadByte04 : 96|8@1+ (1,0) [0|255] "" UPPER
 SG_ PayloadByte05 : 104|8@1+ (1,0) [0|255] "" UPPER
 SG_ PayloadByte06 : 112|8@1+ (1,0) [0|255] "" UPPER
 SG_ PayloadByte07 : 120|8@1+ (1,0) [0|255] "" UPPER
 SG_ PayloadByte08 : 128|8@1+ (1,0) [0|255] "" UPPER
 SG_ PayloadByte09 : 136|8@1+ (1,0) [0|255] "" UPPER
 SG_ PayloadByte10 : 144|8@1+ (1,0) [0|255] "" UPPER
 SG_ PayloadByte11 : 152|8@1+ (1,0) [0|255] "" UPPER
 SG_ PayloadByte12 : 160|8@1+ (1,0) [0|255] "" UPPER
 SG_ PayloadByte13 : 168|8@1+ (1,0) [0|255] "" UPPER
 SG_ PayloadByte14 : 176|8@1+ (1,0) [0|255] "" UPPER
 SG_ PayloadByte15 : 184|8@1+ (1,0) [0|255] "" UPPER
 SG_ PayloadByte16 : 192|8@1+ (1,0) [0|255] "" UPPER
 SG_ PayloadByte17 : 200|8@1+ (1,0) [0|255] "" UPPER
 SG_ PayloadByte18 : 208|8@1+ (1,0) [0|255] "" UPPER
 SG_ PayloadByte19 : 216|8@1+ (1,0) [0|255] "" UPPER
 SG_ PayloadByte20 : 224|8@1+ (1,0) [0|255] "" UPPER
 SG_ PayloadByte21 : 232|8@1+ (1,0) [0|255] "" UPPER
 SG_ PayloadByte22 : 240|8@1+ (1,0) [0|255] "" UPPER
 SG_ PayloadByte23 : 248|8@1+ (1,0) [0|255] "" UPPER
 SG_ PayloadByte24 : 256|8@1+ (1,0) [0|255] "" UPPER
 SG_ PayloadByte25 : 264|8@1+ (1,0) [0|255] "" UPPER
 SG_ PayloadByte26 : 272|8@1+ (1,0) [0|255] "" UPPER
 SG_ PayloadByte27 : 280|8@1+ (1,0) [0|255] "" UPPER
 SG_ PayloadByte28 : 288|8@1+ (1,0) [0|255] "" UPPER
 SG_ PayloadByte29 : 296|8@1+ (1,0) [0|255] "" UPPER
 SG_ PayloadByte30 : 304|8@1+ (1,0) [0|255] "" UPPER
 SG_ PayloadByte31 : 312|8@1+ (1,0) [0|255] "" UPPER
 SG_ PayloadByte32 : 320|8@1+ (1,0) [0|255] "" UPPER
 SG_ PayloadByte33 : 328|8@1+ (1,0) [0|255] "" UPPER
 SG_ PayloadByte34 : 336|8@1+ (1,0) [0|255] "" UPPER
 SG_ PayloadByte35 : 344|8@1+ (1,0) [0|255] "" UPPER
 SG_ PayloadByte36 : 352|8@1+ (1,0) [0|255] "" UPPER
 SG_ PayloadByte37 : 360|8@1+ (1,0) [0|255] "" UPPER
 SG_ PayloadByte38 : 368|8@1+ (1,0) [0|255] "" UPPER
 SG_ PayloadByte39 : 376|8@1+ (1,0) [0|255] "" UPPER
 SG_ PayloadByte40 : 384|8@1+ (1,0) [0|255] "" UPPER
 SG_ PayloadByte41 : 392|8@1+ (1,0) [0|255] "" UPPER
 SG_ PayloadByte42 : 400|8@1+ (1,0) [0|255] "" UPPER
 SG_ PayloadByte43 : 408|8@1+ (1,0) [0|255] "" UPPER
 SG_ PayloadByte44 : 416|8@1+ (1,0) [0|255] "" UPPER
 SG_ PayloadByte45 : 424|8@1+ (1,0) [0|255] "" UPPER
 SG_ PayloadByte46 : 432|8@1+ (1,0) [0|255] "" UPPER
 SG_ PayloadByte47 : 440|8@1+ (1,0) [0|255] "" UPPER
 SG_ PayloadByte48 : 448|8@1+ (1,0) [0|255] "" UPPER
 SG_ PayloadByte49 : 456|8@1+ (1,0) [0|255] "" UPPER
 SG_ PayloadByte50 : 464|8@1+ (1,0) [0|255] "" UPPER
 SG_ PayloadByte51 : 472|8@1+ (1,0) [0|255] "" UPPER
 SG_ PayloadByte52 : 480|8@1+ (1,0) [0|255] "" UPPER
 SG_ PayloadByte53 : 488|8@1+ (1,0) [0|255] "" UPPER
 SG_ PayloadByte54 : 496|8@1+ (1,0) [0|255] "" UPPER
 SG_ PayloadByte55 : 504|8@1+ (1,0) [0|255] "" UPPER

BO_ 1723 S20_Upper_Fragment_06: 64 S20
 SG_ MagicU : 0|8@1+ (1,0) [0|255] "" UPPER
 SG_ MagicC : 8|8@1+ (1,0) [0|255] "" UPPER
 SG_ ProtocolVersion : 16|8@1+ (1,0) [0|255] "" UPPER
 SG_ FragmentIndex : 24|8@1+ (1,0) [0|255] "" UPPER
 SG_ SequenceLow16 : 32|16@1+ (1,0) [0|65535] "" UPPER
 SG_ PacketLength : 48|16@1+ (1,0) [0|65535] "" UPPER
 SG_ PayloadByte00 : 64|8@1+ (1,0) [0|255] "" UPPER
 SG_ PayloadByte01 : 72|8@1+ (1,0) [0|255] "" UPPER
 SG_ PayloadByte02 : 80|8@1+ (1,0) [0|255] "" UPPER
 SG_ PayloadByte03 : 88|8@1+ (1,0) [0|255] "" UPPER
 SG_ PayloadByte04 : 96|8@1+ (1,0) [0|255] "" UPPER
 SG_ PayloadByte05 : 104|8@1+ (1,0) [0|255] "" UPPER
 SG_ PayloadByte06 : 112|8@1+ (1,0) [0|255] "" UPPER
 SG_ PayloadByte07 : 120|8@1+ (1,0) [0|255] "" UPPER
 SG_ PayloadByte08 : 128|8@1+ (1,0) [0|255] "" UPPER
 SG_ PayloadByte09 : 136|8@1+ (1,0) [0|255] "" UPPER
 SG_ PayloadByte10 : 144|8@1+ (1,0) [0|255] "" UPPER
 SG_ PayloadByte11 : 152|8@1+ (1,0) [0|255] "" UPPER
 SG_ PayloadByte12 : 160|8@1+ (1,0) [0|255] "" UPPER
 SG_ PayloadByte13 : 168|8@1+ (1,0) [0|255] "" UPPER
 SG_ PayloadByte14 : 176|8@1+ (1,0) [0|255] "" UPPER
 SG_ PayloadByte15 : 184|8@1+ (1,0) [0|255] "" UPPER
 SG_ PayloadByte16 : 192|8@1+ (1,0) [0|255] "" UPPER
 SG_ PayloadByte17 : 200|8@1+ (1,0) [0|255] "" UPPER
 SG_ PayloadByte18 : 208|8@1+ (1,0) [0|255] "" UPPER
 SG_ PayloadByte19 : 216|8@1+ (1,0) [0|255] "" UPPER
 SG_ PayloadByte20 : 224|8@1+ (1,0) [0|255] "" UPPER
 SG_ PayloadByte21 : 232|8@1+ (1,0) [0|255] "" UPPER
 SG_ PayloadByte22 : 240|8@1+ (1,0) [0|255] "" UPPER
 SG_ PayloadByte23 : 248|8@1+ (1,0) [0|255] "" UPPER
 SG_ PayloadByte24 : 256|8@1+ (1,0) [0|255] "" UPPER
 SG_ PayloadByte25 : 264|8@1+ (1,0) [0|255] "" UPPER
 SG_ PayloadByte26 : 272|8@1+ (1,0) [0|255] "" UPPER
 SG_ PayloadByte27 : 280|8@1+ (1,0) [0|255] "" UPPER
 SG_ PayloadByte28 : 288|8@1+ (1,0) [0|255] "" UPPER
 SG_ PayloadByte29 : 296|8@1+ (1,0) [0|255] "" UPPER
 SG_ PayloadByte30 : 304|8@1+ (1,0) [0|255] "" UPPER
 SG_ PayloadByte31 : 312|8@1+ (1,0) [0|255] "" UPPER
 SG_ PayloadByte32 : 320|8@1+ (1,0) [0|255] "" UPPER
 SG_ PayloadByte33 : 328|8@1+ (1,0) [0|255] "" UPPER
 SG_ PayloadByte34 : 336|8@1+ (1,0) [0|255] "" UPPER
 SG_ PayloadByte35 : 344|8@1+ (1,0) [0|255] "" UPPER
 SG_ PayloadByte36 : 352|8@1+ (1,0) [0|255] "" UPPER
 SG_ PayloadByte37 : 360|8@1+ (1,0) [0|255] "" UPPER
 SG_ PayloadByte38 : 368|8@1+ (1,0) [0|255] "" UPPER
 SG_ PayloadByte39 : 376|8@1+ (1,0) [0|255] "" UPPER
 SG_ PayloadByte40 : 384|8@1+ (1,0) [0|255] "" UPPER
 SG_ PayloadByte41 : 392|8@1+ (1,0) [0|255] "" UPPER
 SG_ PayloadByte42 : 400|8@1+ (1,0) [0|255] "" UPPER
 SG_ PayloadByte43 : 408|8@1+ (1,0) [0|255] "" UPPER
 SG_ PayloadByte44 : 416|8@1+ (1,0) [0|255] "" UPPER
 SG_ PayloadByte45 : 424|8@1+ (1,0) [0|255] "" UPPER
 SG_ PayloadByte46 : 432|8@1+ (1,0) [0|255] "" UPPER
 SG_ PayloadByte47 : 440|8@1+ (1,0) [0|255] "" UPPER
 SG_ PayloadByte48 : 448|8@1+ (1,0) [0|255] "" UPPER
 SG_ PayloadByte49 : 456|8@1+ (1,0) [0|255] "" UPPER
 SG_ PayloadByte50 : 464|8@1+ (1,0) [0|255] "" UPPER
 SG_ PayloadByte51 : 472|8@1+ (1,0) [0|255] "" UPPER
 SG_ PayloadByte52 : 480|8@1+ (1,0) [0|255] "" UPPER
 SG_ PayloadByte53 : 488|8@1+ (1,0) [0|255] "" UPPER
 SG_ PayloadByte54 : 496|8@1+ (1,0) [0|255] "" UPPER
 SG_ PayloadByte55 : 504|8@1+ (1,0) [0|255] "" UPPER

BO_ 1724 S20_Upper_Fragment_07: 64 S20
 SG_ MagicU : 0|8@1+ (1,0) [0|255] "" UPPER
 SG_ MagicC : 8|8@1+ (1,0) [0|255] "" UPPER
 SG_ ProtocolVersion : 16|8@1+ (1,0) [0|255] "" UPPER
 SG_ FragmentIndex : 24|8@1+ (1,0) [0|255] "" UPPER
 SG_ SequenceLow16 : 32|16@1+ (1,0) [0|65535] "" UPPER
 SG_ PacketLength : 48|16@1+ (1,0) [0|65535] "" UPPER
 SG_ PayloadByte00 : 64|8@1+ (1,0) [0|255] "" UPPER
 SG_ PayloadByte01 : 72|8@1+ (1,0) [0|255] "" UPPER
 SG_ PayloadByte02 : 80|8@1+ (1,0) [0|255] "" UPPER
 SG_ PayloadByte03 : 88|8@1+ (1,0) [0|255] "" UPPER
 SG_ PayloadByte04 : 96|8@1+ (1,0) [0|255] "" UPPER
 SG_ PayloadByte05 : 104|8@1+ (1,0) [0|255] "" UPPER
 SG_ PayloadByte06 : 112|8@1+ (1,0) [0|255] "" UPPER
 SG_ PayloadByte07 : 120|8@1+ (1,0) [0|255] "" UPPER
 SG_ PayloadByte08 : 128|8@1+ (1,0) [0|255] "" UPPER
 SG_ PayloadByte09 : 136|8@1+ (1,0) [0|255] "" UPPER
 SG_ PayloadByte10 : 144|8@1+ (1,0) [0|255] "" UPPER
 SG_ PayloadByte11 : 152|8@1+ (1,0) [0|255] "" UPPER
 SG_ PayloadByte12 : 160|8@1+ (1,0) [0|255] "" UPPER
 SG_ PayloadByte13 : 168|8@1+ (1,0) [0|255] "" UPPER
 SG_ PayloadByte14 : 176|8@1+ (1,0) [0|255] "" UPPER
 SG_ PayloadByte15 : 184|8@1+ (1,0) [0|255] "" UPPER
 SG_ PayloadByte16 : 192|8@1+ (1,0) [0|255] "" UPPER
 SG_ PayloadByte17 : 200|8@1+ (1,0) [0|255] "" UPPER
 SG_ PayloadByte18 : 208|8@1+ (1,0) [0|255] "" UPPER
 SG_ PayloadByte19 : 216|8@1+ (1,0) [0|255] "" UPPER
 SG_ PayloadByte20 : 224|8@1+ (1,0) [0|255] "" UPPER
 SG_ PayloadByte21 : 232|8@1+ (1,0) [0|255] "" UPPER
 SG_ PayloadByte22 : 240|8@1+ (1,0) [0|255] "" UPPER
 SG_ PayloadByte23 : 248|8@1+ (1,0) [0|255] "" UPPER
 SG_ PayloadByte24 : 256|8@1+ (1,0) [0|255] "" UPPER
 SG_ PayloadByte25 : 264|8@1+ (1,0) [0|255] "" UPPER
 SG_ PayloadByte26 : 272|8@1+ (1,0) [0|255] "" UPPER
 SG_ PayloadByte27 : 280|8@1+ (1,0) [0|255] "" UPPER
 SG_ PayloadByte28 : 288|8@1+ (1,0) [0|255] "" UPPER
 SG_ PayloadByte29 : 296|8@1+ (1,0) [0|255] "" UPPER
 SG_ PayloadByte30 : 304|8@1+ (1,0) [0|255] "" UPPER
 SG_ PayloadByte31 : 312|8@1+ (1,0) [0|255] "" UPPER
 SG_ PayloadByte32 : 320|8@1+ (1,0) [0|255] "" UPPER
 SG_ PayloadByte33 : 328|8@1+ (1,0) [0|255] "" UPPER
 SG_ PayloadByte34 : 336|8@1+ (1,0) [0|255] "" UPPER
 SG_ PayloadByte35 : 344|8@1+ (1,0) [0|255] "" UPPER
 SG_ PayloadByte36 : 352|8@1+ (1,0) [0|255] "" UPPER
 SG_ PayloadByte37 : 360|8@1+ (1,0) [0|255] "" UPPER
 SG_ PayloadByte38 : 368|8@1+ (1,0) [0|255] "" UPPER
 SG_ PayloadByte39 : 376|8@1+ (1,0) [0|255] "" UPPER
 SG_ PayloadByte40 : 384|8@1+ (1,0) [0|255] "" UPPER
 SG_ PayloadByte41 : 392|8@1+ (1,0) [0|255] "" UPPER
 SG_ PayloadByte42 : 400|8@1+ (1,0) [0|255] "" UPPER
 SG_ PayloadByte43 : 408|8@1+ (1,0) [0|255] "" UPPER
 SG_ PayloadByte44 : 416|8@1+ (1,0) [0|255] "" UPPER
 SG_ PayloadByte45 : 424|8@1+ (1,0) [0|255] "" UPPER
 SG_ PayloadByte46 : 432|8@1+ (1,0) [0|255] "" UPPER
 SG_ PayloadByte47 : 440|8@1+ (1,0) [0|255] "" UPPER
 SG_ PayloadByte48 : 448|8@1+ (1,0) [0|255] "" UPPER
 SG_ PayloadByte49 : 456|8@1+ (1,0) [0|255] "" UPPER
 SG_ PayloadByte50 : 464|8@1+ (1,0) [0|255] "" UPPER
 SG_ PayloadByte51 : 472|8@1+ (1,0) [0|255] "" UPPER
 SG_ PayloadByte52 : 480|8@1+ (1,0) [0|255] "" UPPER
 SG_ PayloadByte53 : 488|8@1+ (1,0) [0|255] "" UPPER
 SG_ PayloadByte54 : 496|8@1+ (1,0) [0|255] "" UPPER
 SG_ PayloadByte55 : 504|8@1+ (1,0) [0|255] "" UPPER

BO_ 1725 S20_Upper_Fragment_08: 64 S20
 SG_ MagicU : 0|8@1+ (1,0) [0|255] "" UPPER
 SG_ MagicC : 8|8@1+ (1,0) [0|255] "" UPPER
 SG_ ProtocolVersion : 16|8@1+ (1,0) [0|255] "" UPPER
 SG_ FragmentIndex : 24|8@1+ (1,0) [0|255] "" UPPER
 SG_ SequenceLow16 : 32|16@1+ (1,0) [0|65535] "" UPPER
 SG_ PacketLength : 48|16@1+ (1,0) [0|65535] "" UPPER
 SG_ PayloadByte00 : 64|8@1+ (1,0) [0|255] "" UPPER
 SG_ PayloadByte01 : 72|8@1+ (1,0) [0|255] "" UPPER
 SG_ PayloadByte02 : 80|8@1+ (1,0) [0|255] "" UPPER
 SG_ PayloadByte03 : 88|8@1+ (1,0) [0|255] "" UPPER
 SG_ PayloadByte04 : 96|8@1+ (1,0) [0|255] "" UPPER
 SG_ PayloadByte05 : 104|8@1+ (1,0) [0|255] "" UPPER
 SG_ PayloadByte06 : 112|8@1+ (1,0) [0|255] "" UPPER
 SG_ PayloadByte07 : 120|8@1+ (1,0) [0|255] "" UPPER
 SG_ PayloadByte08 : 128|8@1+ (1,0) [0|255] "" UPPER
 SG_ PayloadByte09 : 136|8@1+ (1,0) [0|255] "" UPPER
 SG_ PayloadByte10 : 144|8@1+ (1,0) [0|255] "" UPPER
 SG_ PayloadByte11 : 152|8@1+ (1,0) [0|255] "" UPPER
 SG_ PayloadByte12 : 160|8@1+ (1,0) [0|255] "" UPPER
 SG_ PayloadByte13 : 168|8@1+ (1,0) [0|255] "" UPPER
 SG_ PayloadByte14 : 176|8@1+ (1,0) [0|255] "" UPPER
 SG_ PayloadByte15 : 184|8@1+ (1,0) [0|255] "" UPPER
 SG_ PayloadByte16 : 192|8@1+ (1,0) [0|255] "" UPPER
 SG_ PayloadByte17 : 200|8@1+ (1,0) [0|255] "" UPPER
 SG_ PayloadByte18 : 208|8@1+ (1,0) [0|255] "" UPPER
 SG_ PayloadByte19 : 216|8@1+ (1,0) [0|255] "" UPPER
 SG_ PayloadByte20 : 224|8@1+ (1,0) [0|255] "" UPPER
 SG_ PayloadByte21 : 232|8@1+ (1,0) [0|255] "" UPPER
 SG_ PayloadByte22 : 240|8@1+ (1,0) [0|255] "" UPPER
 SG_ PayloadByte23 : 248|8@1+ (1,0) [0|255] "" UPPER
 SG_ PayloadByte24 : 256|8@1+ (1,0) [0|255] "" UPPER
 SG_ PayloadByte25 : 264|8@1+ (1,0) [0|255] "" UPPER
 SG_ PayloadByte26 : 272|8@1+ (1,0) [0|255] "" UPPER
 SG_ PayloadByte27 : 280|8@1+ (1,0) [0|255] "" UPPER
 SG_ PayloadByte28 : 288|8@1+ (1,0) [0|255] "" UPPER
 SG_ PayloadByte29 : 296|8@1+ (1,0) [0|255] "" UPPER
 SG_ PayloadByte30 : 304|8@1+ (1,0) [0|255] "" UPPER
 SG_ PayloadByte31 : 312|8@1+ (1,0) [0|255] "" UPPER
 SG_ PayloadByte32 : 320|8@1+ (1,0) [0|255] "" UPPER
 SG_ PayloadByte33 : 328|8@1+ (1,0) [0|255] "" UPPER
 SG_ PayloadByte34 : 336|8@1+ (1,0) [0|255] "" UPPER
 SG_ PayloadByte35 : 344|8@1+ (1,0) [0|255] "" UPPER
 SG_ PayloadByte36 : 352|8@1+ (1,0) [0|255] "" UPPER
 SG_ PayloadByte37 : 360|8@1+ (1,0) [0|255] "" UPPER
 SG_ PayloadByte38 : 368|8@1+ (1,0) [0|255] "" UPPER
 SG_ PayloadByte39 : 376|8@1+ (1,0) [0|255] "" UPPER
 SG_ PayloadByte40 : 384|8@1+ (1,0) [0|255] "" UPPER
 SG_ PayloadByte41 : 392|8@1+ (1,0) [0|255] "" UPPER
 SG_ PayloadByte42 : 400|8@1+ (1,0) [0|255] "" UPPER
 SG_ PayloadByte43 : 408|8@1+ (1,0) [0|255] "" UPPER
 SG_ PayloadByte44 : 416|8@1+ (1,0) [0|255] "" UPPER
 SG_ PayloadByte45 : 424|8@1+ (1,0) [0|255] "" UPPER
 SG_ PayloadByte46 : 432|8@1+ (1,0) [0|255] "" UPPER
 SG_ PayloadByte47 : 440|8@1+ (1,0) [0|255] "" UPPER
 SG_ PayloadByte48 : 448|8@1+ (1,0) [0|255] "" UPPER
 SG_ PayloadByte49 : 456|8@1+ (1,0) [0|255] "" UPPER
 SG_ PayloadByte50 : 464|8@1+ (1,0) [0|255] "" UPPER
 SG_ PayloadByte51 : 472|8@1+ (1,0) [0|255] "" UPPER
 SG_ PayloadByte52 : 480|8@1+ (1,0) [0|255] "" UPPER
 SG_ PayloadByte53 : 488|8@1+ (1,0) [0|255] "" UPPER
 SG_ PayloadByte54 : 496|8@1+ (1,0) [0|255] "" UPPER
 SG_ PayloadByte55 : 504|8@1+ (1,0) [0|255] "" UPPER

BO_ 1726 S20_Upper_Fragment_09: 64 S20
 SG_ MagicU : 0|8@1+ (1,0) [0|255] "" UPPER
 SG_ MagicC : 8|8@1+ (1,0) [0|255] "" UPPER
 SG_ ProtocolVersion : 16|8@1+ (1,0) [0|255] "" UPPER
 SG_ FragmentIndex : 24|8@1+ (1,0) [0|255] "" UPPER
 SG_ SequenceLow16 : 32|16@1+ (1,0) [0|65535] "" UPPER
 SG_ PacketLength : 48|16@1+ (1,0) [0|65535] "" UPPER
 SG_ PayloadByte00 : 64|8@1+ (1,0) [0|255] "" UPPER
 SG_ PayloadByte01 : 72|8@1+ (1,0) [0|255] "" UPPER
 SG_ PayloadByte02 : 80|8@1+ (1,0) [0|255] "" UPPER
 SG_ PayloadByte03 : 88|8@1+ (1,0) [0|255] "" UPPER
 SG_ PayloadByte04 : 96|8@1+ (1,0) [0|255] "" UPPER
 SG_ PayloadByte05 : 104|8@1+ (1,0) [0|255] "" UPPER
 SG_ PayloadByte06 : 112|8@1+ (1,0) [0|255] "" UPPER
 SG_ PayloadByte07 : 120|8@1+ (1,0) [0|255] "" UPPER
 SG_ PayloadByte08 : 128|8@1+ (1,0) [0|255] "" UPPER
 SG_ PayloadByte09 : 136|8@1+ (1,0) [0|255] "" UPPER
 SG_ PayloadByte10 : 144|8@1+ (1,0) [0|255] "" UPPER
 SG_ PayloadByte11 : 152|8@1+ (1,0) [0|255] "" UPPER
 SG_ PayloadByte12 : 160|8@1+ (1,0) [0|255] "" UPPER
 SG_ PayloadByte13 : 168|8@1+ (1,0) [0|255] "" UPPER
 SG_ PayloadByte14 : 176|8@1+ (1,0) [0|255] "" UPPER
 SG_ PayloadByte15 : 184|8@1+ (1,0) [0|255] "" UPPER
 SG_ PayloadByte16 : 192|8@1+ (1,0) [0|255] "" UPPER
 SG_ PayloadByte17 : 200|8@1+ (1,0) [0|255] "" UPPER
 SG_ PayloadByte18 : 208|8@1+ (1,0) [0|255] "" UPPER
 SG_ PayloadByte19 : 216|8@1+ (1,0) [0|255] "" UPPER
 SG_ PayloadByte20 : 224|8@1+ (1,0) [0|255] "" UPPER
 SG_ PayloadByte21 : 232|8@1+ (1,0) [0|255] "" UPPER
 SG_ PayloadByte22 : 240|8@1+ (1,0) [0|255] "" UPPER
 SG_ PayloadByte23 : 248|8@1+ (1,0) [0|255] "" UPPER
 SG_ PayloadByte24 : 256|8@1+ (1,0) [0|255] "" UPPER
 SG_ PayloadByte25 : 264|8@1+ (1,0) [0|255] "" UPPER
 SG_ PayloadByte26 : 272|8@1+ (1,0) [0|255] "" UPPER
 SG_ PayloadByte27 : 280|8@1+ (1,0) [0|255] "" UPPER
 SG_ PayloadByte28 : 288|8@1+ (1,0) [0|255] "" UPPER
 SG_ PayloadByte29 : 296|8@1+ (1,0) [0|255] "" UPPER
 SG_ PayloadByte30 : 304|8@1+ (1,0) [0|255] "" UPPER
 SG_ PayloadByte31 : 312|8@1+ (1,0) [0|255] "" UPPER
 SG_ PayloadByte32 : 320|8@1+ (1,0) [0|255] "" UPPER
 SG_ PayloadByte33 : 328|8@1+ (1,0) [0|255] "" UPPER
 SG_ PayloadByte34 : 336|8@1+ (1,0) [0|255] "" UPPER
 SG_ PayloadByte35 : 344|8@1+ (1,0) [0|255] "" UPPER
 SG_ PayloadByte36 : 352|8@1+ (1,0) [0|255] "" UPPER
 SG_ PayloadByte37 : 360|8@1+ (1,0) [0|255] "" UPPER
 SG_ PayloadByte38 : 368|8@1+ (1,0) [0|255] "" UPPER
 SG_ PayloadByte39 : 376|8@1+ (1,0) [0|255] "" UPPER
 SG_ PayloadByte40 : 384|8@1+ (1,0) [0|255] "" UPPER
 SG_ PayloadByte41 : 392|8@1+ (1,0) [0|255] "" UPPER
 SG_ PayloadByte42 : 400|8@1+ (1,0) [0|255] "" UPPER
 SG_ PayloadByte43 : 408|8@1+ (1,0) [0|255] "" UPPER
 SG_ PayloadByte44 : 416|8@1+ (1,0) [0|255] "" UPPER
 SG_ PayloadByte45 : 424|8@1+ (1,0) [0|255] "" UPPER
 SG_ PayloadByte46 : 432|8@1+ (1,0) [0|255] "" UPPER
 SG_ PayloadByte47 : 440|8@1+ (1,0) [0|255] "" UPPER
 SG_ PayloadByte48 : 448|8@1+ (1,0) [0|255] "" UPPER
 SG_ PayloadByte49 : 456|8@1+ (1,0) [0|255] "" UPPER
 SG_ PayloadByte50 : 464|8@1+ (1,0) [0|255] "" UPPER
 SG_ PayloadByte51 : 472|8@1+ (1,0) [0|255] "" UPPER
 SG_ PayloadByte52 : 480|8@1+ (1,0) [0|255] "" UPPER
 SG_ PayloadByte53 : 488|8@1+ (1,0) [0|255] "" UPPER
 SG_ PayloadByte54 : 496|8@1+ (1,0) [0|255] "" UPPER
 SG_ PayloadByte55 : 504|8@1+ (1,0) [0|255] "" UPPER

BO_ 1727 S20_Upper_Fragment_10: 64 S20
 SG_ MagicU : 0|8@1+ (1,0) [0|255] "" UPPER
 SG_ MagicC : 8|8@1+ (1,0) [0|255] "" UPPER
 SG_ ProtocolVersion : 16|8@1+ (1,0) [0|255] "" UPPER
 SG_ FragmentIndex : 24|8@1+ (1,0) [0|255] "" UPPER
 SG_ SequenceLow16 : 32|16@1+ (1,0) [0|65535] "" UPPER
 SG_ PacketLength : 48|16@1+ (1,0) [0|65535] "" UPPER
 SG_ PayloadByte00 : 64|8@1+ (1,0) [0|255] "" UPPER
 SG_ PayloadByte01 : 72|8@1+ (1,0) [0|255] "" UPPER
 SG_ PayloadByte02 : 80|8@1+ (1,0) [0|255] "" UPPER
 SG_ PayloadByte03 : 88|8@1+ (1,0) [0|255] "" UPPER
 SG_ PayloadByte04 : 96|8@1+ (1,0) [0|255] "" UPPER
 SG_ PayloadByte05 : 104|8@1+ (1,0) [0|255] "" UPPER
 SG_ PayloadByte06 : 112|8@1+ (1,0) [0|255] "" UPPER
 SG_ PayloadByte07 : 120|8@1+ (1,0) [0|255] "" UPPER
 SG_ PayloadByte08 : 128|8@1+ (1,0) [0|255] "" UPPER
 SG_ PayloadByte09 : 136|8@1+ (1,0) [0|255] "" UPPER
 SG_ PayloadByte10 : 144|8@1+ (1,0) [0|255] "" UPPER
 SG_ PayloadByte11 : 152|8@1+ (1,0) [0|255] "" UPPER
 SG_ PayloadByte12 : 160|8@1+ (1,0) [0|255] "" UPPER
 SG_ PayloadByte13 : 168|8@1+ (1,0) [0|255] "" UPPER
 SG_ PayloadByte14 : 176|8@1+ (1,0) [0|255] "" UPPER
 SG_ PayloadByte15 : 184|8@1+ (1,0) [0|255] "" UPPER
 SG_ PayloadByte16 : 192|8@1+ (1,0) [0|255] "" UPPER
 SG_ PayloadByte17 : 200|8@1+ (1,0) [0|255] "" UPPER
 SG_ PayloadByte18 : 208|8@1+ (1,0) [0|255] "" UPPER
 SG_ PayloadByte19 : 216|8@1+ (1,0) [0|255] "" UPPER
 SG_ PayloadByte20 : 224|8@1+ (1,0) [0|255] "" UPPER
 SG_ PayloadByte21 : 232|8@1+ (1,0) [0|255] "" UPPER
 SG_ PayloadByte22 : 240|8@1+ (1,0) [0|255] "" UPPER
 SG_ PayloadByte23 : 248|8@1+ (1,0) [0|255] "" UPPER
 SG_ PayloadByte24 : 256|8@1+ (1,0) [0|255] "" UPPER
 SG_ PayloadByte25 : 264|8@1+ (1,0) [0|255] "" UPPER
 SG_ PayloadByte26 : 272|8@1+ (1,0) [0|255] "" UPPER
 SG_ PayloadByte27 : 280|8@1+ (1,0) [0|255] "" UPPER
 SG_ PayloadByte28 : 288|8@1+ (1,0) [0|255] "" UPPER
 SG_ PayloadByte29 : 296|8@1+ (1,0) [0|255] "" UPPER
 SG_ PayloadByte30 : 304|8@1+ (1,0) [0|255] "" UPPER
 SG_ PayloadByte31 : 312|8@1+ (1,0) [0|255] "" UPPER
 SG_ PayloadByte32 : 320|8@1+ (1,0) [0|255] "" UPPER
 SG_ PayloadByte33 : 328|8@1+ (1,0) [0|255] "" UPPER
 SG_ PayloadByte34 : 336|8@1+ (1,0) [0|255] "" UPPER
 SG_ PayloadByte35 : 344|8@1+ (1,0) [0|255] "" UPPER
 SG_ PayloadByte36 : 352|8@1+ (1,0) [0|255] "" UPPER
 SG_ PayloadByte37 : 360|8@1+ (1,0) [0|255] "" UPPER
 SG_ PayloadByte38 : 368|8@1+ (1,0) [0|255] "" UPPER
 SG_ PayloadByte39 : 376|8@1+ (1,0) [0|255] "" UPPER
 SG_ PayloadByte40 : 384|8@1+ (1,0) [0|255] "" UPPER
 SG_ PayloadByte41 : 392|8@1+ (1,0) [0|255] "" UPPER
 SG_ PayloadByte42 : 400|8@1+ (1,0) [0|255] "" UPPER
 SG_ PayloadByte43 : 408|8@1+ (1,0) [0|255] "" UPPER
 SG_ PayloadByte44 : 416|8@1+ (1,0) [0|255] "" UPPER
 SG_ PayloadByte45 : 424|8@1+ (1,0) [0|255] "" UPPER
 SG_ PayloadByte46 : 432|8@1+ (1,0) [0|255] "" UPPER
 SG_ PayloadByte47 : 440|8@1+ (1,0) [0|255] "" UPPER
 SG_ PayloadByte48 : 448|8@1+ (1,0) [0|255] "" UPPER
 SG_ PayloadByte49 : 456|8@1+ (1,0) [0|255] "" UPPER
 SG_ PayloadByte50 : 464|8@1+ (1,0) [0|255] "" UPPER
 SG_ PayloadByte51 : 472|8@1+ (1,0) [0|255] "" UPPER
 SG_ PayloadByte52 : 480|8@1+ (1,0) [0|255] "" UPPER
 SG_ PayloadByte53 : 488|8@1+ (1,0) [0|255] "" UPPER
 SG_ PayloadByte54 : 496|8@1+ (1,0) [0|255] "" UPPER
 SG_ PayloadByte55 : 504|8@1+ (1,0) [0|255] "" UPPER

BO_ 1728 S20_Upper_Fragment_11: 64 S20
 SG_ MagicU : 0|8@1+ (1,0) [0|255] "" UPPER
 SG_ MagicC : 8|8@1+ (1,0) [0|255] "" UPPER
 SG_ ProtocolVersion : 16|8@1+ (1,0) [0|255] "" UPPER
 SG_ FragmentIndex : 24|8@1+ (1,0) [0|255] "" UPPER
 SG_ SequenceLow16 : 32|16@1+ (1,0) [0|65535] "" UPPER
 SG_ PacketLength : 48|16@1+ (1,0) [0|65535] "" UPPER
 SG_ PayloadByte00 : 64|8@1+ (1,0) [0|255] "" UPPER
 SG_ PayloadByte01 : 72|8@1+ (1,0) [0|255] "" UPPER
 SG_ PayloadByte02 : 80|8@1+ (1,0) [0|255] "" UPPER
 SG_ PayloadByte03 : 88|8@1+ (1,0) [0|255] "" UPPER
 SG_ PayloadByte04 : 96|8@1+ (1,0) [0|255] "" UPPER
 SG_ PayloadByte05 : 104|8@1+ (1,0) [0|255] "" UPPER
 SG_ PayloadByte06 : 112|8@1+ (1,0) [0|255] "" UPPER
 SG_ PayloadByte07 : 120|8@1+ (1,0) [0|255] "" UPPER
 SG_ PayloadByte08 : 128|8@1+ (1,0) [0|255] "" UPPER
 SG_ PayloadByte09 : 136|8@1+ (1,0) [0|255] "" UPPER
 SG_ PayloadByte10 : 144|8@1+ (1,0) [0|255] "" UPPER
 SG_ PayloadByte11 : 152|8@1+ (1,0) [0|255] "" UPPER
 SG_ PayloadByte12 : 160|8@1+ (1,0) [0|255] "" UPPER
 SG_ PayloadByte13 : 168|8@1+ (1,0) [0|255] "" UPPER
 SG_ PayloadByte14 : 176|8@1+ (1,0) [0|255] "" UPPER
 SG_ PayloadByte15 : 184|8@1+ (1,0) [0|255] "" UPPER
 SG_ PayloadByte16 : 192|8@1+ (1,0) [0|255] "" UPPER
 SG_ PayloadByte17 : 200|8@1+ (1,0) [0|255] "" UPPER
 SG_ PayloadByte18 : 208|8@1+ (1,0) [0|255] "" UPPER
 SG_ PayloadByte19 : 216|8@1+ (1,0) [0|255] "" UPPER
 SG_ PayloadByte20 : 224|8@1+ (1,0) [0|255] "" UPPER
 SG_ PayloadByte21 : 232|8@1+ (1,0) [0|255] "" UPPER
 SG_ PayloadByte22 : 240|8@1+ (1,0) [0|255] "" UPPER
 SG_ PayloadByte23 : 248|8@1+ (1,0) [0|255] "" UPPER
 SG_ PayloadByte24 : 256|8@1+ (1,0) [0|255] "" UPPER
 SG_ PayloadByte25 : 264|8@1+ (1,0) [0|255] "" UPPER
 SG_ PayloadByte26 : 272|8@1+ (1,0) [0|255] "" UPPER
 SG_ PayloadByte27 : 280|8@1+ (1,0) [0|255] "" UPPER
 SG_ PayloadByte28 : 288|8@1+ (1,0) [0|255] "" UPPER
 SG_ PayloadByte29 : 296|8@1+ (1,0) [0|255] "" UPPER
 SG_ PayloadByte30 : 304|8@1+ (1,0) [0|255] "" UPPER
 SG_ PayloadByte31 : 312|8@1+ (1,0) [0|255] "" UPPER
 SG_ PayloadByte32 : 320|8@1+ (1,0) [0|255] "" UPPER
 SG_ PayloadByte33 : 328|8@1+ (1,0) [0|255] "" UPPER
 SG_ PayloadByte34 : 336|8@1+ (1,0) [0|255] "" UPPER
 SG_ PayloadByte35 : 344|8@1+ (1,0) [0|255] "" UPPER
 SG_ PayloadByte36 : 352|8@1+ (1,0) [0|255] "" UPPER
 SG_ PayloadByte37 : 360|8@1+ (1,0) [0|255] "" UPPER
 SG_ PayloadByte38 : 368|8@1+ (1,0) [0|255] "" UPPER
 SG_ PayloadByte39 : 376|8@1+ (1,0) [0|255] "" UPPER
 SG_ PayloadByte40 : 384|8@1+ (1,0) [0|255] "" UPPER
 SG_ PayloadByte41 : 392|8@1+ (1,0) [0|255] "" UPPER
 SG_ PayloadByte42 : 400|8@1+ (1,0) [0|255] "" UPPER
 SG_ PayloadByte43 : 408|8@1+ (1,0) [0|255] "" UPPER
 SG_ PayloadByte44 : 416|8@1+ (1,0) [0|255] "" UPPER
 SG_ PayloadByte45 : 424|8@1+ (1,0) [0|255] "" UPPER
 SG_ PayloadByte46 : 432|8@1+ (1,0) [0|255] "" UPPER
 SG_ PayloadByte47 : 440|8@1+ (1,0) [0|255] "" UPPER
 SG_ PayloadByte48 : 448|8@1+ (1,0) [0|255] "" UPPER
 SG_ PayloadByte49 : 456|8@1+ (1,0) [0|255] "" UPPER
 SG_ PayloadByte50 : 464|8@1+ (1,0) [0|255] "" UPPER
 SG_ PayloadByte51 : 472|8@1+ (1,0) [0|255] "" UPPER
 SG_ PayloadByte52 : 480|8@1+ (1,0) [0|255] "" UPPER
 SG_ PayloadByte53 : 488|8@1+ (1,0) [0|255] "" UPPER
 SG_ PayloadByte54 : 496|8@1+ (1,0) [0|255] "" UPPER
 SG_ PayloadByte55 : 504|8@1+ (1,0) [0|255] "" UPPER

BO_ 1729 S20_Upper_Fragment_12: 64 S20
 SG_ MagicU : 0|8@1+ (1,0) [0|255] "" UPPER
 SG_ MagicC : 8|8@1+ (1,0) [0|255] "" UPPER
 SG_ ProtocolVersion : 16|8@1+ (1,0) [0|255] "" UPPER
 SG_ FragmentIndex : 24|8@1+ (1,0) [0|255] "" UPPER
 SG_ SequenceLow16 : 32|16@1+ (1,0) [0|65535] "" UPPER
 SG_ PacketLength : 48|16@1+ (1,0) [0|65535] "" UPPER
 SG_ PayloadByte00 : 64|8@1+ (1,0) [0|255] "" UPPER
 SG_ PayloadByte01 : 72|8@1+ (1,0) [0|255] "" UPPER
 SG_ PayloadByte02 : 80|8@1+ (1,0) [0|255] "" UPPER
 SG_ PayloadByte03 : 88|8@1+ (1,0) [0|255] "" UPPER
 SG_ PayloadByte04 : 96|8@1+ (1,0) [0|255] "" UPPER
 SG_ PayloadByte05 : 104|8@1+ (1,0) [0|255] "" UPPER
 SG_ PayloadByte06 : 112|8@1+ (1,0) [0|255] "" UPPER
 SG_ PayloadByte07 : 120|8@1+ (1,0) [0|255] "" UPPER
 SG_ PayloadByte08 : 128|8@1+ (1,0) [0|255] "" UPPER
 SG_ PayloadByte09 : 136|8@1+ (1,0) [0|255] "" UPPER
 SG_ PayloadByte10 : 144|8@1+ (1,0) [0|255] "" UPPER
 SG_ PayloadByte11 : 152|8@1+ (1,0) [0|255] "" UPPER
 SG_ PayloadByte12 : 160|8@1+ (1,0) [0|255] "" UPPER
 SG_ PayloadByte13 : 168|8@1+ (1,0) [0|255] "" UPPER
 SG_ PayloadByte14 : 176|8@1+ (1,0) [0|255] "" UPPER
 SG_ PayloadByte15 : 184|8@1+ (1,0) [0|255] "" UPPER
 SG_ PayloadByte16 : 192|8@1+ (1,0) [0|255] "" UPPER
 SG_ PayloadByte17 : 200|8@1+ (1,0) [0|255] "" UPPER
 SG_ PayloadByte18 : 208|8@1+ (1,0) [0|255] "" UPPER
 SG_ PayloadByte19 : 216|8@1+ (1,0) [0|255] "" UPPER
 SG_ PayloadByte20 : 224|8@1+ (1,0) [0|255] "" UPPER
 SG_ PayloadByte21 : 232|8@1+ (1,0) [0|255] "" UPPER
 SG_ PayloadByte22 : 240|8@1+ (1,0) [0|255] "" UPPER
 SG_ PayloadByte23 : 248|8@1+ (1,0) [0|255] "" UPPER
 SG_ PayloadByte24 : 256|8@1+ (1,0) [0|255] "" UPPER
 SG_ PayloadByte25 : 264|8@1+ (1,0) [0|255] "" UPPER
 SG_ PayloadByte26 : 272|8@1+ (1,0) [0|255] "" UPPER
 SG_ PayloadByte27 : 280|8@1+ (1,0) [0|255] "" UPPER
 SG_ PayloadByte28 : 288|8@1+ (1,0) [0|255] "" UPPER
 SG_ PayloadByte29 : 296|8@1+ (1,0) [0|255] "" UPPER
 SG_ PayloadByte30 : 304|8@1+ (1,0) [0|255] "" UPPER
 SG_ PayloadByte31 : 312|8@1+ (1,0) [0|255] "" UPPER
 SG_ PayloadByte32 : 320|8@1+ (1,0) [0|255] "" UPPER
 SG_ PayloadByte33 : 328|8@1+ (1,0) [0|255] "" UPPER
 SG_ PayloadByte34 : 336|8@1+ (1,0) [0|255] "" UPPER
 SG_ PayloadByte35 : 344|8@1+ (1,0) [0|255] "" UPPER
 SG_ PayloadByte36 : 352|8@1+ (1,0) [0|255] "" UPPER
 SG_ PayloadByte37 : 360|8@1+ (1,0) [0|255] "" UPPER
 SG_ PayloadByte38 : 368|8@1+ (1,0) [0|255] "" UPPER
 SG_ PayloadByte39 : 376|8@1+ (1,0) [0|255] "" UPPER
 SG_ PayloadByte40 : 384|8@1+ (1,0) [0|255] "" UPPER
 SG_ PayloadByte41 : 392|8@1+ (1,0) [0|255] "" UPPER
 SG_ PayloadByte42 : 400|8@1+ (1,0) [0|255] "" UPPER
 SG_ PayloadByte43 : 408|8@1+ (1,0) [0|255] "" UPPER
 SG_ PayloadByte44 : 416|8@1+ (1,0) [0|255] "" UPPER
 SG_ PayloadByte45 : 424|8@1+ (1,0) [0|255] "" UPPER
 SG_ PayloadByte46 : 432|8@1+ (1,0) [0|255] "" UPPER
 SG_ PayloadByte47 : 440|8@1+ (1,0) [0|255] "" UPPER
 SG_ PayloadByte48 : 448|8@1+ (1,0) [0|255] "" UPPER
 SG_ PayloadByte49 : 456|8@1+ (1,0) [0|255] "" UPPER
 SG_ PayloadByte50 : 464|8@1+ (1,0) [0|255] "" UPPER
 SG_ PayloadByte51 : 472|8@1+ (1,0) [0|255] "" UPPER
 SG_ PayloadByte52 : 480|8@1+ (1,0) [0|255] "" UPPER
 SG_ PayloadByte53 : 488|8@1+ (1,0) [0|255] "" UPPER
 SG_ PayloadByte54 : 496|8@1+ (1,0) [0|255] "" UPPER
 SG_ PayloadByte55 : 504|8@1+ (1,0) [0|255] "" UPPER

BO_ 1730 S20_Upper_Fragment_13: 64 S20
 SG_ MagicU : 0|8@1+ (1,0) [0|255] "" UPPER
 SG_ MagicC : 8|8@1+ (1,0) [0|255] "" UPPER
 SG_ ProtocolVersion : 16|8@1+ (1,0) [0|255] "" UPPER
 SG_ FragmentIndex : 24|8@1+ (1,0) [0|255] "" UPPER
 SG_ SequenceLow16 : 32|16@1+ (1,0) [0|65535] "" UPPER
 SG_ PacketLength : 48|16@1+ (1,0) [0|65535] "" UPPER
 SG_ PayloadByte00 : 64|8@1+ (1,0) [0|255] "" UPPER
 SG_ PayloadByte01 : 72|8@1+ (1,0) [0|255] "" UPPER
 SG_ PayloadByte02 : 80|8@1+ (1,0) [0|255] "" UPPER
 SG_ PayloadByte03 : 88|8@1+ (1,0) [0|255] "" UPPER
 SG_ PayloadByte04 : 96|8@1+ (1,0) [0|255] "" UPPER
 SG_ PayloadByte05 : 104|8@1+ (1,0) [0|255] "" UPPER
 SG_ PayloadByte06 : 112|8@1+ (1,0) [0|255] "" UPPER
 SG_ PayloadByte07 : 120|8@1+ (1,0) [0|255] "" UPPER
 SG_ PayloadByte08 : 128|8@1+ (1,0) [0|255] "" UPPER
 SG_ PayloadByte09 : 136|8@1+ (1,0) [0|255] "" UPPER
 SG_ PayloadByte10 : 144|8@1+ (1,0) [0|255] "" UPPER
 SG_ PayloadByte11 : 152|8@1+ (1,0) [0|255] "" UPPER
 SG_ PayloadByte12 : 160|8@1+ (1,0) [0|255] "" UPPER
 SG_ PayloadByte13 : 168|8@1+ (1,0) [0|255] "" UPPER
 SG_ PayloadByte14 : 176|8@1+ (1,0) [0|255] "" UPPER
 SG_ PayloadByte15 : 184|8@1+ (1,0) [0|255] "" UPPER
 SG_ PayloadByte16 : 192|8@1+ (1,0) [0|255] "" UPPER
 SG_ PayloadByte17 : 200|8@1+ (1,0) [0|255] "" UPPER
 SG_ PayloadByte18 : 208|8@1+ (1,0) [0|255] "" UPPER
 SG_ PayloadByte19 : 216|8@1+ (1,0) [0|255] "" UPPER
 SG_ PayloadByte20 : 224|8@1+ (1,0) [0|255] "" UPPER
 SG_ PayloadByte21 : 232|8@1+ (1,0) [0|255] "" UPPER
 SG_ PayloadByte22 : 240|8@1+ (1,0) [0|255] "" UPPER
 SG_ PayloadByte23 : 248|8@1+ (1,0) [0|255] "" UPPER
 SG_ PayloadByte24 : 256|8@1+ (1,0) [0|255] "" UPPER
 SG_ PayloadByte25 : 264|8@1+ (1,0) [0|255] "" UPPER
 SG_ PayloadByte26 : 272|8@1+ (1,0) [0|255] "" UPPER
 SG_ PayloadByte27 : 280|8@1+ (1,0) [0|255] "" UPPER
 SG_ PayloadByte28 : 288|8@1+ (1,0) [0|255] "" UPPER
 SG_ PayloadByte29 : 296|8@1+ (1,0) [0|255] "" UPPER
 SG_ PayloadByte30 : 304|8@1+ (1,0) [0|255] "" UPPER
 SG_ PayloadByte31 : 312|8@1+ (1,0) [0|255] "" UPPER
 SG_ PayloadByte32 : 320|8@1+ (1,0) [0|255] "" UPPER
 SG_ PayloadByte33 : 328|8@1+ (1,0) [0|255] "" UPPER
 SG_ PayloadByte34 : 336|8@1+ (1,0) [0|255] "" UPPER
 SG_ PayloadByte35 : 344|8@1+ (1,0) [0|255] "" UPPER
 SG_ PayloadByte36 : 352|8@1+ (1,0) [0|255] "" UPPER
 SG_ PayloadByte37 : 360|8@1+ (1,0) [0|255] "" UPPER
 SG_ PayloadByte38 : 368|8@1+ (1,0) [0|255] "" UPPER
 SG_ PayloadByte39 : 376|8@1+ (1,0) [0|255] "" UPPER
 SG_ PayloadByte40 : 384|8@1+ (1,0) [0|255] "" UPPER
 SG_ PayloadByte41 : 392|8@1+ (1,0) [0|255] "" UPPER
 SG_ PayloadByte42 : 400|8@1+ (1,0) [0|255] "" UPPER
 SG_ PayloadByte43 : 408|8@1+ (1,0) [0|255] "" UPPER
 SG_ PayloadByte44 : 416|8@1+ (1,0) [0|255] "" UPPER
 SG_ PayloadByte45 : 424|8@1+ (1,0) [0|255] "" UPPER
 SG_ PayloadByte46 : 432|8@1+ (1,0) [0|255] "" UPPER
 SG_ PayloadByte47 : 440|8@1+ (1,0) [0|255] "" UPPER
 SG_ PayloadByte48 : 448|8@1+ (1,0) [0|255] "" UPPER
 SG_ PayloadByte49 : 456|8@1+ (1,0) [0|255] "" UPPER
 SG_ PayloadByte50 : 464|8@1+ (1,0) [0|255] "" UPPER
 SG_ PayloadByte51 : 472|8@1+ (1,0) [0|255] "" UPPER
 SG_ PayloadByte52 : 480|8@1+ (1,0) [0|255] "" UPPER
 SG_ PayloadByte53 : 488|8@1+ (1,0) [0|255] "" UPPER
 SG_ PayloadByte54 : 496|8@1+ (1,0) [0|255] "" UPPER
 SG_ PayloadByte55 : 504|8@1+ (1,0) [0|255] "" UPPER

BO_ 1731 S20_Upper_Fragment_14: 64 S20
 SG_ MagicU : 0|8@1+ (1,0) [0|255] "" UPPER
 SG_ MagicC : 8|8@1+ (1,0) [0|255] "" UPPER
 SG_ ProtocolVersion : 16|8@1+ (1,0) [0|255] "" UPPER
 SG_ FragmentIndex : 24|8@1+ (1,0) [0|255] "" UPPER
 SG_ SequenceLow16 : 32|16@1+ (1,0) [0|65535] "" UPPER
 SG_ PacketLength : 48|16@1+ (1,0) [0|65535] "" UPPER
 SG_ PayloadByte00 : 64|8@1+ (1,0) [0|255] "" UPPER
 SG_ PayloadByte01 : 72|8@1+ (1,0) [0|255] "" UPPER
 SG_ PayloadByte02 : 80|8@1+ (1,0) [0|255] "" UPPER
 SG_ PayloadByte03 : 88|8@1+ (1,0) [0|255] "" UPPER
 SG_ PayloadByte04 : 96|8@1+ (1,0) [0|255] "" UPPER
 SG_ PayloadByte05 : 104|8@1+ (1,0) [0|255] "" UPPER
 SG_ PayloadByte06 : 112|8@1+ (1,0) [0|255] "" UPPER
 SG_ PayloadByte07 : 120|8@1+ (1,0) [0|255] "" UPPER
 SG_ PayloadByte08 : 128|8@1+ (1,0) [0|255] "" UPPER
 SG_ PayloadByte09 : 136|8@1+ (1,0) [0|255] "" UPPER
 SG_ PayloadByte10 : 144|8@1+ (1,0) [0|255] "" UPPER
 SG_ PayloadByte11 : 152|8@1+ (1,0) [0|255] "" UPPER
 SG_ PayloadByte12 : 160|8@1+ (1,0) [0|255] "" UPPER
 SG_ PayloadByte13 : 168|8@1+ (1,0) [0|255] "" UPPER
 SG_ PayloadByte14 : 176|8@1+ (1,0) [0|255] "" UPPER
 SG_ PayloadByte15 : 184|8@1+ (1,0) [0|255] "" UPPER
 SG_ PayloadByte16 : 192|8@1+ (1,0) [0|255] "" UPPER
 SG_ PayloadByte17 : 200|8@1+ (1,0) [0|255] "" UPPER
 SG_ PayloadByte18 : 208|8@1+ (1,0) [0|255] "" UPPER
 SG_ PayloadByte19 : 216|8@1+ (1,0) [0|255] "" UPPER
 SG_ PayloadByte20 : 224|8@1+ (1,0) [0|255] "" UPPER
 SG_ PayloadByte21 : 232|8@1+ (1,0) [0|255] "" UPPER
 SG_ PayloadByte22 : 240|8@1+ (1,0) [0|255] "" UPPER
 SG_ PayloadByte23 : 248|8@1+ (1,0) [0|255] "" UPPER
 SG_ PayloadByte24 : 256|8@1+ (1,0) [0|255] "" UPPER
 SG_ PayloadByte25 : 264|8@1+ (1,0) [0|255] "" UPPER
 SG_ PayloadByte26 : 272|8@1+ (1,0) [0|255] "" UPPER
 SG_ PayloadByte27 : 280|8@1+ (1,0) [0|255] "" UPPER
 SG_ PayloadByte28 : 288|8@1+ (1,0) [0|255] "" UPPER
 SG_ PayloadByte29 : 296|8@1+ (1,0) [0|255] "" UPPER
 SG_ PayloadByte30 : 304|8@1+ (1,0) [0|255] "" UPPER
 SG_ PayloadByte31 : 312|8@1+ (1,0) [0|255] "" UPPER
 SG_ PayloadByte32 : 320|8@1+ (1,0) [0|255] "" UPPER
 SG_ PayloadByte33 : 328|8@1+ (1,0) [0|255] "" UPPER
 SG_ PayloadByte34 : 336|8@1+ (1,0) [0|255] "" UPPER
 SG_ PayloadByte35 : 344|8@1+ (1,0) [0|255] "" UPPER
 SG_ PayloadByte36 : 352|8@1+ (1,0) [0|255] "" UPPER
 SG_ PayloadByte37 : 360|8@1+ (1,0) [0|255] "" UPPER
 SG_ PayloadByte38 : 368|8@1+ (1,0) [0|255] "" UPPER
 SG_ PayloadByte39 : 376|8@1+ (1,0) [0|255] "" UPPER
 SG_ PayloadByte40 : 384|8@1+ (1,0) [0|255] "" UPPER
 SG_ PayloadByte41 : 392|8@1+ (1,0) [0|255] "" UPPER
 SG_ PayloadByte42 : 400|8@1+ (1,0) [0|255] "" UPPER
 SG_ PayloadByte43 : 408|8@1+ (1,0) [0|255] "" UPPER
 SG_ PayloadByte44 : 416|8@1+ (1,0) [0|255] "" UPPER
 SG_ PayloadByte45 : 424|8@1+ (1,0) [0|255] "" UPPER
 SG_ PayloadByte46 : 432|8@1+ (1,0) [0|255] "" UPPER
 SG_ PayloadByte47 : 440|8@1+ (1,0) [0|255] "" UPPER
 SG_ PayloadByte48 : 448|8@1+ (1,0) [0|255] "" UPPER
 SG_ PayloadByte49 : 456|8@1+ (1,0) [0|255] "" UPPER
 SG_ PayloadByte50 : 464|8@1+ (1,0) [0|255] "" UPPER
 SG_ PayloadByte51 : 472|8@1+ (1,0) [0|255] "" UPPER
 SG_ PayloadByte52 : 480|8@1+ (1,0) [0|255] "" UPPER
 SG_ PayloadByte53 : 488|8@1+ (1,0) [0|255] "" UPPER
 SG_ PayloadByte54 : 496|8@1+ (1,0) [0|255] "" UPPER
 SG_ PayloadByte55 : 504|8@1+ (1,0) [0|255] "" UPPER

BO_ 1732 S20_Upper_Fragment_15: 64 S20
 SG_ MagicU : 0|8@1+ (1,0) [0|255] "" UPPER
 SG_ MagicC : 8|8@1+ (1,0) [0|255] "" UPPER
 SG_ ProtocolVersion : 16|8@1+ (1,0) [0|255] "" UPPER
 SG_ FragmentIndex : 24|8@1+ (1,0) [0|255] "" UPPER
 SG_ SequenceLow16 : 32|16@1+ (1,0) [0|65535] "" UPPER
 SG_ PacketLength : 48|16@1+ (1,0) [0|65535] "" UPPER
 SG_ PayloadByte00 : 64|8@1+ (1,0) [0|255] "" UPPER
 SG_ PayloadByte01 : 72|8@1+ (1,0) [0|255] "" UPPER
 SG_ PayloadByte02 : 80|8@1+ (1,0) [0|255] "" UPPER
 SG_ PayloadByte03 : 88|8@1+ (1,0) [0|255] "" UPPER
 SG_ PayloadByte04 : 96|8@1+ (1,0) [0|255] "" UPPER
 SG_ PayloadByte05 : 104|8@1+ (1,0) [0|255] "" UPPER
 SG_ PayloadByte06 : 112|8@1+ (1,0) [0|255] "" UPPER
 SG_ PayloadByte07 : 120|8@1+ (1,0) [0|255] "" UPPER
 SG_ PayloadByte08 : 128|8@1+ (1,0) [0|255] "" UPPER
 SG_ PayloadByte09 : 136|8@1+ (1,0) [0|255] "" UPPER
 SG_ PayloadByte10 : 144|8@1+ (1,0) [0|255] "" UPPER
 SG_ PayloadByte11 : 152|8@1+ (1,0) [0|255] "" UPPER
 SG_ PayloadByte12 : 160|8@1+ (1,0) [0|255] "" UPPER
 SG_ PayloadByte13 : 168|8@1+ (1,0) [0|255] "" UPPER
 SG_ PayloadByte14 : 176|8@1+ (1,0) [0|255] "" UPPER
 SG_ PayloadByte15 : 184|8@1+ (1,0) [0|255] "" UPPER
 SG_ PayloadByte16 : 192|8@1+ (1,0) [0|255] "" UPPER
 SG_ PayloadByte17 : 200|8@1+ (1,0) [0|255] "" UPPER
 SG_ PayloadByte18 : 208|8@1+ (1,0) [0|255] "" UPPER
 SG_ PayloadByte19 : 216|8@1+ (1,0) [0|255] "" UPPER
 SG_ PayloadByte20 : 224|8@1+ (1,0) [0|255] "" UPPER
 SG_ PayloadByte21 : 232|8@1+ (1,0) [0|255] "" UPPER
 SG_ PayloadByte22 : 240|8@1+ (1,0) [0|255] "" UPPER
 SG_ PayloadByte23 : 248|8@1+ (1,0) [0|255] "" UPPER
 SG_ PayloadByte24 : 256|8@1+ (1,0) [0|255] "" UPPER
 SG_ PayloadByte25 : 264|8@1+ (1,0) [0|255] "" UPPER
 SG_ PayloadByte26 : 272|8@1+ (1,0) [0|255] "" UPPER
 SG_ PayloadByte27 : 280|8@1+ (1,0) [0|255] "" UPPER
 SG_ PayloadByte28 : 288|8@1+ (1,0) [0|255] "" UPPER
 SG_ PayloadByte29 : 296|8@1+ (1,0) [0|255] "" UPPER
 SG_ PayloadByte30 : 304|8@1+ (1,0) [0|255] "" UPPER
 SG_ PayloadByte31 : 312|8@1+ (1,0) [0|255] "" UPPER
 SG_ PayloadByte32 : 320|8@1+ (1,0) [0|255] "" UPPER
 SG_ PayloadByte33 : 328|8@1+ (1,0) [0|255] "" UPPER
 SG_ PayloadByte34 : 336|8@1+ (1,0) [0|255] "" UPPER
 SG_ PayloadByte35 : 344|8@1+ (1,0) [0|255] "" UPPER
 SG_ PayloadByte36 : 352|8@1+ (1,0) [0|255] "" UPPER
 SG_ PayloadByte37 : 360|8@1+ (1,0) [0|255] "" UPPER
 SG_ PayloadByte38 : 368|8@1+ (1,0) [0|255] "" UPPER
 SG_ PayloadByte39 : 376|8@1+ (1,0) [0|255] "" UPPER
 SG_ PayloadByte40 : 384|8@1+ (1,0) [0|255] "" UPPER
 SG_ PayloadByte41 : 392|8@1+ (1,0) [0|255] "" UPPER
 SG_ PayloadByte42 : 400|8@1+ (1,0) [0|255] "" UPPER
 SG_ PayloadByte43 : 408|8@1+ (1,0) [0|255] "" UPPER
 SG_ PayloadByte44 : 416|8@1+ (1,0) [0|255] "" UPPER
 SG_ PayloadByte45 : 424|8@1+ (1,0) [0|255] "" UPPER
 SG_ PayloadByte46 : 432|8@1+ (1,0) [0|255] "" UPPER
 SG_ PayloadByte47 : 440|8@1+ (1,0) [0|255] "" UPPER
 SG_ PayloadByte48 : 448|8@1+ (1,0) [0|255] "" UPPER
 SG_ PayloadByte49 : 456|8@1+ (1,0) [0|255] "" UPPER
 SG_ PayloadByte50 : 464|8@1+ (1,0) [0|255] "" UPPER
 SG_ PayloadByte51 : 472|8@1+ (1,0) [0|255] "" UPPER
 SG_ PayloadByte52 : 480|8@1+ (1,0) [0|255] "" UPPER
 SG_ PayloadByte53 : 488|8@1+ (1,0) [0|255] "" UPPER
 SG_ PayloadByte54 : 496|8@1+ (1,0) [0|255] "" UPPER
 SG_ PayloadByte55 : 504|8@1+ (1,0) [0|255] "" UPPER

BO_ 1733 S20_Upper_Fragment_16: 64 S20
 SG_ MagicU : 0|8@1+ (1,0) [0|255] "" UPPER
 SG_ MagicC : 8|8@1+ (1,0) [0|255] "" UPPER
 SG_ ProtocolVersion : 16|8@1+ (1,0) [0|255] "" UPPER
 SG_ FragmentIndex : 24|8@1+ (1,0) [0|255] "" UPPER
 SG_ SequenceLow16 : 32|16@1+ (1,0) [0|65535] "" UPPER
 SG_ PacketLength : 48|16@1+ (1,0) [0|65535] "" UPPER
 SG_ PayloadByte00 : 64|8@1+ (1,0) [0|255] "" UPPER
 SG_ PayloadByte01 : 72|8@1+ (1,0) [0|255] "" UPPER
 SG_ PayloadByte02 : 80|8@1+ (1,0) [0|255] "" UPPER
 SG_ PayloadByte03 : 88|8@1+ (1,0) [0|255] "" UPPER
 SG_ PayloadByte04 : 96|8@1+ (1,0) [0|255] "" UPPER
 SG_ PayloadByte05 : 104|8@1+ (1,0) [0|255] "" UPPER
 SG_ PayloadByte06 : 112|8@1+ (1,0) [0|255] "" UPPER
 SG_ PayloadByte07 : 120|8@1+ (1,0) [0|255] "" UPPER
 SG_ PayloadByte08 : 128|8@1+ (1,0) [0|255] "" UPPER
 SG_ PayloadByte09 : 136|8@1+ (1,0) [0|255] "" UPPER
 SG_ PayloadByte10 : 144|8@1+ (1,0) [0|255] "" UPPER
 SG_ PayloadByte11 : 152|8@1+ (1,0) [0|255] "" UPPER
 SG_ PayloadByte12 : 160|8@1+ (1,0) [0|255] "" UPPER
 SG_ PayloadByte13 : 168|8@1+ (1,0) [0|255] "" UPPER
 SG_ PayloadByte14 : 176|8@1+ (1,0) [0|255] "" UPPER
 SG_ PayloadByte15 : 184|8@1+ (1,0) [0|255] "" UPPER
 SG_ PayloadByte16 : 192|8@1+ (1,0) [0|255] "" UPPER
 SG_ PayloadByte17 : 200|8@1+ (1,0) [0|255] "" UPPER
 SG_ PayloadByte18 : 208|8@1+ (1,0) [0|255] "" UPPER
 SG_ PayloadByte19 : 216|8@1+ (1,0) [0|255] "" UPPER
 SG_ PayloadByte20 : 224|8@1+ (1,0) [0|255] "" UPPER
 SG_ PayloadByte21 : 232|8@1+ (1,0) [0|255] "" UPPER
 SG_ PayloadByte22 : 240|8@1+ (1,0) [0|255] "" UPPER
 SG_ PayloadByte23 : 248|8@1+ (1,0) [0|255] "" UPPER
 SG_ PayloadByte24 : 256|8@1+ (1,0) [0|255] "" UPPER
 SG_ PayloadByte25 : 264|8@1+ (1,0) [0|255] "" UPPER
 SG_ PayloadByte26 : 272|8@1+ (1,0) [0|255] "" UPPER
 SG_ PayloadByte27 : 280|8@1+ (1,0) [0|255] "" UPPER
 SG_ PayloadByte28 : 288|8@1+ (1,0) [0|255] "" UPPER
 SG_ PayloadByte29 : 296|8@1+ (1,0) [0|255] "" UPPER
 SG_ PayloadByte30 : 304|8@1+ (1,0) [0|255] "" UPPER
 SG_ PayloadByte31 : 312|8@1+ (1,0) [0|255] "" UPPER
 SG_ PayloadByte32 : 320|8@1+ (1,0) [0|255] "" UPPER
 SG_ PayloadByte33 : 328|8@1+ (1,0) [0|255] "" UPPER
 SG_ PayloadByte34 : 336|8@1+ (1,0) [0|255] "" UPPER
 SG_ PayloadByte35 : 344|8@1+ (1,0) [0|255] "" UPPER
 SG_ PayloadByte36 : 352|8@1+ (1,0) [0|255] "" UPPER
 SG_ PayloadByte37 : 360|8@1+ (1,0) [0|255] "" UPPER
 SG_ PayloadByte38 : 368|8@1+ (1,0) [0|255] "" UPPER
 SG_ PayloadByte39 : 376|8@1+ (1,0) [0|255] "" UPPER
 SG_ PayloadByte40 : 384|8@1+ (1,0) [0|255] "" UPPER
 SG_ PayloadByte41 : 392|8@1+ (1,0) [0|255] "" UPPER
 SG_ PayloadByte42 : 400|8@1+ (1,0) [0|255] "" UPPER
 SG_ PayloadByte43 : 408|8@1+ (1,0) [0|255] "" UPPER
 SG_ PayloadByte44 : 416|8@1+ (1,0) [0|255] "" UPPER
 SG_ PayloadByte45 : 424|8@1+ (1,0) [0|255] "" UPPER
 SG_ PayloadByte46 : 432|8@1+ (1,0) [0|255] "" UPPER
 SG_ PayloadByte47 : 440|8@1+ (1,0) [0|255] "" UPPER
 SG_ PayloadByte48 : 448|8@1+ (1,0) [0|255] "" UPPER
 SG_ PayloadByte49 : 456|8@1+ (1,0) [0|255] "" UPPER
 SG_ PayloadByte50 : 464|8@1+ (1,0) [0|255] "" UPPER
 SG_ PayloadByte51 : 472|8@1+ (1,0) [0|255] "" UPPER
 SG_ PayloadByte52 : 480|8@1+ (1,0) [0|255] "" UPPER
 SG_ PayloadByte53 : 488|8@1+ (1,0) [0|255] "" UPPER
 SG_ PayloadByte54 : 496|8@1+ (1,0) [0|255] "" UPPER
 SG_ PayloadByte55 : 504|8@1+ (1,0) [0|255] "" UPPER

BO_ 1734 S20_Upper_Fragment_17: 64 S20
 SG_ MagicU : 0|8@1+ (1,0) [0|255] "" UPPER
 SG_ MagicC : 8|8@1+ (1,0) [0|255] "" UPPER
 SG_ ProtocolVersion : 16|8@1+ (1,0) [0|255] "" UPPER
 SG_ FragmentIndex : 24|8@1+ (1,0) [0|255] "" UPPER
 SG_ SequenceLow16 : 32|16@1+ (1,0) [0|65535] "" UPPER
 SG_ PacketLength : 48|16@1+ (1,0) [0|65535] "" UPPER
 SG_ PayloadByte00 : 64|8@1+ (1,0) [0|255] "" UPPER
 SG_ PayloadByte01 : 72|8@1+ (1,0) [0|255] "" UPPER
 SG_ PayloadByte02 : 80|8@1+ (1,0) [0|255] "" UPPER
 SG_ PayloadByte03 : 88|8@1+ (1,0) [0|255] "" UPPER
 SG_ PayloadByte04 : 96|8@1+ (1,0) [0|255] "" UPPER
 SG_ PayloadByte05 : 104|8@1+ (1,0) [0|255] "" UPPER
 SG_ PayloadByte06 : 112|8@1+ (1,0) [0|255] "" UPPER
 SG_ PayloadByte07 : 120|8@1+ (1,0) [0|255] "" UPPER
 SG_ PayloadByte08 : 128|8@1+ (1,0) [0|255] "" UPPER
 SG_ PayloadByte09 : 136|8@1+ (1,0) [0|255] "" UPPER
 SG_ PayloadByte10 : 144|8@1+ (1,0) [0|255] "" UPPER
 SG_ PayloadByte11 : 152|8@1+ (1,0) [0|255] "" UPPER
 SG_ PayloadByte12 : 160|8@1+ (1,0) [0|255] "" UPPER
 SG_ PayloadByte13 : 168|8@1+ (1,0) [0|255] "" UPPER
 SG_ PayloadByte14 : 176|8@1+ (1,0) [0|255] "" UPPER
 SG_ PayloadByte15 : 184|8@1+ (1,0) [0|255] "" UPPER
 SG_ PayloadByte16 : 192|8@1+ (1,0) [0|255] "" UPPER
 SG_ PayloadByte17 : 200|8@1+ (1,0) [0|255] "" UPPER
 SG_ PayloadByte18 : 208|8@1+ (1,0) [0|255] "" UPPER
 SG_ PayloadByte19 : 216|8@1+ (1,0) [0|255] "" UPPER
 SG_ PayloadByte20 : 224|8@1+ (1,0) [0|255] "" UPPER
 SG_ PayloadByte21 : 232|8@1+ (1,0) [0|255] "" UPPER
 SG_ PayloadByte22 : 240|8@1+ (1,0) [0|255] "" UPPER
 SG_ PayloadByte23 : 248|8@1+ (1,0) [0|255] "" UPPER
 SG_ PayloadByte24 : 256|8@1+ (1,0) [0|255] "" UPPER
 SG_ PayloadByte25 : 264|8@1+ (1,0) [0|255] "" UPPER
 SG_ PayloadByte26 : 272|8@1+ (1,0) [0|255] "" UPPER
 SG_ PayloadByte27 : 280|8@1+ (1,0) [0|255] "" UPPER
 SG_ PayloadByte28 : 288|8@1+ (1,0) [0|255] "" UPPER
 SG_ PayloadByte29 : 296|8@1+ (1,0) [0|255] "" UPPER
 SG_ PayloadByte30 : 304|8@1+ (1,0) [0|255] "" UPPER
 SG_ PayloadByte31 : 312|8@1+ (1,0) [0|255] "" UPPER
 SG_ PayloadByte32 : 320|8@1+ (1,0) [0|255] "" UPPER
 SG_ PayloadByte33 : 328|8@1+ (1,0) [0|255] "" UPPER
 SG_ PayloadByte34 : 336|8@1+ (1,0) [0|255] "" UPPER
 SG_ PayloadByte35 : 344|8@1+ (1,0) [0|255] "" UPPER
 SG_ PayloadByte36 : 352|8@1+ (1,0) [0|255] "" UPPER
 SG_ PayloadByte37 : 360|8@1+ (1,0) [0|255] "" UPPER
 SG_ PayloadByte38 : 368|8@1+ (1,0) [0|255] "" UPPER
 SG_ PayloadByte39 : 376|8@1+ (1,0) [0|255] "" UPPER
 SG_ PayloadByte40 : 384|8@1+ (1,0) [0|255] "" UPPER
 SG_ PayloadByte41 : 392|8@1+ (1,0) [0|255] "" UPPER
 SG_ PayloadByte42 : 400|8@1+ (1,0) [0|255] "" UPPER
 SG_ PayloadByte43 : 408|8@1+ (1,0) [0|255] "" UPPER
 SG_ PayloadByte44 : 416|8@1+ (1,0) [0|255] "" UPPER
 SG_ PayloadByte45 : 424|8@1+ (1,0) [0|255] "" UPPER
 SG_ PayloadByte46 : 432|8@1+ (1,0) [0|255] "" UPPER
 SG_ PayloadByte47 : 440|8@1+ (1,0) [0|255] "" UPPER
 SG_ PayloadByte48 : 448|8@1+ (1,0) [0|255] "" UPPER
 SG_ PayloadByte49 : 456|8@1+ (1,0) [0|255] "" UPPER
 SG_ PayloadByte50 : 464|8@1+ (1,0) [0|255] "" UPPER
 SG_ PayloadByte51 : 472|8@1+ (1,0) [0|255] "" UPPER
 SG_ PayloadByte52 : 480|8@1+ (1,0) [0|255] "" UPPER
 SG_ PayloadByte53 : 488|8@1+ (1,0) [0|255] "" UPPER
 SG_ PayloadByte54 : 496|8@1+ (1,0) [0|255] "" UPPER
 SG_ PayloadByte55 : 504|8@1+ (1,0) [0|255] "" UPPER

BO_ 1735 S20_Upper_Fragment_18: 64 S20
 SG_ MagicU : 0|8@1+ (1,0) [0|255] "" UPPER
 SG_ MagicC : 8|8@1+ (1,0) [0|255] "" UPPER
 SG_ ProtocolVersion : 16|8@1+ (1,0) [0|255] "" UPPER
 SG_ FragmentIndex : 24|8@1+ (1,0) [0|255] "" UPPER
 SG_ SequenceLow16 : 32|16@1+ (1,0) [0|65535] "" UPPER
 SG_ PacketLength : 48|16@1+ (1,0) [0|65535] "" UPPER
 SG_ PayloadByte00 : 64|8@1+ (1,0) [0|255] "" UPPER
 SG_ PayloadByte01 : 72|8@1+ (1,0) [0|255] "" UPPER
 SG_ PayloadByte02 : 80|8@1+ (1,0) [0|255] "" UPPER
 SG_ PayloadByte03 : 88|8@1+ (1,0) [0|255] "" UPPER
 SG_ PayloadByte04 : 96|8@1+ (1,0) [0|255] "" UPPER
 SG_ PayloadByte05 : 104|8@1+ (1,0) [0|255] "" UPPER
 SG_ PayloadByte06 : 112|8@1+ (1,0) [0|255] "" UPPER
 SG_ PayloadByte07 : 120|8@1+ (1,0) [0|255] "" UPPER
 SG_ PayloadByte08 : 128|8@1+ (1,0) [0|255] "" UPPER
 SG_ PayloadByte09 : 136|8@1+ (1,0) [0|255] "" UPPER
 SG_ PayloadByte10 : 144|8@1+ (1,0) [0|255] "" UPPER
 SG_ PayloadByte11 : 152|8@1+ (1,0) [0|255] "" UPPER
 SG_ PayloadByte12 : 160|8@1+ (1,0) [0|255] "" UPPER
 SG_ PayloadByte13 : 168|8@1+ (1,0) [0|255] "" UPPER
 SG_ PayloadByte14 : 176|8@1+ (1,0) [0|255] "" UPPER
 SG_ PayloadByte15 : 184|8@1+ (1,0) [0|255] "" UPPER
 SG_ PayloadByte16 : 192|8@1+ (1,0) [0|255] "" UPPER
 SG_ PayloadByte17 : 200|8@1+ (1,0) [0|255] "" UPPER
 SG_ PayloadByte18 : 208|8@1+ (1,0) [0|255] "" UPPER
 SG_ PayloadByte19 : 216|8@1+ (1,0) [0|255] "" UPPER
 SG_ PayloadByte20 : 224|8@1+ (1,0) [0|255] "" UPPER
 SG_ PayloadByte21 : 232|8@1+ (1,0) [0|255] "" UPPER
 SG_ PayloadByte22 : 240|8@1+ (1,0) [0|255] "" UPPER
 SG_ PayloadByte23 : 248|8@1+ (1,0) [0|255] "" UPPER
 SG_ PayloadByte24 : 256|8@1+ (1,0) [0|255] "" UPPER
 SG_ PayloadByte25 : 264|8@1+ (1,0) [0|255] "" UPPER
 SG_ PayloadByte26 : 272|8@1+ (1,0) [0|255] "" UPPER
 SG_ PayloadByte27 : 280|8@1+ (1,0) [0|255] "" UPPER
 SG_ PayloadByte28 : 288|8@1+ (1,0) [0|255] "" UPPER
 SG_ PayloadByte29 : 296|8@1+ (1,0) [0|255] "" UPPER
 SG_ PayloadByte30 : 304|8@1+ (1,0) [0|255] "" UPPER
 SG_ PayloadByte31 : 312|8@1+ (1,0) [0|255] "" UPPER
 SG_ PayloadByte32 : 320|8@1+ (1,0) [0|255] "" UPPER
 SG_ PayloadByte33 : 328|8@1+ (1,0) [0|255] "" UPPER
 SG_ PayloadByte34 : 336|8@1+ (1,0) [0|255] "" UPPER
 SG_ PayloadByte35 : 344|8@1+ (1,0) [0|255] "" UPPER
 SG_ PayloadByte36 : 352|8@1+ (1,0) [0|255] "" UPPER
 SG_ PayloadByte37 : 360|8@1+ (1,0) [0|255] "" UPPER
 SG_ PayloadByte38 : 368|8@1+ (1,0) [0|255] "" UPPER
 SG_ PayloadByte39 : 376|8@1+ (1,0) [0|255] "" UPPER
 SG_ PayloadByte40 : 384|8@1+ (1,0) [0|255] "" UPPER
 SG_ PayloadByte41 : 392|8@1+ (1,0) [0|255] "" UPPER
 SG_ PayloadByte42 : 400|8@1+ (1,0) [0|255] "" UPPER
 SG_ PayloadByte43 : 408|8@1+ (1,0) [0|255] "" UPPER
 SG_ PayloadByte44 : 416|8@1+ (1,0) [0|255] "" UPPER
 SG_ PayloadByte45 : 424|8@1+ (1,0) [0|255] "" UPPER
 SG_ PayloadByte46 : 432|8@1+ (1,0) [0|255] "" UPPER
 SG_ PayloadByte47 : 440|8@1+ (1,0) [0|255] "" UPPER
 SG_ PayloadByte48 : 448|8@1+ (1,0) [0|255] "" UPPER
 SG_ PayloadByte49 : 456|8@1+ (1,0) [0|255] "" UPPER
 SG_ PayloadByte50 : 464|8@1+ (1,0) [0|255] "" UPPER
 SG_ PayloadByte51 : 472|8@1+ (1,0) [0|255] "" UPPER
 SG_ PayloadByte52 : 480|8@1+ (1,0) [0|255] "" UPPER
 SG_ PayloadByte53 : 488|8@1+ (1,0) [0|255] "" UPPER
 SG_ PayloadByte54 : 496|8@1+ (1,0) [0|255] "" UPPER
 SG_ PayloadByte55 : 504|8@1+ (1,0) [0|255] "" UPPER

BO_ 1736 S20_Upper_Fragment_19: 64 S20
 SG_ MagicU : 0|8@1+ (1,0) [0|255] "" UPPER
 SG_ MagicC : 8|8@1+ (1,0) [0|255] "" UPPER
 SG_ ProtocolVersion : 16|8@1+ (1,0) [0|255] "" UPPER
 SG_ FragmentIndex : 24|8@1+ (1,0) [0|255] "" UPPER
 SG_ SequenceLow16 : 32|16@1+ (1,0) [0|65535] "" UPPER
 SG_ PacketLength : 48|16@1+ (1,0) [0|65535] "" UPPER
 SG_ PayloadByte00 : 64|8@1+ (1,0) [0|255] "" UPPER
 SG_ PayloadByte01 : 72|8@1+ (1,0) [0|255] "" UPPER
 SG_ PayloadByte02 : 80|8@1+ (1,0) [0|255] "" UPPER
 SG_ PayloadByte03 : 88|8@1+ (1,0) [0|255] "" UPPER
 SG_ PayloadByte04 : 96|8@1+ (1,0) [0|255] "" UPPER
 SG_ PayloadByte05 : 104|8@1+ (1,0) [0|255] "" UPPER
 SG_ PayloadByte06 : 112|8@1+ (1,0) [0|255] "" UPPER
 SG_ PayloadByte07 : 120|8@1+ (1,0) [0|255] "" UPPER
 SG_ PayloadByte08 : 128|8@1+ (1,0) [0|255] "" UPPER
 SG_ PayloadByte09 : 136|8@1+ (1,0) [0|255] "" UPPER
 SG_ PayloadByte10 : 144|8@1+ (1,0) [0|255] "" UPPER
 SG_ PayloadByte11 : 152|8@1+ (1,0) [0|255] "" UPPER
 SG_ PayloadByte12 : 160|8@1+ (1,0) [0|255] "" UPPER
 SG_ PayloadByte13 : 168|8@1+ (1,0) [0|255] "" UPPER
 SG_ PayloadByte14 : 176|8@1+ (1,0) [0|255] "" UPPER
 SG_ PayloadByte15 : 184|8@1+ (1,0) [0|255] "" UPPER
 SG_ PayloadByte16 : 192|8@1+ (1,0) [0|255] "" UPPER
 SG_ PayloadByte17 : 200|8@1+ (1,0) [0|255] "" UPPER
 SG_ PayloadByte18 : 208|8@1+ (1,0) [0|255] "" UPPER
 SG_ PayloadByte19 : 216|8@1+ (1,0) [0|255] "" UPPER
 SG_ PayloadByte20 : 224|8@1+ (1,0) [0|255] "" UPPER
 SG_ PayloadByte21 : 232|8@1+ (1,0) [0|255] "" UPPER
 SG_ PayloadByte22 : 240|8@1+ (1,0) [0|255] "" UPPER
 SG_ PayloadByte23 : 248|8@1+ (1,0) [0|255] "" UPPER
 SG_ PayloadByte24 : 256|8@1+ (1,0) [0|255] "" UPPER
 SG_ PayloadByte25 : 264|8@1+ (1,0) [0|255] "" UPPER
 SG_ PayloadByte26 : 272|8@1+ (1,0) [0|255] "" UPPER
 SG_ PayloadByte27 : 280|8@1+ (1,0) [0|255] "" UPPER
 SG_ PayloadByte28 : 288|8@1+ (1,0) [0|255] "" UPPER
 SG_ PayloadByte29 : 296|8@1+ (1,0) [0|255] "" UPPER
 SG_ PayloadByte30 : 304|8@1+ (1,0) [0|255] "" UPPER
 SG_ PayloadByte31 : 312|8@1+ (1,0) [0|255] "" UPPER
 SG_ PayloadByte32 : 320|8@1+ (1,0) [0|255] "" UPPER
 SG_ PayloadByte33 : 328|8@1+ (1,0) [0|255] "" UPPER
 SG_ PayloadByte34 : 336|8@1+ (1,0) [0|255] "" UPPER
 SG_ PayloadByte35 : 344|8@1+ (1,0) [0|255] "" UPPER
 SG_ PayloadByte36 : 352|8@1+ (1,0) [0|255] "" UPPER
 SG_ PayloadByte37 : 360|8@1+ (1,0) [0|255] "" UPPER
 SG_ PayloadByte38 : 368|8@1+ (1,0) [0|255] "" UPPER
 SG_ PayloadByte39 : 376|8@1+ (1,0) [0|255] "" UPPER
 SG_ PayloadByte40 : 384|8@1+ (1,0) [0|255] "" UPPER
 SG_ PayloadByte41 : 392|8@1+ (1,0) [0|255] "" UPPER
 SG_ PayloadByte42 : 400|8@1+ (1,0) [0|255] "" UPPER
 SG_ PayloadByte43 : 408|8@1+ (1,0) [0|255] "" UPPER
 SG_ PayloadByte44 : 416|8@1+ (1,0) [0|255] "" UPPER
 SG_ PayloadByte45 : 424|8@1+ (1,0) [0|255] "" UPPER
 SG_ PayloadByte46 : 432|8@1+ (1,0) [0|255] "" UPPER
 SG_ PayloadByte47 : 440|8@1+ (1,0) [0|255] "" UPPER
 SG_ PayloadByte48 : 448|8@1+ (1,0) [0|255] "" UPPER
 SG_ PayloadByte49 : 456|8@1+ (1,0) [0|255] "" UPPER
 SG_ PayloadByte50 : 464|8@1+ (1,0) [0|255] "" UPPER
 SG_ PayloadByte51 : 472|8@1+ (1,0) [0|255] "" UPPER
 SG_ PayloadByte52 : 480|8@1+ (1,0) [0|255] "" UPPER
 SG_ PayloadByte53 : 488|8@1+ (1,0) [0|255] "" UPPER
 SG_ PayloadByte54 : 496|8@1+ (1,0) [0|255] "" UPPER
 SG_ PayloadByte55 : 504|8@1+ (1,0) [0|255] "" UPPER

BA_DEF_ BO_ "VFrameFormat" ENUM "StandardCAN","ExtendedCAN","reserved","J1939PG","reserved","reserved","reserved","reserved","reserved","reserved","reserved","reserved","reserved","reserved","StandardCAN_FD","ExtendedCAN_FD";
BA_DEF_ BO_ "GenMsgCycleTime" INT 0 65535;
CM_ "UC v1 fragment transport. MagicU=85, MagicC=67, ProtocolVersion=1, PacketLength=1634. Reassemble 30 fragments, validate inner USSV header and CRC32 before interpreting sf_Upper values. Do not use legacy geometry DBC for these frames.";
BA_ "VFrameFormat" BO_ 1600 14;
BA_ "GenMsgCycleTime" BO_ 1600 40;
CM_ BO_ 1600 "RTE PAS_Rawdata0. FragmentIndex modulo 20 = 0; 255 is idle. PayloadByte00 is packet byte 56*FragmentIndex. Complete packet has 1634 bytes; final fragment padding must be ignored.";
BA_ "VFrameFormat" BO_ 1718 14;
BA_ "GenMsgCycleTime" BO_ 1718 40;
CM_ BO_ 1718 "RTE PAS_Rawdata1. FragmentIndex modulo 20 = 1; 255 is idle. PayloadByte00 is packet byte 56*FragmentIndex. Complete packet has 1634 bytes; final fragment padding must be ignored.";
BA_ "VFrameFormat" BO_ 1719 14;
BA_ "GenMsgCycleTime" BO_ 1719 40;
CM_ BO_ 1719 "RTE PAS_Rawdata2. FragmentIndex modulo 20 = 2; 255 is idle. PayloadByte00 is packet byte 56*FragmentIndex. Complete packet has 1634 bytes; final fragment padding must be ignored.";
BA_ "VFrameFormat" BO_ 1720 14;
BA_ "GenMsgCycleTime" BO_ 1720 40;
CM_ BO_ 1720 "RTE PAS_Rawdata3. FragmentIndex modulo 20 = 3; 255 is idle. PayloadByte00 is packet byte 56*FragmentIndex. Complete packet has 1634 bytes; final fragment padding must be ignored.";
BA_ "VFrameFormat" BO_ 1721 14;
BA_ "GenMsgCycleTime" BO_ 1721 40;
CM_ BO_ 1721 "RTE PAS_Rawdata4. FragmentIndex modulo 20 = 4; 255 is idle. PayloadByte00 is packet byte 56*FragmentIndex. Complete packet has 1634 bytes; final fragment padding must be ignored.";
BA_ "VFrameFormat" BO_ 1722 14;
BA_ "GenMsgCycleTime" BO_ 1722 40;
CM_ BO_ 1722 "RTE PAS_Rawdata5. FragmentIndex modulo 20 = 5; 255 is idle. PayloadByte00 is packet byte 56*FragmentIndex. Complete packet has 1634 bytes; final fragment padding must be ignored.";
BA_ "VFrameFormat" BO_ 1723 14;
BA_ "GenMsgCycleTime" BO_ 1723 40;
CM_ BO_ 1723 "RTE PAS_Rawdata6. FragmentIndex modulo 20 = 6; 255 is idle. PayloadByte00 is packet byte 56*FragmentIndex. Complete packet has 1634 bytes; final fragment padding must be ignored.";
BA_ "VFrameFormat" BO_ 1724 14;
BA_ "GenMsgCycleTime" BO_ 1724 40;
CM_ BO_ 1724 "RTE PAS_Rawdata7. FragmentIndex modulo 20 = 7; 255 is idle. PayloadByte00 is packet byte 56*FragmentIndex. Complete packet has 1634 bytes; final fragment padding must be ignored.";
BA_ "VFrameFormat" BO_ 1725 14;
BA_ "GenMsgCycleTime" BO_ 1725 40;
CM_ BO_ 1725 "RTE PAS_Rawdata8. FragmentIndex modulo 20 = 8; 255 is idle. PayloadByte00 is packet byte 56*FragmentIndex. Complete packet has 1634 bytes; final fragment padding must be ignored.";
BA_ "VFrameFormat" BO_ 1726 14;
BA_ "GenMsgCycleTime" BO_ 1726 40;
CM_ BO_ 1726 "RTE PAS_Rawdata9. FragmentIndex modulo 20 = 9; 255 is idle. PayloadByte00 is packet byte 56*FragmentIndex. Complete packet has 1634 bytes; final fragment padding must be ignored.";
BA_ "VFrameFormat" BO_ 1727 14;
BA_ "GenMsgCycleTime" BO_ 1727 40;
CM_ BO_ 1727 "RTE PAS_Rawdata10. FragmentIndex modulo 20 = 10; 255 is idle. PayloadByte00 is packet byte 56*FragmentIndex. Complete packet has 1634 bytes; final fragment padding must be ignored.";
BA_ "VFrameFormat" BO_ 1728 14;
BA_ "GenMsgCycleTime" BO_ 1728 40;
CM_ BO_ 1728 "RTE PAS_Rawdata11. FragmentIndex modulo 20 = 11; 255 is idle. PayloadByte00 is packet byte 56*FragmentIndex. Complete packet has 1634 bytes; final fragment padding must be ignored.";
BA_ "VFrameFormat" BO_ 1729 14;
BA_ "GenMsgCycleTime" BO_ 1729 40;
CM_ BO_ 1729 "RTE PAS_Rawdata12. FragmentIndex modulo 20 = 12; 255 is idle. PayloadByte00 is packet byte 56*FragmentIndex. Complete packet has 1634 bytes; final fragment padding must be ignored.";
BA_ "VFrameFormat" BO_ 1730 14;
BA_ "GenMsgCycleTime" BO_ 1730 40;
CM_ BO_ 1730 "RTE PAS_Rawdata13. FragmentIndex modulo 20 = 13; 255 is idle. PayloadByte00 is packet byte 56*FragmentIndex. Complete packet has 1634 bytes; final fragment padding must be ignored.";
BA_ "VFrameFormat" BO_ 1731 14;
BA_ "GenMsgCycleTime" BO_ 1731 40;
CM_ BO_ 1731 "RTE PAS_Rawdata14. FragmentIndex modulo 20 = 14; 255 is idle. PayloadByte00 is packet byte 56*FragmentIndex. Complete packet has 1634 bytes; final fragment padding must be ignored.";
BA_ "VFrameFormat" BO_ 1732 14;
BA_ "GenMsgCycleTime" BO_ 1732 40;
CM_ BO_ 1732 "RTE PAS_Rawdata15. FragmentIndex modulo 20 = 15; 255 is idle. PayloadByte00 is packet byte 56*FragmentIndex. Complete packet has 1634 bytes; final fragment padding must be ignored.";
BA_ "VFrameFormat" BO_ 1733 14;
BA_ "GenMsgCycleTime" BO_ 1733 40;
CM_ BO_ 1733 "RTE PAS_Rawdata16. FragmentIndex modulo 20 = 16; 255 is idle. PayloadByte00 is packet byte 56*FragmentIndex. Complete packet has 1634 bytes; final fragment padding must be ignored.";
BA_ "VFrameFormat" BO_ 1734 14;
BA_ "GenMsgCycleTime" BO_ 1734 40;
CM_ BO_ 1734 "RTE PAS_Rawdata17. FragmentIndex modulo 20 = 17; 255 is idle. PayloadByte00 is packet byte 56*FragmentIndex. Complete packet has 1634 bytes; final fragment padding must be ignored.";
BA_ "VFrameFormat" BO_ 1735 14;
BA_ "GenMsgCycleTime" BO_ 1735 40;
CM_ BO_ 1735 "RTE PAS_Rawdata18. FragmentIndex modulo 20 = 18; 255 is idle. PayloadByte00 is packet byte 56*FragmentIndex. Complete packet has 1634 bytes; final fragment padding must be ignored.";
BA_ "VFrameFormat" BO_ 1736 14;
BA_ "GenMsgCycleTime" BO_ 1736 40;
CM_ BO_ 1736 "RTE PAS_Rawdata19. FragmentIndex modulo 20 = 19; 255 is idle. PayloadByte00 is packet byte 56*FragmentIndex. Complete packet has 1634 bytes; final fragment padding must be ignored.";
