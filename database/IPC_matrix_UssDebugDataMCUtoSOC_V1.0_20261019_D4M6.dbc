VERSION ""

NS_ :

BS_:

BU_: MCU SOC

BO_ 2415921000 Upper_PointOutSignal_01: 64 MCU
 SG_ ObjID_0 : 7|16@0+ (1,0) [0|65535] "" SOC
 SG_ x_0 : 23|16@0- (1,0) [-32768|32767] "cm" SOC
 SG_ y_0 : 39|16@0- (1,0) [-32768|32767] "cm" SOC
 SG_ cHight_0 : 55|8@0+ (1,0) [0|255] "" SOC
 SG_ SNS_Txindex_0 : 63|8@0+ (1,0) [0|255] "" SOC
 SG_ SNS_Rxindex_0 : 71|8@0+ (1,0) [0|255] "" SOC
 SG_ ObjID_1 : 87|16@0+ (1,0) [0|65535] "" SOC
 SG_ x_1 : 103|16@0- (1,0) [-32768|32767] "cm" SOC
 SG_ y_1 : 119|16@0- (1,0) [-32768|32767] "cm" SOC
 SG_ cHight_1 : 135|8@0+ (1,0) [0|255] "" SOC
 SG_ SNS_Txindex_1 : 143|8@0+ (1,0) [0|255] "" SOC
 SG_ SNS_Rxindex_1 : 151|8@0+ (1,0) [0|255] "" SOC
 SG_ ObjID_2 : 167|16@0+ (1,0) [0|65535] "" SOC
 SG_ x_2 : 183|16@0- (1,0) [-32768|32767] "cm" SOC
 SG_ y_2 : 199|16@0- (1,0) [-32768|32767] "cm" SOC
 SG_ cHight_2 : 215|8@0+ (1,0) [0|255] "" SOC
 SG_ SNS_Txindex_2 : 223|8@0+ (1,0) [0|255] "" SOC
 SG_ SNS_Rxindex_2 : 231|8@0+ (1,0) [0|255] "" SOC
 SG_ ObjID_3 : 247|16@0+ (1,0) [0|65535] "" SOC
 SG_ x_3 : 263|16@0- (1,0) [-32768|32767] "cm" SOC
 SG_ y_3 : 279|16@0- (1,0) [-32768|32767] "cm" SOC
 SG_ cHight_3 : 295|8@0+ (1,0) [0|255] "" SOC
 SG_ SNS_Txindex_3 : 303|8@0+ (1,0) [0|255] "" SOC
 SG_ SNS_Rxindex_3 : 311|8@0+ (1,0) [0|255] "" SOC
 SG_ ObjID_4 : 327|16@0+ (1,0) [0|65535] "" SOC
 SG_ x_4 : 343|16@0- (1,0) [-32768|32767] "cm" SOC
 SG_ y_4 : 359|16@0- (1,0) [-32768|32767] "cm" SOC
 SG_ cHight_4 : 375|8@0+ (1,0) [0|255] "" SOC
 SG_ SNS_Txindex_4 : 383|8@0+ (1,0) [0|255] "" SOC
 SG_ SNS_Rxindex_4 : 391|8@0+ (1,0) [0|255] "" SOC
 SG_ ObjID_5 : 407|16@0+ (1,0) [0|65535] "" SOC
 SG_ x_5 : 423|16@0- (1,0) [-32768|32767] "cm" SOC
 SG_ y_5 : 439|16@0- (1,0) [-32768|32767] "cm" SOC
 SG_ cHight_5 : 455|8@0+ (1,0) [0|255] "" SOC
 SG_ SNS_Txindex_5 : 463|8@0+ (1,0) [0|255] "" SOC
 SG_ SNS_Rxindex_5 : 471|8@0+ (1,0) [0|255] "" SOC

BO_ 2415921001 Upper_PointOutSignal_02: 64 MCU
 SG_ ObjID_6 : 7|16@0+ (1,0) [0|65535] "" SOC
 SG_ x_6 : 23|16@0- (1,0) [-32768|32767] "cm" SOC
 SG_ y_6 : 39|16@0- (1,0) [-32768|32767] "cm" SOC
 SG_ cHight_6 : 55|8@0+ (1,0) [0|255] "" SOC
 SG_ SNS_Txindex_6 : 63|8@0+ (1,0) [0|255] "" SOC
 SG_ SNS_Rxindex_6 : 71|8@0+ (1,0) [0|255] "" SOC
 SG_ ObjID_7 : 87|16@0+ (1,0) [0|65535] "" SOC
 SG_ x_7 : 103|16@0- (1,0) [-32768|32767] "cm" SOC
 SG_ y_7 : 119|16@0- (1,0) [-32768|32767] "cm" SOC
 SG_ cHight_7 : 135|8@0+ (1,0) [0|255] "" SOC
 SG_ SNS_Txindex_7 : 143|8@0+ (1,0) [0|255] "" SOC
 SG_ SNS_Rxindex_7 : 151|8@0+ (1,0) [0|255] "" SOC
 SG_ ObjID_8 : 167|16@0+ (1,0) [0|65535] "" SOC
 SG_ x_8 : 183|16@0- (1,0) [-32768|32767] "cm" SOC
 SG_ y_8 : 199|16@0- (1,0) [-32768|32767] "cm" SOC
 SG_ cHight_8 : 215|8@0+ (1,0) [0|255] "" SOC
 SG_ SNS_Txindex_8 : 223|8@0+ (1,0) [0|255] "" SOC
 SG_ SNS_Rxindex_8 : 231|8@0+ (1,0) [0|255] "" SOC
 SG_ ObjID_9 : 247|16@0+ (1,0) [0|65535] "" SOC
 SG_ x_9 : 263|16@0- (1,0) [-32768|32767] "cm" SOC
 SG_ y_9 : 279|16@0- (1,0) [-32768|32767] "cm" SOC
 SG_ cHight_9 : 295|8@0+ (1,0) [0|255] "" SOC
 SG_ SNS_Txindex_9 : 303|8@0+ (1,0) [0|255] "" SOC
 SG_ SNS_Rxindex_9 : 311|8@0+ (1,0) [0|255] "" SOC
 SG_ ObjID_10 : 327|16@0+ (1,0) [0|65535] "" SOC
 SG_ x_10 : 343|16@0- (1,0) [-32768|32767] "cm" SOC
 SG_ y_10 : 359|16@0- (1,0) [-32768|32767] "cm" SOC
 SG_ cHight_10 : 375|8@0+ (1,0) [0|255] "" SOC
 SG_ SNS_Txindex_10 : 383|8@0+ (1,0) [0|255] "" SOC
 SG_ SNS_Rxindex_10 : 391|8@0+ (1,0) [0|255] "" SOC
 SG_ ObjID_11 : 407|16@0+ (1,0) [0|65535] "" SOC
 SG_ x_11 : 423|16@0- (1,0) [-32768|32767] "cm" SOC
 SG_ y_11 : 439|16@0- (1,0) [-32768|32767] "cm" SOC
 SG_ cHight_11 : 455|8@0+ (1,0) [0|255] "" SOC
 SG_ SNS_Txindex_11 : 463|8@0+ (1,0) [0|255] "" SOC
 SG_ SNS_Rxindex_11 : 471|8@0+ (1,0) [0|255] "" SOC

BO_ 2415921002 Upper_PointOutSignal_03: 64 MCU
 SG_ ObjID_12 : 7|16@0+ (1,0) [0|65535] "" SOC
 SG_ x_12 : 23|16@0- (1,0) [-32768|32767] "cm" SOC
 SG_ y_12 : 39|16@0- (1,0) [-32768|32767] "cm" SOC
 SG_ cHight_12 : 55|8@0+ (1,0) [0|255] "" SOC
 SG_ SNS_Txindex_12 : 63|8@0+ (1,0) [0|255] "" SOC
 SG_ SNS_Rxindex_12 : 71|8@0+ (1,0) [0|255] "" SOC
 SG_ ObjID_13 : 87|16@0+ (1,0) [0|65535] "" SOC
 SG_ x_13 : 103|16@0- (1,0) [-32768|32767] "cm" SOC
 SG_ y_13 : 119|16@0- (1,0) [-32768|32767] "cm" SOC
 SG_ cHight_13 : 135|8@0+ (1,0) [0|255] "" SOC
 SG_ SNS_Txindex_13 : 143|8@0+ (1,0) [0|255] "" SOC
 SG_ SNS_Rxindex_13 : 151|8@0+ (1,0) [0|255] "" SOC
 SG_ ObjID_14 : 167|16@0+ (1,0) [0|65535] "" SOC
 SG_ x_14 : 183|16@0- (1,0) [-32768|32767] "cm" SOC
 SG_ y_14 : 199|16@0- (1,0) [-32768|32767] "cm" SOC
 SG_ cHight_14 : 215|8@0+ (1,0) [0|255] "" SOC
 SG_ SNS_Txindex_14 : 223|8@0+ (1,0) [0|255] "" SOC
 SG_ SNS_Rxindex_14 : 231|8@0+ (1,0) [0|255] "" SOC
 SG_ ObjID_15 : 247|16@0+ (1,0) [0|65535] "" SOC
 SG_ x_15 : 263|16@0- (1,0) [-32768|32767] "cm" SOC
 SG_ y_15 : 279|16@0- (1,0) [-32768|32767] "cm" SOC
 SG_ cHight_15 : 295|8@0+ (1,0) [0|255] "" SOC
 SG_ SNS_Txindex_15 : 303|8@0+ (1,0) [0|255] "" SOC
 SG_ SNS_Rxindex_15 : 311|8@0+ (1,0) [0|255] "" SOC
 SG_ ObjID_16 : 327|16@0+ (1,0) [0|65535] "" SOC
 SG_ x_16 : 343|16@0- (1,0) [-32768|32767] "cm" SOC
 SG_ y_16 : 359|16@0- (1,0) [-32768|32767] "cm" SOC
 SG_ cHight_16 : 375|8@0+ (1,0) [0|255] "" SOC
 SG_ SNS_Txindex_16 : 383|8@0+ (1,0) [0|255] "" SOC
 SG_ SNS_Rxindex_16 : 391|8@0+ (1,0) [0|255] "" SOC
 SG_ ObjID_17 : 407|16@0+ (1,0) [0|65535] "" SOC
 SG_ x_17 : 423|16@0- (1,0) [-32768|32767] "cm" SOC
 SG_ y_17 : 439|16@0- (1,0) [-32768|32767] "cm" SOC
 SG_ cHight_17 : 455|8@0+ (1,0) [0|255] "" SOC
 SG_ SNS_Txindex_17 : 463|8@0+ (1,0) [0|255] "" SOC
 SG_ SNS_Rxindex_17 : 471|8@0+ (1,0) [0|255] "" SOC

BO_ 2415921003 Upper_PointOutSignal_04: 64 MCU
 SG_ ObjID_18 : 7|16@0+ (1,0) [0|65535] "" SOC
 SG_ x_18 : 23|16@0- (1,0) [-32768|32767] "cm" SOC
 SG_ y_18 : 39|16@0- (1,0) [-32768|32767] "cm" SOC
 SG_ cHight_18 : 55|8@0+ (1,0) [0|255] "" SOC
 SG_ SNS_Txindex_18 : 63|8@0+ (1,0) [0|255] "" SOC
 SG_ SNS_Rxindex_18 : 71|8@0+ (1,0) [0|255] "" SOC
 SG_ ObjID_19 : 87|16@0+ (1,0) [0|65535] "" SOC
 SG_ x_19 : 103|16@0- (1,0) [-32768|32767] "cm" SOC
 SG_ y_19 : 119|16@0- (1,0) [-32768|32767] "cm" SOC
 SG_ cHight_19 : 135|8@0+ (1,0) [0|255] "" SOC
 SG_ SNS_Txindex_19 : 143|8@0+ (1,0) [0|255] "" SOC
 SG_ SNS_Rxindex_19 : 151|8@0+ (1,0) [0|255] "" SOC
 SG_ ObjID_20 : 167|16@0+ (1,0) [0|65535] "" SOC
 SG_ x_20 : 183|16@0- (1,0) [-32768|32767] "cm" SOC
 SG_ y_20 : 199|16@0- (1,0) [-32768|32767] "cm" SOC
 SG_ cHight_20 : 215|8@0+ (1,0) [0|255] "" SOC
 SG_ SNS_Txindex_20 : 223|8@0+ (1,0) [0|255] "" SOC
 SG_ SNS_Rxindex_20 : 231|8@0+ (1,0) [0|255] "" SOC
 SG_ ObjID_21 : 247|16@0+ (1,0) [0|65535] "" SOC
 SG_ x_21 : 263|16@0- (1,0) [-32768|32767] "cm" SOC
 SG_ y_21 : 279|16@0- (1,0) [-32768|32767] "cm" SOC
 SG_ cHight_21 : 295|8@0+ (1,0) [0|255] "" SOC
 SG_ SNS_Txindex_21 : 303|8@0+ (1,0) [0|255] "" SOC
 SG_ SNS_Rxindex_21 : 311|8@0+ (1,0) [0|255] "" SOC
 SG_ ObjID_22 : 327|16@0+ (1,0) [0|65535] "" SOC
 SG_ x_22 : 343|16@0- (1,0) [-32768|32767] "cm" SOC
 SG_ y_22 : 359|16@0- (1,0) [-32768|32767] "cm" SOC
 SG_ cHight_22 : 375|8@0+ (1,0) [0|255] "" SOC
 SG_ SNS_Txindex_22 : 383|8@0+ (1,0) [0|255] "" SOC
 SG_ SNS_Rxindex_22 : 391|8@0+ (1,0) [0|255] "" SOC
 SG_ ObjID_23 : 407|16@0+ (1,0) [0|65535] "" SOC
 SG_ x_23 : 423|16@0- (1,0) [-32768|32767] "cm" SOC
 SG_ y_23 : 439|16@0- (1,0) [-32768|32767] "cm" SOC
 SG_ cHight_23 : 455|8@0+ (1,0) [0|255] "" SOC
 SG_ SNS_Txindex_23 : 463|8@0+ (1,0) [0|255] "" SOC
 SG_ SNS_Rxindex_23 : 471|8@0+ (1,0) [0|255] "" SOC

BO_ 2415921004 Upper_PointOutSignal_05: 64 MCU
 SG_ ObjID_24 : 7|16@0+ (1,0) [0|65535] "" SOC
 SG_ x_24 : 23|16@0- (1,0) [-32768|32767] "cm" SOC
 SG_ y_24 : 39|16@0- (1,0) [-32768|32767] "cm" SOC
 SG_ cHight_24 : 55|8@0+ (1,0) [0|255] "" SOC
 SG_ SNS_Txindex_24 : 63|8@0+ (1,0) [0|255] "" SOC
 SG_ SNS_Rxindex_24 : 71|8@0+ (1,0) [0|255] "" SOC
 SG_ ObjID_25 : 87|16@0+ (1,0) [0|65535] "" SOC
 SG_ x_25 : 103|16@0- (1,0) [-32768|32767] "cm" SOC
 SG_ y_25 : 119|16@0- (1,0) [-32768|32767] "cm" SOC
 SG_ cHight_25 : 135|8@0+ (1,0) [0|255] "" SOC
 SG_ SNS_Txindex_25 : 143|8@0+ (1,0) [0|255] "" SOC
 SG_ SNS_Rxindex_25 : 151|8@0+ (1,0) [0|255] "" SOC
 SG_ ObjID_26 : 167|16@0+ (1,0) [0|65535] "" SOC
 SG_ x_26 : 183|16@0- (1,0) [-32768|32767] "cm" SOC
 SG_ y_26 : 199|16@0- (1,0) [-32768|32767] "cm" SOC
 SG_ cHight_26 : 215|8@0+ (1,0) [0|255] "" SOC
 SG_ SNS_Txindex_26 : 223|8@0+ (1,0) [0|255] "" SOC
 SG_ SNS_Rxindex_26 : 231|8@0+ (1,0) [0|255] "" SOC
 SG_ ObjID_27 : 247|16@0+ (1,0) [0|65535] "" SOC
 SG_ x_27 : 263|16@0- (1,0) [-32768|32767] "cm" SOC
 SG_ y_27 : 279|16@0- (1,0) [-32768|32767] "cm" SOC
 SG_ cHight_27 : 295|8@0+ (1,0) [0|255] "" SOC
 SG_ SNS_Txindex_27 : 303|8@0+ (1,0) [0|255] "" SOC
 SG_ SNS_Rxindex_27 : 311|8@0+ (1,0) [0|255] "" SOC
 SG_ ObjID_28 : 327|16@0+ (1,0) [0|65535] "" SOC
 SG_ x_28 : 343|16@0- (1,0) [-32768|32767] "cm" SOC
 SG_ y_28 : 359|16@0- (1,0) [-32768|32767] "cm" SOC
 SG_ cHight_28 : 375|8@0+ (1,0) [0|255] "" SOC
 SG_ SNS_Txindex_28 : 383|8@0+ (1,0) [0|255] "" SOC
 SG_ SNS_Rxindex_28 : 391|8@0+ (1,0) [0|255] "" SOC
 SG_ ObjID_29 : 407|16@0+ (1,0) [0|65535] "" SOC
 SG_ x_29 : 423|16@0- (1,0) [-32768|32767] "cm" SOC
 SG_ y_29 : 439|16@0- (1,0) [-32768|32767] "cm" SOC
 SG_ cHight_29 : 455|8@0+ (1,0) [0|255] "" SOC
 SG_ SNS_Txindex_29 : 463|8@0+ (1,0) [0|255] "" SOC
 SG_ SNS_Rxindex_29 : 471|8@0+ (1,0) [0|255] "" SOC

BO_ 2415921005 Upper_PointOutSignal_06: 64 MCU
 SG_ ObjID_30 : 7|16@0+ (1,0) [0|65535] "" SOC
 SG_ x_30 : 23|16@0- (1,0) [-32768|32767] "cm" SOC
 SG_ y_30 : 39|16@0- (1,0) [-32768|32767] "cm" SOC
 SG_ cHight_30 : 55|8@0+ (1,0) [0|255] "" SOC
 SG_ SNS_Txindex_30 : 63|8@0+ (1,0) [0|255] "" SOC
 SG_ SNS_Rxindex_30 : 71|8@0+ (1,0) [0|255] "" SOC
 SG_ ObjID_31 : 87|16@0+ (1,0) [0|65535] "" SOC
 SG_ x_31 : 103|16@0- (1,0) [-32768|32767] "cm" SOC
 SG_ y_31 : 119|16@0- (1,0) [-32768|32767] "cm" SOC
 SG_ cHight_31 : 135|8@0+ (1,0) [0|255] "" SOC
 SG_ SNS_Txindex_31 : 143|8@0+ (1,0) [0|255] "" SOC
 SG_ SNS_Rxindex_31 : 151|8@0+ (1,0) [0|255] "" SOC
 SG_ ObjID_32 : 167|16@0+ (1,0) [0|65535] "" SOC
 SG_ x_32 : 183|16@0- (1,0) [-32768|32767] "cm" SOC
 SG_ y_32 : 199|16@0- (1,0) [-32768|32767] "cm" SOC
 SG_ cHight_32 : 215|8@0+ (1,0) [0|255] "" SOC
 SG_ SNS_Txindex_32 : 223|8@0+ (1,0) [0|255] "" SOC
 SG_ SNS_Rxindex_32 : 231|8@0+ (1,0) [0|255] "" SOC
 SG_ ObjID_33 : 247|16@0+ (1,0) [0|65535] "" SOC
 SG_ x_33 : 263|16@0- (1,0) [-32768|32767] "cm" SOC
 SG_ y_33 : 279|16@0- (1,0) [-32768|32767] "cm" SOC
 SG_ cHight_33 : 295|8@0+ (1,0) [0|255] "" SOC
 SG_ SNS_Txindex_33 : 303|8@0+ (1,0) [0|255] "" SOC
 SG_ SNS_Rxindex_33 : 311|8@0+ (1,0) [0|255] "" SOC
 SG_ ObjID_34 : 327|16@0+ (1,0) [0|65535] "" SOC
 SG_ x_34 : 343|16@0- (1,0) [-32768|32767] "cm" SOC
 SG_ y_34 : 359|16@0- (1,0) [-32768|32767] "cm" SOC
 SG_ cHight_34 : 375|8@0+ (1,0) [0|255] "" SOC
 SG_ SNS_Txindex_34 : 383|8@0+ (1,0) [0|255] "" SOC
 SG_ SNS_Rxindex_34 : 391|8@0+ (1,0) [0|255] "" SOC
 SG_ ObjID_35 : 407|16@0+ (1,0) [0|65535] "" SOC
 SG_ x_35 : 423|16@0- (1,0) [-32768|32767] "cm" SOC
 SG_ y_35 : 439|16@0- (1,0) [-32768|32767] "cm" SOC
 SG_ cHight_35 : 455|8@0+ (1,0) [0|255] "" SOC
 SG_ SNS_Txindex_35 : 463|8@0+ (1,0) [0|255] "" SOC
 SG_ SNS_Rxindex_35 : 471|8@0+ (1,0) [0|255] "" SOC

BO_ 2415921006 Upper_PointOutSignal_07: 64 MCU
 SG_ ObjID_36 : 7|16@0+ (1,0) [0|65535] "" SOC
 SG_ x_36 : 23|16@0- (1,0) [-32768|32767] "cm" SOC
 SG_ y_36 : 39|16@0- (1,0) [-32768|32767] "cm" SOC
 SG_ cHight_36 : 55|8@0+ (1,0) [0|255] "" SOC
 SG_ SNS_Txindex_36 : 63|8@0+ (1,0) [0|255] "" SOC
 SG_ SNS_Rxindex_36 : 71|8@0+ (1,0) [0|255] "" SOC
 SG_ ObjID_37 : 87|16@0+ (1,0) [0|65535] "" SOC
 SG_ x_37 : 103|16@0- (1,0) [-32768|32767] "cm" SOC
 SG_ y_37 : 119|16@0- (1,0) [-32768|32767] "cm" SOC
 SG_ cHight_37 : 135|8@0+ (1,0) [0|255] "" SOC
 SG_ SNS_Txindex_37 : 143|8@0+ (1,0) [0|255] "" SOC
 SG_ SNS_Rxindex_37 : 151|8@0+ (1,0) [0|255] "" SOC
 SG_ ObjID_38 : 167|16@0+ (1,0) [0|65535] "" SOC
 SG_ x_38 : 183|16@0- (1,0) [-32768|32767] "cm" SOC
 SG_ y_38 : 199|16@0- (1,0) [-32768|32767] "cm" SOC
 SG_ cHight_38 : 215|8@0+ (1,0) [0|255] "" SOC
 SG_ SNS_Txindex_38 : 223|8@0+ (1,0) [0|255] "" SOC
 SG_ SNS_Rxindex_38 : 231|8@0+ (1,0) [0|255] "" SOC
 SG_ ObjID_39 : 247|16@0+ (1,0) [0|65535] "" SOC
 SG_ x_39 : 263|16@0- (1,0) [-32768|32767] "cm" SOC
 SG_ y_39 : 279|16@0- (1,0) [-32768|32767] "cm" SOC
 SG_ cHight_39 : 295|8@0+ (1,0) [0|255] "" SOC
 SG_ SNS_Txindex_39 : 303|8@0+ (1,0) [0|255] "" SOC
 SG_ SNS_Rxindex_39 : 311|8@0+ (1,0) [0|255] "" SOC
 SG_ ObjID_40 : 327|16@0+ (1,0) [0|65535] "" SOC
 SG_ x_40 : 343|16@0- (1,0) [-32768|32767] "cm" SOC
 SG_ y_40 : 359|16@0- (1,0) [-32768|32767] "cm" SOC
 SG_ cHight_40 : 375|8@0+ (1,0) [0|255] "" SOC
 SG_ SNS_Txindex_40 : 383|8@0+ (1,0) [0|255] "" SOC
 SG_ SNS_Rxindex_40 : 391|8@0+ (1,0) [0|255] "" SOC
 SG_ ObjID_41 : 407|16@0+ (1,0) [0|65535] "" SOC
 SG_ x_41 : 423|16@0- (1,0) [-32768|32767] "cm" SOC
 SG_ y_41 : 439|16@0- (1,0) [-32768|32767] "cm" SOC
 SG_ cHight_41 : 455|8@0+ (1,0) [0|255] "" SOC
 SG_ SNS_Txindex_41 : 463|8@0+ (1,0) [0|255] "" SOC
 SG_ SNS_Rxindex_41 : 471|8@0+ (1,0) [0|255] "" SOC

BO_ 2415921007 Upper_PointOutSignal_08: 64 MCU
 SG_ ObjID_42 : 7|16@0+ (1,0) [0|65535] "" SOC
 SG_ x_42 : 23|16@0- (1,0) [-32768|32767] "cm" SOC
 SG_ y_42 : 39|16@0- (1,0) [-32768|32767] "cm" SOC
 SG_ cHight_42 : 55|8@0+ (1,0) [0|255] "" SOC
 SG_ SNS_Txindex_42 : 63|8@0+ (1,0) [0|255] "" SOC
 SG_ SNS_Rxindex_42 : 71|8@0+ (1,0) [0|255] "" SOC
 SG_ ObjID_43 : 87|16@0+ (1,0) [0|65535] "" SOC
 SG_ x_43 : 103|16@0- (1,0) [-32768|32767] "cm" SOC
 SG_ y_43 : 119|16@0- (1,0) [-32768|32767] "cm" SOC
 SG_ cHight_43 : 135|8@0+ (1,0) [0|255] "" SOC
 SG_ SNS_Txindex_43 : 143|8@0+ (1,0) [0|255] "" SOC
 SG_ SNS_Rxindex_43 : 151|8@0+ (1,0) [0|255] "" SOC
 SG_ ObjID_44 : 167|16@0+ (1,0) [0|65535] "" SOC
 SG_ x_44 : 183|16@0- (1,0) [-32768|32767] "cm" SOC
 SG_ y_44 : 199|16@0- (1,0) [-32768|32767] "cm" SOC
 SG_ cHight_44 : 215|8@0+ (1,0) [0|255] "" SOC
 SG_ SNS_Txindex_44 : 223|8@0+ (1,0) [0|255] "" SOC
 SG_ SNS_Rxindex_44 : 231|8@0+ (1,0) [0|255] "" SOC
 SG_ ObjID_45 : 247|16@0+ (1,0) [0|65535] "" SOC
 SG_ x_45 : 263|16@0- (1,0) [-32768|32767] "cm" SOC
 SG_ y_45 : 279|16@0- (1,0) [-32768|32767] "cm" SOC
 SG_ cHight_45 : 295|8@0+ (1,0) [0|255] "" SOC
 SG_ SNS_Txindex_45 : 303|8@0+ (1,0) [0|255] "" SOC
 SG_ SNS_Rxindex_45 : 311|8@0+ (1,0) [0|255] "" SOC
 SG_ ObjID_46 : 327|16@0+ (1,0) [0|65535] "" SOC
 SG_ x_46 : 343|16@0- (1,0) [-32768|32767] "cm" SOC
 SG_ y_46 : 359|16@0- (1,0) [-32768|32767] "cm" SOC
 SG_ cHight_46 : 375|8@0+ (1,0) [0|255] "" SOC
 SG_ SNS_Txindex_46 : 383|8@0+ (1,0) [0|255] "" SOC
 SG_ SNS_Rxindex_46 : 391|8@0+ (1,0) [0|255] "" SOC
 SG_ ObjID_47 : 407|16@0+ (1,0) [0|65535] "" SOC
 SG_ x_47 : 423|16@0- (1,0) [-32768|32767] "cm" SOC
 SG_ y_47 : 439|16@0- (1,0) [-32768|32767] "cm" SOC
 SG_ cHight_47 : 455|8@0+ (1,0) [0|255] "" SOC
 SG_ SNS_Txindex_47 : 463|8@0+ (1,0) [0|255] "" SOC
 SG_ SNS_Rxindex_47 : 471|8@0+ (1,0) [0|255] "" SOC

BO_ 2415921008 Upper_PointOutSignal_09: 64 MCU
 SG_ ObjID_48 : 7|16@0+ (1,0) [0|65535] "" SOC
 SG_ x_48 : 23|16@0- (1,0) [-32768|32767] "cm" SOC
 SG_ y_48 : 39|16@0- (1,0) [-32768|32767] "cm" SOC
 SG_ cHight_48 : 55|8@0+ (1,0) [0|255] "" SOC
 SG_ SNS_Txindex_48 : 63|8@0+ (1,0) [0|255] "" SOC
 SG_ SNS_Rxindex_48 : 71|8@0+ (1,0) [0|255] "" SOC
 SG_ ObjID_49 : 87|16@0+ (1,0) [0|65535] "" SOC
 SG_ x_49 : 103|16@0- (1,0) [-32768|32767] "cm" SOC
 SG_ y_49 : 119|16@0- (1,0) [-32768|32767] "cm" SOC
 SG_ cHight_49 : 135|8@0+ (1,0) [0|255] "" SOC
 SG_ SNS_Txindex_49 : 143|8@0+ (1,0) [0|255] "" SOC
 SG_ SNS_Rxindex_49 : 151|8@0+ (1,0) [0|255] "" SOC
 SG_ ObjID_50 : 167|16@0+ (1,0) [0|65535] "" SOC
 SG_ x_50 : 183|16@0- (1,0) [-32768|32767] "cm" SOC
 SG_ y_50 : 199|16@0- (1,0) [-32768|32767] "cm" SOC
 SG_ cHight_50 : 215|8@0+ (1,0) [0|255] "" SOC
 SG_ SNS_Txindex_50 : 223|8@0+ (1,0) [0|255] "" SOC
 SG_ SNS_Rxindex_50 : 231|8@0+ (1,0) [0|255] "" SOC
 SG_ ObjID_51 : 247|16@0+ (1,0) [0|65535] "" SOC
 SG_ x_51 : 263|16@0- (1,0) [-32768|32767] "cm" SOC
 SG_ y_51 : 279|16@0- (1,0) [-32768|32767] "cm" SOC
 SG_ cHight_51 : 295|8@0+ (1,0) [0|255] "" SOC
 SG_ SNS_Txindex_51 : 303|8@0+ (1,0) [0|255] "" SOC
 SG_ SNS_Rxindex_51 : 311|8@0+ (1,0) [0|255] "" SOC
 SG_ ObjID_52 : 327|16@0+ (1,0) [0|65535] "" SOC
 SG_ x_52 : 343|16@0- (1,0) [-32768|32767] "cm" SOC
 SG_ y_52 : 359|16@0- (1,0) [-32768|32767] "cm" SOC
 SG_ cHight_52 : 375|8@0+ (1,0) [0|255] "" SOC
 SG_ SNS_Txindex_52 : 383|8@0+ (1,0) [0|255] "" SOC
 SG_ SNS_Rxindex_52 : 391|8@0+ (1,0) [0|255] "" SOC
 SG_ ObjID_53 : 407|16@0+ (1,0) [0|65535] "" SOC
 SG_ x_53 : 423|16@0- (1,0) [-32768|32767] "cm" SOC
 SG_ y_53 : 439|16@0- (1,0) [-32768|32767] "cm" SOC
 SG_ cHight_53 : 455|8@0+ (1,0) [0|255] "" SOC
 SG_ SNS_Txindex_53 : 463|8@0+ (1,0) [0|255] "" SOC
 SG_ SNS_Rxindex_53 : 471|8@0+ (1,0) [0|255] "" SOC

BO_ 2415921009 Upper_PointOutSignal_10: 64 MCU
 SG_ ObjID_54 : 7|16@0+ (1,0) [0|65535] "" SOC
 SG_ x_54 : 23|16@0- (1,0) [-32768|32767] "cm" SOC
 SG_ y_54 : 39|16@0- (1,0) [-32768|32767] "cm" SOC
 SG_ cHight_54 : 55|8@0+ (1,0) [0|255] "" SOC
 SG_ SNS_Txindex_54 : 63|8@0+ (1,0) [0|255] "" SOC
 SG_ SNS_Rxindex_54 : 71|8@0+ (1,0) [0|255] "" SOC
 SG_ ObjID_55 : 87|16@0+ (1,0) [0|65535] "" SOC
 SG_ x_55 : 103|16@0- (1,0) [-32768|32767] "cm" SOC
 SG_ y_55 : 119|16@0- (1,0) [-32768|32767] "cm" SOC
 SG_ cHight_55 : 135|8@0+ (1,0) [0|255] "" SOC
 SG_ SNS_Txindex_55 : 143|8@0+ (1,0) [0|255] "" SOC
 SG_ SNS_Rxindex_55 : 151|8@0+ (1,0) [0|255] "" SOC
 SG_ ObjID_56 : 167|16@0+ (1,0) [0|65535] "" SOC
 SG_ x_56 : 183|16@0- (1,0) [-32768|32767] "cm" SOC
 SG_ y_56 : 199|16@0- (1,0) [-32768|32767] "cm" SOC
 SG_ cHight_56 : 215|8@0+ (1,0) [0|255] "" SOC
 SG_ SNS_Txindex_56 : 223|8@0+ (1,0) [0|255] "" SOC
 SG_ SNS_Rxindex_56 : 231|8@0+ (1,0) [0|255] "" SOC
 SG_ ObjID_57 : 247|16@0+ (1,0) [0|65535] "" SOC
 SG_ x_57 : 263|16@0- (1,0) [-32768|32767] "cm" SOC
 SG_ y_57 : 279|16@0- (1,0) [-32768|32767] "cm" SOC
 SG_ cHight_57 : 295|8@0+ (1,0) [0|255] "" SOC
 SG_ SNS_Txindex_57 : 303|8@0+ (1,0) [0|255] "" SOC
 SG_ SNS_Rxindex_57 : 311|8@0+ (1,0) [0|255] "" SOC
 SG_ ObjID_58 : 327|16@0+ (1,0) [0|65535] "" SOC
 SG_ x_58 : 343|16@0- (1,0) [-32768|32767] "cm" SOC
 SG_ y_58 : 359|16@0- (1,0) [-32768|32767] "cm" SOC
 SG_ cHight_58 : 375|8@0+ (1,0) [0|255] "" SOC
 SG_ SNS_Txindex_58 : 383|8@0+ (1,0) [0|255] "" SOC
 SG_ SNS_Rxindex_58 : 391|8@0+ (1,0) [0|255] "" SOC
 SG_ ObjID_59 : 407|16@0+ (1,0) [0|65535] "" SOC
 SG_ x_59 : 423|16@0- (1,0) [-32768|32767] "cm" SOC
 SG_ y_59 : 439|16@0- (1,0) [-32768|32767] "cm" SOC
 SG_ cHight_59 : 455|8@0+ (1,0) [0|255] "" SOC
 SG_ SNS_Txindex_59 : 463|8@0+ (1,0) [0|255] "" SOC
 SG_ SNS_Rxindex_59 : 471|8@0+ (1,0) [0|255] "" SOC

BO_ 2415921010 Upper_PointOutSignal_11: 64 MCU
 SG_ ObjID_60 : 7|16@0+ (1,0) [0|65535] "" SOC
 SG_ x_60 : 23|16@0- (1,0) [-32768|32767] "cm" SOC
 SG_ y_60 : 39|16@0- (1,0) [-32768|32767] "cm" SOC
 SG_ cHight_60 : 55|8@0+ (1,0) [0|255] "" SOC
 SG_ SNS_Txindex_60 : 63|8@0+ (1,0) [0|255] "" SOC
 SG_ SNS_Rxindex_60 : 71|8@0+ (1,0) [0|255] "" SOC
 SG_ ObjID_61 : 87|16@0+ (1,0) [0|65535] "" SOC
 SG_ x_61 : 103|16@0- (1,0) [-32768|32767] "cm" SOC
 SG_ y_61 : 119|16@0- (1,0) [-32768|32767] "cm" SOC
 SG_ cHight_61 : 135|8@0+ (1,0) [0|255] "" SOC
 SG_ SNS_Txindex_61 : 143|8@0+ (1,0) [0|255] "" SOC
 SG_ SNS_Rxindex_61 : 151|8@0+ (1,0) [0|255] "" SOC
 SG_ ObjID_62 : 167|16@0+ (1,0) [0|65535] "" SOC
 SG_ x_62 : 183|16@0- (1,0) [-32768|32767] "cm" SOC
 SG_ y_62 : 199|16@0- (1,0) [-32768|32767] "cm" SOC
 SG_ cHight_62 : 215|8@0+ (1,0) [0|255] "" SOC
 SG_ SNS_Txindex_62 : 223|8@0+ (1,0) [0|255] "" SOC
 SG_ SNS_Rxindex_62 : 231|8@0+ (1,0) [0|255] "" SOC
 SG_ ObjID_63 : 247|16@0+ (1,0) [0|65535] "" SOC
 SG_ x_63 : 263|16@0- (1,0) [-32768|32767] "cm" SOC
 SG_ y_63 : 279|16@0- (1,0) [-32768|32767] "cm" SOC
 SG_ cHight_63 : 295|8@0+ (1,0) [0|255] "" SOC
 SG_ SNS_Txindex_63 : 303|8@0+ (1,0) [0|255] "" SOC
 SG_ SNS_Rxindex_63 : 311|8@0+ (1,0) [0|255] "" SOC
 SG_ ObjID_64 : 327|16@0+ (1,0) [0|65535] "" SOC
 SG_ x_64 : 343|16@0- (1,0) [-32768|32767] "cm" SOC
 SG_ y_64 : 359|16@0- (1,0) [-32768|32767] "cm" SOC
 SG_ cHight_64 : 375|8@0+ (1,0) [0|255] "" SOC
 SG_ SNS_Txindex_64 : 383|8@0+ (1,0) [0|255] "" SOC
 SG_ SNS_Rxindex_64 : 391|8@0+ (1,0) [0|255] "" SOC
 SG_ ObjID_65 : 407|16@0+ (1,0) [0|65535] "" SOC
 SG_ x_65 : 423|16@0- (1,0) [-32768|32767] "cm" SOC
 SG_ y_65 : 439|16@0- (1,0) [-32768|32767] "cm" SOC
 SG_ cHight_65 : 455|8@0+ (1,0) [0|255] "" SOC
 SG_ SNS_Txindex_65 : 463|8@0+ (1,0) [0|255] "" SOC
 SG_ SNS_Rxindex_65 : 471|8@0+ (1,0) [0|255] "" SOC

BO_ 2415921011 Upper_PointOutSignal_12: 64 MCU
 SG_ ObjID_66 : 7|16@0+ (1,0) [0|65535] "" SOC
 SG_ x_66 : 23|16@0- (1,0) [-32768|32767] "cm" SOC
 SG_ y_66 : 39|16@0- (1,0) [-32768|32767] "cm" SOC
 SG_ cHight_66 : 55|8@0+ (1,0) [0|255] "" SOC
 SG_ SNS_Txindex_66 : 63|8@0+ (1,0) [0|255] "" SOC
 SG_ SNS_Rxindex_66 : 71|8@0+ (1,0) [0|255] "" SOC
 SG_ ObjID_67 : 87|16@0+ (1,0) [0|65535] "" SOC
 SG_ x_67 : 103|16@0- (1,0) [-32768|32767] "cm" SOC
 SG_ y_67 : 119|16@0- (1,0) [-32768|32767] "cm" SOC
 SG_ cHight_67 : 135|8@0+ (1,0) [0|255] "" SOC
 SG_ SNS_Txindex_67 : 143|8@0+ (1,0) [0|255] "" SOC
 SG_ SNS_Rxindex_67 : 151|8@0+ (1,0) [0|255] "" SOC
 SG_ ObjID_68 : 167|16@0+ (1,0) [0|65535] "" SOC
 SG_ x_68 : 183|16@0- (1,0) [-32768|32767] "cm" SOC
 SG_ y_68 : 199|16@0- (1,0) [-32768|32767] "cm" SOC
 SG_ cHight_68 : 215|8@0+ (1,0) [0|255] "" SOC
 SG_ SNS_Txindex_68 : 223|8@0+ (1,0) [0|255] "" SOC
 SG_ SNS_Rxindex_68 : 231|8@0+ (1,0) [0|255] "" SOC
 SG_ ObjID_69 : 247|16@0+ (1,0) [0|65535] "" SOC
 SG_ x_69 : 263|16@0- (1,0) [-32768|32767] "cm" SOC
 SG_ y_69 : 279|16@0- (1,0) [-32768|32767] "cm" SOC
 SG_ cHight_69 : 295|8@0+ (1,0) [0|255] "" SOC
 SG_ SNS_Txindex_69 : 303|8@0+ (1,0) [0|255] "" SOC
 SG_ SNS_Rxindex_69 : 311|8@0+ (1,0) [0|255] "" SOC
 SG_ ObjID_70 : 327|16@0+ (1,0) [0|65535] "" SOC
 SG_ x_70 : 343|16@0- (1,0) [-32768|32767] "cm" SOC
 SG_ y_70 : 359|16@0- (1,0) [-32768|32767] "cm" SOC
 SG_ cHight_70 : 375|8@0+ (1,0) [0|255] "" SOC
 SG_ SNS_Txindex_70 : 383|8@0+ (1,0) [0|255] "" SOC
 SG_ SNS_Rxindex_70 : 391|8@0+ (1,0) [0|255] "" SOC
 SG_ ObjID_71 : 407|16@0+ (1,0) [0|65535] "" SOC
 SG_ x_71 : 423|16@0- (1,0) [-32768|32767] "cm" SOC
 SG_ y_71 : 439|16@0- (1,0) [-32768|32767] "cm" SOC
 SG_ cHight_71 : 455|8@0+ (1,0) [0|255] "" SOC
 SG_ SNS_Txindex_71 : 463|8@0+ (1,0) [0|255] "" SOC
 SG_ SNS_Rxindex_71 : 471|8@0+ (1,0) [0|255] "" SOC

BO_ 2415921012 Upper_PointOutSignal_13: 64 MCU
 SG_ ObjID_72 : 7|16@0+ (1,0) [0|65535] "" SOC
 SG_ x_72 : 23|16@0- (1,0) [-32768|32767] "cm" SOC
 SG_ y_72 : 39|16@0- (1,0) [-32768|32767] "cm" SOC
 SG_ cHight_72 : 55|8@0+ (1,0) [0|255] "" SOC
 SG_ SNS_Txindex_72 : 63|8@0+ (1,0) [0|255] "" SOC
 SG_ SNS_Rxindex_72 : 71|8@0+ (1,0) [0|255] "" SOC
 SG_ ObjID_73 : 87|16@0+ (1,0) [0|65535] "" SOC
 SG_ x_73 : 103|16@0- (1,0) [-32768|32767] "cm" SOC
 SG_ y_73 : 119|16@0- (1,0) [-32768|32767] "cm" SOC
 SG_ cHight_73 : 135|8@0+ (1,0) [0|255] "" SOC
 SG_ SNS_Txindex_73 : 143|8@0+ (1,0) [0|255] "" SOC
 SG_ SNS_Rxindex_73 : 151|8@0+ (1,0) [0|255] "" SOC
 SG_ ObjID_74 : 167|16@0+ (1,0) [0|65535] "" SOC
 SG_ x_74 : 183|16@0- (1,0) [-32768|32767] "cm" SOC
 SG_ y_74 : 199|16@0- (1,0) [-32768|32767] "cm" SOC
 SG_ cHight_74 : 215|8@0+ (1,0) [0|255] "" SOC
 SG_ SNS_Txindex_74 : 223|8@0+ (1,0) [0|255] "" SOC
 SG_ SNS_Rxindex_74 : 231|8@0+ (1,0) [0|255] "" SOC
 SG_ ObjID_75 : 247|16@0+ (1,0) [0|65535] "" SOC
 SG_ x_75 : 263|16@0- (1,0) [-32768|32767] "cm" SOC
 SG_ y_75 : 279|16@0- (1,0) [-32768|32767] "cm" SOC
 SG_ cHight_75 : 295|8@0+ (1,0) [0|255] "" SOC
 SG_ SNS_Txindex_75 : 303|8@0+ (1,0) [0|255] "" SOC
 SG_ SNS_Rxindex_75 : 311|8@0+ (1,0) [0|255] "" SOC
 SG_ ObjID_76 : 327|16@0+ (1,0) [0|65535] "" SOC
 SG_ x_76 : 343|16@0- (1,0) [-32768|32767] "cm" SOC
 SG_ y_76 : 359|16@0- (1,0) [-32768|32767] "cm" SOC
 SG_ cHight_76 : 375|8@0+ (1,0) [0|255] "" SOC
 SG_ SNS_Txindex_76 : 383|8@0+ (1,0) [0|255] "" SOC
 SG_ SNS_Rxindex_76 : 391|8@0+ (1,0) [0|255] "" SOC
 SG_ ObjID_77 : 407|16@0+ (1,0) [0|65535] "" SOC
 SG_ x_77 : 423|16@0- (1,0) [-32768|32767] "cm" SOC
 SG_ y_77 : 439|16@0- (1,0) [-32768|32767] "cm" SOC
 SG_ cHight_77 : 455|8@0+ (1,0) [0|255] "" SOC
 SG_ SNS_Txindex_77 : 463|8@0+ (1,0) [0|255] "" SOC
 SG_ SNS_Rxindex_77 : 471|8@0+ (1,0) [0|255] "" SOC

BO_ 2415921013 Upper_PointOutSignal_14: 64 MCU
 SG_ ObjID_78 : 7|16@0+ (1,0) [0|65535] "" SOC
 SG_ x_78 : 23|16@0- (1,0) [-32768|32767] "cm" SOC
 SG_ y_78 : 39|16@0- (1,0) [-32768|32767] "cm" SOC
 SG_ cHight_78 : 55|8@0+ (1,0) [0|255] "" SOC
 SG_ SNS_Txindex_78 : 63|8@0+ (1,0) [0|255] "" SOC
 SG_ SNS_Rxindex_78 : 71|8@0+ (1,0) [0|255] "" SOC
 SG_ ObjID_79 : 87|16@0+ (1,0) [0|65535] "" SOC
 SG_ x_79 : 103|16@0- (1,0) [-32768|32767] "cm" SOC
 SG_ y_79 : 119|16@0- (1,0) [-32768|32767] "cm" SOC
 SG_ cHight_79 : 135|8@0+ (1,0) [0|255] "" SOC
 SG_ SNS_Txindex_79 : 143|8@0+ (1,0) [0|255] "" SOC
 SG_ SNS_Rxindex_79 : 151|8@0+ (1,0) [0|255] "" SOC

BO_ 2415921014 Upper_LineOutSignal_01: 64 MCU
 SG_ cNum_0 : 7|8@0+ (1,0) [0|255] "" SOC
 SG_ cHight_0 : 15|8@0+ (1,0) [0|255] "" SOC
 SG_ cObjType_0 : 23|8@0+ (1,0) [0|255] "" SOC
 SG_ wStartx_0 : 39|16@0- (1,0) [-32768|32767] "cm" SOC
 SG_ wStarty_0 : 55|16@0- (1,0) [-32768|32767] "cm" SOC
 SG_ wEndx_0 : 71|16@0- (1,0) [-32768|32767] "cm" SOC
 SG_ wEndy_0 : 87|16@0- (1,0) [-32768|32767] "cm" SOC
 SG_ wDist_0 : 103|16@0+ (1,0) [0|65535] "cm" SOC
 SG_ cNum_1 : 119|8@0+ (1,0) [0|255] "" SOC
 SG_ cHight_1 : 127|8@0+ (1,0) [0|255] "" SOC
 SG_ cObjType_1 : 135|8@0+ (1,0) [0|255] "" SOC
 SG_ wStartx_1 : 151|16@0- (1,0) [-32768|32767] "cm" SOC
 SG_ wStarty_1 : 167|16@0- (1,0) [-32768|32767] "cm" SOC
 SG_ wEndx_1 : 183|16@0- (1,0) [-32768|32767] "cm" SOC
 SG_ wEndy_1 : 199|16@0- (1,0) [-32768|32767] "cm" SOC
 SG_ wDist_1 : 215|16@0+ (1,0) [0|65535] "cm" SOC
 SG_ cNum_2 : 231|8@0+ (1,0) [0|255] "" SOC
 SG_ cHight_2 : 239|8@0+ (1,0) [0|255] "" SOC
 SG_ cObjType_2 : 247|8@0+ (1,0) [0|255] "" SOC
 SG_ wStartx_2 : 263|16@0- (1,0) [-32768|32767] "cm" SOC
 SG_ wStarty_2 : 279|16@0- (1,0) [-32768|32767] "cm" SOC
 SG_ wEndx_2 : 295|16@0- (1,0) [-32768|32767] "cm" SOC
 SG_ wEndy_2 : 311|16@0- (1,0) [-32768|32767] "cm" SOC
 SG_ wDist_2 : 327|16@0+ (1,0) [0|65535] "cm" SOC
 SG_ cNum_3 : 343|8@0+ (1,0) [0|255] "" SOC
 SG_ cHight_3 : 351|8@0+ (1,0) [0|255] "" SOC
 SG_ cObjType_3 : 359|8@0+ (1,0) [0|255] "" SOC
 SG_ wStartx_3 : 375|16@0- (1,0) [-32768|32767] "cm" SOC
 SG_ wStarty_3 : 391|16@0- (1,0) [-32768|32767] "cm" SOC
 SG_ wEndx_3 : 407|16@0- (1,0) [-32768|32767] "cm" SOC
 SG_ wEndy_3 : 423|16@0- (1,0) [-32768|32767] "cm" SOC
 SG_ wDist_3 : 439|16@0+ (1,0) [0|65535] "cm" SOC

BO_ 2415921015 Upper_LineOutSignal_02: 64 MCU
 SG_ cNum_4 : 7|8@0+ (1,0) [0|255] "" SOC
 SG_ cHight_4 : 15|8@0+ (1,0) [0|255] "" SOC
 SG_ cObjType_4 : 23|8@0+ (1,0) [0|255] "" SOC
 SG_ wStartx_4 : 39|16@0- (1,0) [-32768|32767] "cm" SOC
 SG_ wStarty_4 : 55|16@0- (1,0) [-32768|32767] "cm" SOC
 SG_ wEndx_4 : 71|16@0- (1,0) [-32768|32767] "cm" SOC
 SG_ wEndy_4 : 87|16@0- (1,0) [-32768|32767] "cm" SOC
 SG_ wDist_4 : 103|16@0+ (1,0) [0|65535] "cm" SOC
 SG_ cNum_5 : 119|8@0+ (1,0) [0|255] "" SOC
 SG_ cHight_5 : 127|8@0+ (1,0) [0|255] "" SOC
 SG_ cObjType_5 : 135|8@0+ (1,0) [0|255] "" SOC
 SG_ wStartx_5 : 151|16@0- (1,0) [-32768|32767] "cm" SOC
 SG_ wStarty_5 : 167|16@0- (1,0) [-32768|32767] "cm" SOC
 SG_ wEndx_5 : 183|16@0- (1,0) [-32768|32767] "cm" SOC
 SG_ wEndy_5 : 199|16@0- (1,0) [-32768|32767] "cm" SOC
 SG_ wDist_5 : 215|16@0+ (1,0) [0|65535] "cm" SOC
 SG_ cNum_6 : 231|8@0+ (1,0) [0|255] "" SOC
 SG_ cHight_6 : 239|8@0+ (1,0) [0|255] "" SOC
 SG_ cObjType_6 : 247|8@0+ (1,0) [0|255] "" SOC
 SG_ wStartx_6 : 263|16@0- (1,0) [-32768|32767] "cm" SOC
 SG_ wStarty_6 : 279|16@0- (1,0) [-32768|32767] "cm" SOC
 SG_ wEndx_6 : 295|16@0- (1,0) [-32768|32767] "cm" SOC
 SG_ wEndy_6 : 311|16@0- (1,0) [-32768|32767] "cm" SOC
 SG_ wDist_6 : 327|16@0+ (1,0) [0|65535] "cm" SOC
 SG_ cNum_7 : 343|8@0+ (1,0) [0|255] "" SOC
 SG_ cHight_7 : 351|8@0+ (1,0) [0|255] "" SOC
 SG_ cObjType_7 : 359|8@0+ (1,0) [0|255] "" SOC
 SG_ wStartx_7 : 375|16@0- (1,0) [-32768|32767] "cm" SOC
 SG_ wStarty_7 : 391|16@0- (1,0) [-32768|32767] "cm" SOC
 SG_ wEndx_7 : 407|16@0- (1,0) [-32768|32767] "cm" SOC
 SG_ wEndy_7 : 423|16@0- (1,0) [-32768|32767] "cm" SOC
 SG_ wDist_7 : 439|16@0+ (1,0) [0|65535] "cm" SOC

BO_ 2415921016 Upper_LineOutSignal_03: 64 MCU
 SG_ cNum_8 : 7|8@0+ (1,0) [0|255] "" SOC
 SG_ cHight_8 : 15|8@0+ (1,0) [0|255] "" SOC
 SG_ cObjType_8 : 23|8@0+ (1,0) [0|255] "" SOC
 SG_ wStartx_8 : 39|16@0- (1,0) [-32768|32767] "cm" SOC
 SG_ wStarty_8 : 55|16@0- (1,0) [-32768|32767] "cm" SOC
 SG_ wEndx_8 : 71|16@0- (1,0) [-32768|32767] "cm" SOC
 SG_ wEndy_8 : 87|16@0- (1,0) [-32768|32767] "cm" SOC
 SG_ wDist_8 : 103|16@0+ (1,0) [0|65535] "cm" SOC
 SG_ cNum_9 : 119|8@0+ (1,0) [0|255] "" SOC
 SG_ cHight_9 : 127|8@0+ (1,0) [0|255] "" SOC
 SG_ cObjType_9 : 135|8@0+ (1,0) [0|255] "" SOC
 SG_ wStartx_9 : 151|16@0- (1,0) [-32768|32767] "cm" SOC
 SG_ wStarty_9 : 167|16@0- (1,0) [-32768|32767] "cm" SOC
 SG_ wEndx_9 : 183|16@0- (1,0) [-32768|32767] "cm" SOC
 SG_ wEndy_9 : 199|16@0- (1,0) [-32768|32767] "cm" SOC
 SG_ wDist_9 : 215|16@0+ (1,0) [0|65535] "cm" SOC
 SG_ cNum_10 : 231|8@0+ (1,0) [0|255] "" SOC
 SG_ cHight_10 : 239|8@0+ (1,0) [0|255] "" SOC
 SG_ cObjType_10 : 247|8@0+ (1,0) [0|255] "" SOC
 SG_ wStartx_10 : 263|16@0- (1,0) [-32768|32767] "cm" SOC
 SG_ wStarty_10 : 279|16@0- (1,0) [-32768|32767] "cm" SOC
 SG_ wEndx_10 : 295|16@0- (1,0) [-32768|32767] "cm" SOC
 SG_ wEndy_10 : 311|16@0- (1,0) [-32768|32767] "cm" SOC
 SG_ wDist_10 : 327|16@0+ (1,0) [0|65535] "cm" SOC
 SG_ cNum_11 : 343|8@0+ (1,0) [0|255] "" SOC
 SG_ cHight_11 : 351|8@0+ (1,0) [0|255] "" SOC
 SG_ cObjType_11 : 359|8@0+ (1,0) [0|255] "" SOC
 SG_ wStartx_11 : 375|16@0- (1,0) [-32768|32767] "cm" SOC
 SG_ wStarty_11 : 391|16@0- (1,0) [-32768|32767] "cm" SOC
 SG_ wEndx_11 : 407|16@0- (1,0) [-32768|32767] "cm" SOC
 SG_ wEndy_11 : 423|16@0- (1,0) [-32768|32767] "cm" SOC
 SG_ wDist_11 : 439|16@0+ (1,0) [0|65535] "cm" SOC

BO_ 2415921017 Upper_LineOutSignal_04: 64 MCU
 SG_ cNum_12 : 7|8@0+ (1,0) [0|255] "" SOC
 SG_ cHight_12 : 15|8@0+ (1,0) [0|255] "" SOC
 SG_ cObjType_12 : 23|8@0+ (1,0) [0|255] "" SOC
 SG_ wStartx_12 : 39|16@0- (1,0) [-32768|32767] "cm" SOC
 SG_ wStarty_12 : 55|16@0- (1,0) [-32768|32767] "cm" SOC
 SG_ wEndx_12 : 71|16@0- (1,0) [-32768|32767] "cm" SOC
 SG_ wEndy_12 : 87|16@0- (1,0) [-32768|32767] "cm" SOC
 SG_ wDist_12 : 103|16@0+ (1,0) [0|65535] "cm" SOC
 SG_ cNum_13 : 119|8@0+ (1,0) [0|255] "" SOC
 SG_ cHight_13 : 127|8@0+ (1,0) [0|255] "" SOC
 SG_ cObjType_13 : 135|8@0+ (1,0) [0|255] "" SOC
 SG_ wStartx_13 : 151|16@0- (1,0) [-32768|32767] "cm" SOC
 SG_ wStarty_13 : 167|16@0- (1,0) [-32768|32767] "cm" SOC
 SG_ wEndx_13 : 183|16@0- (1,0) [-32768|32767] "cm" SOC
 SG_ wEndy_13 : 199|16@0- (1,0) [-32768|32767] "cm" SOC
 SG_ wDist_13 : 215|16@0+ (1,0) [0|65535] "cm" SOC
 SG_ cNum_14 : 231|8@0+ (1,0) [0|255] "" SOC
 SG_ cHight_14 : 239|8@0+ (1,0) [0|255] "" SOC
 SG_ cObjType_14 : 247|8@0+ (1,0) [0|255] "" SOC
 SG_ wStartx_14 : 263|16@0- (1,0) [-32768|32767] "cm" SOC
 SG_ wStarty_14 : 279|16@0- (1,0) [-32768|32767] "cm" SOC
 SG_ wEndx_14 : 295|16@0- (1,0) [-32768|32767] "cm" SOC
 SG_ wEndy_14 : 311|16@0- (1,0) [-32768|32767] "cm" SOC
 SG_ wDist_14 : 327|16@0+ (1,0) [0|65535] "cm" SOC
 SG_ cNum_15 : 343|8@0+ (1,0) [0|255] "" SOC
 SG_ cHight_15 : 351|8@0+ (1,0) [0|255] "" SOC
 SG_ cObjType_15 : 359|8@0+ (1,0) [0|255] "" SOC
 SG_ wStartx_15 : 375|16@0- (1,0) [-32768|32767] "cm" SOC
 SG_ wStarty_15 : 391|16@0- (1,0) [-32768|32767] "cm" SOC
 SG_ wEndx_15 : 407|16@0- (1,0) [-32768|32767] "cm" SOC
 SG_ wEndy_15 : 423|16@0- (1,0) [-32768|32767] "cm" SOC
 SG_ wDist_15 : 439|16@0+ (1,0) [0|65535] "cm" SOC

BO_ 2415921018 Upper_LineOutSignal_05: 64 MCU
 SG_ cNum_16 : 7|8@0+ (1,0) [0|255] "" SOC
 SG_ cHight_16 : 15|8@0+ (1,0) [0|255] "" SOC
 SG_ cObjType_16 : 23|8@0+ (1,0) [0|255] "" SOC
 SG_ wStartx_16 : 39|16@0- (1,0) [-32768|32767] "cm" SOC
 SG_ wStarty_16 : 55|16@0- (1,0) [-32768|32767] "cm" SOC
 SG_ wEndx_16 : 71|16@0- (1,0) [-32768|32767] "cm" SOC
 SG_ wEndy_16 : 87|16@0- (1,0) [-32768|32767] "cm" SOC
 SG_ wDist_16 : 103|16@0+ (1,0) [0|65535] "cm" SOC
 SG_ cNum_17 : 119|8@0+ (1,0) [0|255] "" SOC
 SG_ cHight_17 : 127|8@0+ (1,0) [0|255] "" SOC
 SG_ cObjType_17 : 135|8@0+ (1,0) [0|255] "" SOC
 SG_ wStartx_17 : 151|16@0- (1,0) [-32768|32767] "cm" SOC
 SG_ wStarty_17 : 167|16@0- (1,0) [-32768|32767] "cm" SOC
 SG_ wEndx_17 : 183|16@0- (1,0) [-32768|32767] "cm" SOC
 SG_ wEndy_17 : 199|16@0- (1,0) [-32768|32767] "cm" SOC
 SG_ wDist_17 : 215|16@0+ (1,0) [0|65535] "cm" SOC
 SG_ cNum_18 : 231|8@0+ (1,0) [0|255] "" SOC
 SG_ cHight_18 : 239|8@0+ (1,0) [0|255] "" SOC
 SG_ cObjType_18 : 247|8@0+ (1,0) [0|255] "" SOC
 SG_ wStartx_18 : 263|16@0- (1,0) [-32768|32767] "cm" SOC
 SG_ wStarty_18 : 279|16@0- (1,0) [-32768|32767] "cm" SOC
 SG_ wEndx_18 : 295|16@0- (1,0) [-32768|32767] "cm" SOC
 SG_ wEndy_18 : 311|16@0- (1,0) [-32768|32767] "cm" SOC
 SG_ wDist_18 : 327|16@0+ (1,0) [0|65535] "cm" SOC
 SG_ cNum_19 : 343|8@0+ (1,0) [0|255] "" SOC
 SG_ cHight_19 : 351|8@0+ (1,0) [0|255] "" SOC
 SG_ cObjType_19 : 359|8@0+ (1,0) [0|255] "" SOC
 SG_ wStartx_19 : 375|16@0- (1,0) [-32768|32767] "cm" SOC
 SG_ wStarty_19 : 391|16@0- (1,0) [-32768|32767] "cm" SOC
 SG_ wEndx_19 : 407|16@0- (1,0) [-32768|32767] "cm" SOC
 SG_ wEndy_19 : 423|16@0- (1,0) [-32768|32767] "cm" SOC
 SG_ wDist_19 : 439|16@0+ (1,0) [0|65535] "cm" SOC

BO_ 2415921019 Upper_StatusOutSignal: 64 MCU
 SG_ GearLever : 7|8@0+ (1,0) [0|255] "" SOC
 SG_ Temp : 23|16@0+ (1,0) [0|65535] "degC" SOC
 SG_ Speed : 39|32@0- (1,0) [-3.402823466e+38|3.402823466e+38] "km/h" SOC
 SG_ TimeStamp : 71|64@0+ (1,0) [0|18446744073709551615] "us" SOC

BO_ 2415921020 Upper_OdoOutSignal: 64 MCU
 SG_ odo_x : 7|32@0- (1,0) [-3.402823466e+38|3.402823466e+38] "mm" SOC
 SG_ odo_y : 39|32@0- (1,0) [-3.402823466e+38|3.402823466e+38] "mm" SOC
 SG_ odo_ang : 71|32@0- (1,0) [-3.402823466e+38|3.402823466e+38] "" SOC

BO_ 2415921021 Upper_RawDataOutSignal_01: 64 MCU
 SG_ samefreq_front_Cnt : 7|16@0+ (1,0) [0|65535] "" SOC
 SG_ samefreq_rear_Cnt : 23|16@0+ (1,0) [0|65535] "" SOC
 SG_ samefreq_front_Flag : 39|8@0+ (1,0) [0|255] "" SOC
 SG_ samefreq_rear_Flag : 47|8@0+ (1,0) [0|255] "" SOC
 SG_ rawdata_info_0_mode : 55|8@0+ (1,0) [0|255] "" SOC
 SG_ rawdata_info_0_de : 71|16@0+ (1,0) [0|65535] "cm" SOC
 SG_ rawdata_info_0_de_peak : 87|16@0+ (1,0) [0|65535] "" SOC
 SG_ rawdata_info_0_de_width : 103|16@0+ (1,0) [0|65535] "us" SOC
 SG_ rawdata_info_0_ce_left : 119|16@0+ (1,0) [0|65535] "cm" SOC
 SG_ rawdata_info_0_ce_left_peak : 135|16@0+ (1,0) [0|65535] "" SOC
 SG_ rawdata_info_0_ce_left_width : 151|16@0+ (1,0) [0|65535] "us" SOC
 SG_ rawdata_info_0_ce_right : 167|16@0+ (1,0) [0|65535] "cm" SOC
 SG_ rawdata_info_0_ce_right_peak : 183|16@0+ (1,0) [0|65535] "" SOC
 SG_ rawdata_info_0_ce_right_width : 199|16@0+ (1,0) [0|65535] "us" SOC
 SG_ rawdata_info_1_mode : 215|8@0+ (1,0) [0|255] "" SOC
 SG_ rawdata_info_1_de : 231|16@0+ (1,0) [0|65535] "cm" SOC
 SG_ rawdata_info_1_de_peak : 247|16@0+ (1,0) [0|65535] "" SOC
 SG_ rawdata_info_1_de_width : 263|16@0+ (1,0) [0|65535] "us" SOC
 SG_ rawdata_info_1_ce_left : 279|16@0+ (1,0) [0|65535] "cm" SOC
 SG_ rawdata_info_1_ce_left_peak : 295|16@0+ (1,0) [0|65535] "" SOC
 SG_ rawdata_info_1_ce_left_width : 311|16@0+ (1,0) [0|65535] "us" SOC
 SG_ rawdata_info_1_ce_right : 327|16@0+ (1,0) [0|65535] "cm" SOC
 SG_ rawdata_info_1_ce_right_peak : 343|16@0+ (1,0) [0|65535] "" SOC
 SG_ rawdata_info_1_ce_right_width : 359|16@0+ (1,0) [0|65535] "us" SOC

BO_ 2415921022 Upper_RawDataOutSignal_02: 64 MCU
 SG_ rawdata_info_2_mode : 7|8@0+ (1,0) [0|255] "" SOC
 SG_ rawdata_info_2_de : 23|16@0+ (1,0) [0|65535] "cm" SOC
 SG_ rawdata_info_2_de_peak : 39|16@0+ (1,0) [0|65535] "" SOC
 SG_ rawdata_info_2_de_width : 55|16@0+ (1,0) [0|65535] "us" SOC
 SG_ rawdata_info_2_ce_left : 71|16@0+ (1,0) [0|65535] "cm" SOC
 SG_ rawdata_info_2_ce_left_peak : 87|16@0+ (1,0) [0|65535] "" SOC
 SG_ rawdata_info_2_ce_left_width : 103|16@0+ (1,0) [0|65535] "us" SOC
 SG_ rawdata_info_2_ce_right : 119|16@0+ (1,0) [0|65535] "cm" SOC
 SG_ rawdata_info_2_ce_right_peak : 135|16@0+ (1,0) [0|65535] "" SOC
 SG_ rawdata_info_2_ce_right_width : 151|16@0+ (1,0) [0|65535] "us" SOC
 SG_ rawdata_info_3_mode : 167|8@0+ (1,0) [0|255] "" SOC
 SG_ rawdata_info_3_de : 183|16@0+ (1,0) [0|65535] "cm" SOC
 SG_ rawdata_info_3_de_peak : 199|16@0+ (1,0) [0|65535] "" SOC
 SG_ rawdata_info_3_de_width : 215|16@0+ (1,0) [0|65535] "us" SOC
 SG_ rawdata_info_3_ce_left : 231|16@0+ (1,0) [0|65535] "cm" SOC
 SG_ rawdata_info_3_ce_left_peak : 247|16@0+ (1,0) [0|65535] "" SOC
 SG_ rawdata_info_3_ce_left_width : 263|16@0+ (1,0) [0|65535] "us" SOC
 SG_ rawdata_info_3_ce_right : 279|16@0+ (1,0) [0|65535] "cm" SOC
 SG_ rawdata_info_3_ce_right_peak : 295|16@0+ (1,0) [0|65535] "" SOC
 SG_ rawdata_info_3_ce_right_width : 311|16@0+ (1,0) [0|65535] "us" SOC
 SG_ rawdata_info_4_mode : 327|8@0+ (1,0) [0|255] "" SOC
 SG_ rawdata_info_4_de : 343|16@0+ (1,0) [0|65535] "cm" SOC
 SG_ rawdata_info_4_de_peak : 359|16@0+ (1,0) [0|65535] "" SOC
 SG_ rawdata_info_4_de_width : 375|16@0+ (1,0) [0|65535] "us" SOC
 SG_ rawdata_info_4_ce_left : 391|16@0+ (1,0) [0|65535] "cm" SOC
 SG_ rawdata_info_4_ce_left_peak : 407|16@0+ (1,0) [0|65535] "" SOC
 SG_ rawdata_info_4_ce_left_width : 423|16@0+ (1,0) [0|65535] "us" SOC
 SG_ rawdata_info_4_ce_right : 439|16@0+ (1,0) [0|65535] "cm" SOC
 SG_ rawdata_info_4_ce_right_peak : 455|16@0+ (1,0) [0|65535] "" SOC
 SG_ rawdata_info_4_ce_right_width : 471|16@0+ (1,0) [0|65535] "us" SOC

BO_ 2415921023 Upper_RawDataOutSignal_03: 64 MCU
 SG_ rawdata_info_5_mode : 7|8@0+ (1,0) [0|255] "" SOC
 SG_ rawdata_info_5_de : 23|16@0+ (1,0) [0|65535] "cm" SOC
 SG_ rawdata_info_5_de_peak : 39|16@0+ (1,0) [0|65535] "" SOC
 SG_ rawdata_info_5_de_width : 55|16@0+ (1,0) [0|65535] "us" SOC
 SG_ rawdata_info_5_ce_left : 71|16@0+ (1,0) [0|65535] "cm" SOC
 SG_ rawdata_info_5_ce_left_peak : 87|16@0+ (1,0) [0|65535] "" SOC
 SG_ rawdata_info_5_ce_left_width : 103|16@0+ (1,0) [0|65535] "us" SOC
 SG_ rawdata_info_5_ce_right : 119|16@0+ (1,0) [0|65535] "cm" SOC
 SG_ rawdata_info_5_ce_right_peak : 135|16@0+ (1,0) [0|65535] "" SOC
 SG_ rawdata_info_5_ce_right_width : 151|16@0+ (1,0) [0|65535] "us" SOC
 SG_ rawdata_info_6_mode : 167|8@0+ (1,0) [0|255] "" SOC
 SG_ rawdata_info_6_de : 183|16@0+ (1,0) [0|65535] "cm" SOC
 SG_ rawdata_info_6_de_peak : 199|16@0+ (1,0) [0|65535] "" SOC
 SG_ rawdata_info_6_de_width : 215|16@0+ (1,0) [0|65535] "us" SOC
 SG_ rawdata_info_6_ce_left : 231|16@0+ (1,0) [0|65535] "cm" SOC
 SG_ rawdata_info_6_ce_left_peak : 247|16@0+ (1,0) [0|65535] "" SOC
 SG_ rawdata_info_6_ce_left_width : 263|16@0+ (1,0) [0|65535] "us" SOC
 SG_ rawdata_info_6_ce_right : 279|16@0+ (1,0) [0|65535] "cm" SOC
 SG_ rawdata_info_6_ce_right_peak : 295|16@0+ (1,0) [0|65535] "" SOC
 SG_ rawdata_info_6_ce_right_width : 311|16@0+ (1,0) [0|65535] "us" SOC
 SG_ rawdata_info_7_mode : 327|8@0+ (1,0) [0|255] "" SOC
 SG_ rawdata_info_7_de : 343|16@0+ (1,0) [0|65535] "cm" SOC
 SG_ rawdata_info_7_de_peak : 359|16@0+ (1,0) [0|65535] "" SOC
 SG_ rawdata_info_7_de_width : 375|16@0+ (1,0) [0|65535] "us" SOC
 SG_ rawdata_info_7_ce_left : 391|16@0+ (1,0) [0|65535] "cm" SOC
 SG_ rawdata_info_7_ce_left_peak : 407|16@0+ (1,0) [0|65535] "" SOC
 SG_ rawdata_info_7_ce_left_width : 423|16@0+ (1,0) [0|65535] "us" SOC
 SG_ rawdata_info_7_ce_right : 439|16@0+ (1,0) [0|65535] "cm" SOC
 SG_ rawdata_info_7_ce_right_peak : 455|16@0+ (1,0) [0|65535] "" SOC
 SG_ rawdata_info_7_ce_right_width : 471|16@0+ (1,0) [0|65535] "us" SOC

BO_ 2415921024 Upper_RawDataOutSignal_04: 64 MCU
 SG_ rawdata_info_8_mode : 7|8@0+ (1,0) [0|255] "" SOC
 SG_ rawdata_info_8_de : 23|16@0+ (1,0) [0|65535] "cm" SOC
 SG_ rawdata_info_8_de_peak : 39|16@0+ (1,0) [0|65535] "" SOC
 SG_ rawdata_info_8_de_width : 55|16@0+ (1,0) [0|65535] "us" SOC
 SG_ rawdata_info_8_ce_left : 71|16@0+ (1,0) [0|65535] "cm" SOC
 SG_ rawdata_info_8_ce_left_peak : 87|16@0+ (1,0) [0|65535] "" SOC
 SG_ rawdata_info_8_ce_left_width : 103|16@0+ (1,0) [0|65535] "us" SOC
 SG_ rawdata_info_8_ce_right : 119|16@0+ (1,0) [0|65535] "cm" SOC
 SG_ rawdata_info_8_ce_right_peak : 135|16@0+ (1,0) [0|65535] "" SOC
 SG_ rawdata_info_8_ce_right_width : 151|16@0+ (1,0) [0|65535] "us" SOC
 SG_ rawdata_info_9_mode : 167|8@0+ (1,0) [0|255] "" SOC
 SG_ rawdata_info_9_de : 183|16@0+ (1,0) [0|65535] "cm" SOC
 SG_ rawdata_info_9_de_peak : 199|16@0+ (1,0) [0|65535] "" SOC
 SG_ rawdata_info_9_de_width : 215|16@0+ (1,0) [0|65535] "us" SOC
 SG_ rawdata_info_9_ce_left : 231|16@0+ (1,0) [0|65535] "cm" SOC
 SG_ rawdata_info_9_ce_left_peak : 247|16@0+ (1,0) [0|65535] "" SOC
 SG_ rawdata_info_9_ce_left_width : 263|16@0+ (1,0) [0|65535] "us" SOC
 SG_ rawdata_info_9_ce_right : 279|16@0+ (1,0) [0|65535] "cm" SOC
 SG_ rawdata_info_9_ce_right_peak : 295|16@0+ (1,0) [0|65535] "" SOC
 SG_ rawdata_info_9_ce_right_width : 311|16@0+ (1,0) [0|65535] "us" SOC
 SG_ rawdata_info_10_mode : 327|8@0+ (1,0) [0|255] "" SOC
 SG_ rawdata_info_10_de : 343|16@0+ (1,0) [0|65535] "cm" SOC
 SG_ rawdata_info_10_de_peak : 359|16@0+ (1,0) [0|65535] "" SOC
 SG_ rawdata_info_10_de_width : 375|16@0+ (1,0) [0|65535] "us" SOC
 SG_ rawdata_info_10_ce_left : 391|16@0+ (1,0) [0|65535] "cm" SOC
 SG_ rawdata_info_10_ce_left_peak : 407|16@0+ (1,0) [0|65535] "" SOC
 SG_ rawdata_info_10_ce_left_width : 423|16@0+ (1,0) [0|65535] "us" SOC
 SG_ rawdata_info_10_ce_right : 439|16@0+ (1,0) [0|65535] "cm" SOC
 SG_ rawdata_info_10_ce_right_peak : 455|16@0+ (1,0) [0|65535] "" SOC
 SG_ rawdata_info_10_ce_right_width : 471|16@0+ (1,0) [0|65535] "us" SOC

BO_ 2415921025 Upper_RawDataOutSignal_05: 64 MCU
 SG_ rawdata_info_11_mode : 7|8@0+ (1,0) [0|255] "" SOC
 SG_ rawdata_info_11_de : 23|16@0+ (1,0) [0|65535] "cm" SOC
 SG_ rawdata_info_11_de_peak : 39|16@0+ (1,0) [0|65535] "" SOC
 SG_ rawdata_info_11_de_width : 55|16@0+ (1,0) [0|65535] "us" SOC
 SG_ rawdata_info_11_ce_left : 71|16@0+ (1,0) [0|65535] "cm" SOC
 SG_ rawdata_info_11_ce_left_peak : 87|16@0+ (1,0) [0|65535] "" SOC
 SG_ rawdata_info_11_ce_left_width : 103|16@0+ (1,0) [0|65535] "us" SOC
 SG_ rawdata_info_11_ce_right : 119|16@0+ (1,0) [0|65535] "cm" SOC
 SG_ rawdata_info_11_ce_right_peak : 135|16@0+ (1,0) [0|65535] "" SOC
 SG_ rawdata_info_11_ce_right_width : 151|16@0+ (1,0) [0|65535] "us" SOC

BO_ 2415921026 Upper_PDCOutSignal: 64 MCU
 SG_ pdc_sts : 7|8@0+ (1,0) [0|255] "" SOC
 SG_ front_sts : 15|8@0+ (1,0) [0|255] "" SOC
 SG_ rear_sts : 23|8@0+ (1,0) [0|255] "" SOC
 SG_ snspdc_info_0_dis : 39|16@0+ (1,0) [0|65535] "" SOC
 SG_ snspdc_info_0_range : 55|8@0+ (1,0) [0|255] "" SOC
 SG_ snspdc_info_0_fault : 63|8@0+ (1,0) [0|255] "" SOC
 SG_ snspdc_info_1_dis : 71|16@0+ (1,0) [0|65535] "" SOC
 SG_ snspdc_info_1_range : 87|8@0+ (1,0) [0|255] "" SOC
 SG_ snspdc_info_1_fault : 95|8@0+ (1,0) [0|255] "" SOC
 SG_ snspdc_info_2_dis : 103|16@0+ (1,0) [0|65535] "" SOC
 SG_ snspdc_info_2_range : 119|8@0+ (1,0) [0|255] "" SOC
 SG_ snspdc_info_2_fault : 127|8@0+ (1,0) [0|255] "" SOC
 SG_ snspdc_info_3_dis : 135|16@0+ (1,0) [0|65535] "" SOC
 SG_ snspdc_info_3_range : 151|8@0+ (1,0) [0|255] "" SOC
 SG_ snspdc_info_3_fault : 159|8@0+ (1,0) [0|255] "" SOC
 SG_ snspdc_info_4_dis : 167|16@0+ (1,0) [0|65535] "" SOC
 SG_ snspdc_info_4_range : 183|8@0+ (1,0) [0|255] "" SOC
 SG_ snspdc_info_4_fault : 191|8@0+ (1,0) [0|255] "" SOC
 SG_ snspdc_info_5_dis : 199|16@0+ (1,0) [0|65535] "" SOC
 SG_ snspdc_info_5_range : 215|8@0+ (1,0) [0|255] "" SOC
 SG_ snspdc_info_5_fault : 223|8@0+ (1,0) [0|255] "" SOC
 SG_ snspdc_info_6_dis : 231|16@0+ (1,0) [0|65535] "" SOC
 SG_ snspdc_info_6_range : 247|8@0+ (1,0) [0|255] "" SOC
 SG_ snspdc_info_6_fault : 255|8@0+ (1,0) [0|255] "" SOC
 SG_ snspdc_info_7_dis : 263|16@0+ (1,0) [0|65535] "" SOC
 SG_ snspdc_info_7_range : 279|8@0+ (1,0) [0|255] "" SOC
 SG_ snspdc_info_7_fault : 287|8@0+ (1,0) [0|255] "" SOC
 SG_ snspdc_info_8_dis : 295|16@0+ (1,0) [0|65535] "" SOC
 SG_ snspdc_info_8_range : 311|8@0+ (1,0) [0|255] "" SOC
 SG_ snspdc_info_8_fault : 319|8@0+ (1,0) [0|255] "" SOC
 SG_ snspdc_info_9_dis : 327|16@0+ (1,0) [0|65535] "" SOC
 SG_ snspdc_info_9_range : 343|8@0+ (1,0) [0|255] "" SOC
 SG_ snspdc_info_9_fault : 351|8@0+ (1,0) [0|255] "" SOC
 SG_ snspdc_info_10_dis : 359|16@0+ (1,0) [0|65535] "" SOC
 SG_ snspdc_info_10_range : 375|8@0+ (1,0) [0|255] "" SOC
 SG_ snspdc_info_10_fault : 383|8@0+ (1,0) [0|255] "" SOC
 SG_ snspdc_info_11_dis : 391|16@0+ (1,0) [0|65535] "" SOC
 SG_ snspdc_info_11_range : 407|8@0+ (1,0) [0|255] "" SOC
 SG_ snspdc_info_11_fault : 415|8@0+ (1,0) [0|255] "" SOC

CM_ BO_ 2415921000 "Packed CAN FD payload: Upper_PointOutSignal[0], Upper_PointOutSignal[1], Upper_PointOutSignal[2], Upper_PointOutSignal[3], Upper_PointOutSignal[4], Upper_PointOutSignal[5]; natural C alignment; Motorola big-endian byte order.";
CM_ BO_ 2415921001 "Packed CAN FD payload: Upper_PointOutSignal[6], Upper_PointOutSignal[7], Upper_PointOutSignal[8], Upper_PointOutSignal[9], Upper_PointOutSignal[10], Upper_PointOutSignal[11]; natural C alignment; Motorola big-endian byte order.";
CM_ BO_ 2415921002 "Packed CAN FD payload: Upper_PointOutSignal[12], Upper_PointOutSignal[13], Upper_PointOutSignal[14], Upper_PointOutSignal[15], Upper_PointOutSignal[16], Upper_PointOutSignal[17]; natural C alignment; Motorola big-endian byte order.";
CM_ BO_ 2415921003 "Packed CAN FD payload: Upper_PointOutSignal[18], Upper_PointOutSignal[19], Upper_PointOutSignal[20], Upper_PointOutSignal[21], Upper_PointOutSignal[22], Upper_PointOutSignal[23]; natural C alignment; Motorola big-endian byte order.";
CM_ BO_ 2415921004 "Packed CAN FD payload: Upper_PointOutSignal[24], Upper_PointOutSignal[25], Upper_PointOutSignal[26], Upper_PointOutSignal[27], Upper_PointOutSignal[28], Upper_PointOutSignal[29]; natural C alignment; Motorola big-endian byte order.";
CM_ BO_ 2415921005 "Packed CAN FD payload: Upper_PointOutSignal[30], Upper_PointOutSignal[31], Upper_PointOutSignal[32], Upper_PointOutSignal[33], Upper_PointOutSignal[34], Upper_PointOutSignal[35]; natural C alignment; Motorola big-endian byte order.";
CM_ BO_ 2415921006 "Packed CAN FD payload: Upper_PointOutSignal[36], Upper_PointOutSignal[37], Upper_PointOutSignal[38], Upper_PointOutSignal[39], Upper_PointOutSignal[40], Upper_PointOutSignal[41]; natural C alignment; Motorola big-endian byte order.";
CM_ BO_ 2415921007 "Packed CAN FD payload: Upper_PointOutSignal[42], Upper_PointOutSignal[43], Upper_PointOutSignal[44], Upper_PointOutSignal[45], Upper_PointOutSignal[46], Upper_PointOutSignal[47]; natural C alignment; Motorola big-endian byte order.";
CM_ BO_ 2415921008 "Packed CAN FD payload: Upper_PointOutSignal[48], Upper_PointOutSignal[49], Upper_PointOutSignal[50], Upper_PointOutSignal[51], Upper_PointOutSignal[52], Upper_PointOutSignal[53]; natural C alignment; Motorola big-endian byte order.";
CM_ BO_ 2415921009 "Packed CAN FD payload: Upper_PointOutSignal[54], Upper_PointOutSignal[55], Upper_PointOutSignal[56], Upper_PointOutSignal[57], Upper_PointOutSignal[58], Upper_PointOutSignal[59]; natural C alignment; Motorola big-endian byte order.";
CM_ BO_ 2415921010 "Packed CAN FD payload: Upper_PointOutSignal[60], Upper_PointOutSignal[61], Upper_PointOutSignal[62], Upper_PointOutSignal[63], Upper_PointOutSignal[64], Upper_PointOutSignal[65]; natural C alignment; Motorola big-endian byte order.";
CM_ BO_ 2415921011 "Packed CAN FD payload: Upper_PointOutSignal[66], Upper_PointOutSignal[67], Upper_PointOutSignal[68], Upper_PointOutSignal[69], Upper_PointOutSignal[70], Upper_PointOutSignal[71]; natural C alignment; Motorola big-endian byte order.";
CM_ BO_ 2415921012 "Packed CAN FD payload: Upper_PointOutSignal[72], Upper_PointOutSignal[73], Upper_PointOutSignal[74], Upper_PointOutSignal[75], Upper_PointOutSignal[76], Upper_PointOutSignal[77]; natural C alignment; Motorola big-endian byte order.";
CM_ BO_ 2415921013 "Packed CAN FD payload: Upper_PointOutSignal[78], Upper_PointOutSignal[79]; natural C alignment; Motorola big-endian byte order.";
CM_ BO_ 2415921014 "Packed CAN FD payload: Upper_LineOutSignal[0], Upper_LineOutSignal[1], Upper_LineOutSignal[2], Upper_LineOutSignal[3]; natural C alignment; Motorola big-endian byte order.";
CM_ BO_ 2415921015 "Packed CAN FD payload: Upper_LineOutSignal[4], Upper_LineOutSignal[5], Upper_LineOutSignal[6], Upper_LineOutSignal[7]; natural C alignment; Motorola big-endian byte order.";
CM_ BO_ 2415921016 "Packed CAN FD payload: Upper_LineOutSignal[8], Upper_LineOutSignal[9], Upper_LineOutSignal[10], Upper_LineOutSignal[11]; natural C alignment; Motorola big-endian byte order.";
CM_ BO_ 2415921017 "Packed CAN FD payload: Upper_LineOutSignal[12], Upper_LineOutSignal[13], Upper_LineOutSignal[14], Upper_LineOutSignal[15]; natural C alignment; Motorola big-endian byte order.";
CM_ BO_ 2415921018 "Packed CAN FD payload: Upper_LineOutSignal[16], Upper_LineOutSignal[17], Upper_LineOutSignal[18], Upper_LineOutSignal[19]; natural C alignment; Motorola big-endian byte order.";
CM_ BO_ 2415921019 "Packed CAN FD payload: Upper_StatusOutSignal; natural C alignment; Motorola big-endian byte order.";
CM_ BO_ 2415921020 "Packed CAN FD payload: Upper_OdoOutSignal; natural C alignment; Motorola big-endian byte order.";
CM_ BO_ 2415921021 "Packed CAN FD payload: Upper_RawDataOutSignal.Header, Upper_RawDataOutSignal.rawdata_info[0], Upper_RawDataOutSignal.rawdata_info[1]; natural C alignment; Motorola big-endian byte order.";
CM_ BO_ 2415921022 "Packed CAN FD payload: Upper_RawDataOutSignal.rawdata_info[2], Upper_RawDataOutSignal.rawdata_info[3], Upper_RawDataOutSignal.rawdata_info[4]; natural C alignment; Motorola big-endian byte order.";
CM_ BO_ 2415921023 "Packed CAN FD payload: Upper_RawDataOutSignal.rawdata_info[5], Upper_RawDataOutSignal.rawdata_info[6], Upper_RawDataOutSignal.rawdata_info[7]; natural C alignment; Motorola big-endian byte order.";
CM_ BO_ 2415921024 "Packed CAN FD payload: Upper_RawDataOutSignal.rawdata_info[8], Upper_RawDataOutSignal.rawdata_info[9], Upper_RawDataOutSignal.rawdata_info[10]; natural C alignment; Motorola big-endian byte order.";
CM_ BO_ 2415921025 "Packed CAN FD payload: Upper_RawDataOutSignal.rawdata_info[11]; natural C alignment; Motorola big-endian byte order.";
CM_ BO_ 2415921026 "Packed CAN FD payload: Upper_PDCOutSignal.Header, Upper_PDCOutSignal.snspdc_info[0], Upper_PDCOutSignal.snspdc_info[1], Upper_PDCOutSignal.snspdc_info[2], Upper_PDCOutSignal.snspdc_info[3], Upper_PDCOutSignal.snspdc_info[4], Upper_PDCOutSignal.snspdc_info[5], Upper_PDCOutSignal.snspdc_info[6], Upper_PDCOutSignal.snspdc_info[7], Upper_PDCOutSignal.snspdc_info[8], Upper_PDCOutSignal.snspdc_info[9], Upper_PDCOutSignal.snspdc_info[10], Upper_PDCOutSignal.snspdc_info[11]; natural C alignment; Motorola big-endian byte order.";
CM_ SG_ 2415921000 ObjID_0 "source row 5; Upper_PointOutSignal[0].ObjID; source type uint16";
CM_ SG_ 2415921000 x_0 "source row 6; Upper_PointOutSignal[0].x; source type int16";
CM_ SG_ 2415921000 y_0 "source row 7; Upper_PointOutSignal[0].y; source type int16";
CM_ SG_ 2415921000 cHight_0 "source row 8; Upper_PointOutSignal[0].cHight; source type uint8";
CM_ SG_ 2415921000 SNS_Txindex_0 "source row 9; Upper_PointOutSignal[0].SNS_Txindex; source type uint8";
CM_ SG_ 2415921000 SNS_Rxindex_0 "source row 10; Upper_PointOutSignal[0].SNS_Rxindex; source type uint8";
CM_ SG_ 2415921000 ObjID_1 "source row 5; Upper_PointOutSignal[1].ObjID; source type uint16";
CM_ SG_ 2415921000 x_1 "source row 6; Upper_PointOutSignal[1].x; source type int16";
CM_ SG_ 2415921000 y_1 "source row 7; Upper_PointOutSignal[1].y; source type int16";
CM_ SG_ 2415921000 cHight_1 "source row 8; Upper_PointOutSignal[1].cHight; source type uint8";
CM_ SG_ 2415921000 SNS_Txindex_1 "source row 9; Upper_PointOutSignal[1].SNS_Txindex; source type uint8";
CM_ SG_ 2415921000 SNS_Rxindex_1 "source row 10; Upper_PointOutSignal[1].SNS_Rxindex; source type uint8";
CM_ SG_ 2415921000 ObjID_2 "source row 5; Upper_PointOutSignal[2].ObjID; source type uint16";
CM_ SG_ 2415921000 x_2 "source row 6; Upper_PointOutSignal[2].x; source type int16";
CM_ SG_ 2415921000 y_2 "source row 7; Upper_PointOutSignal[2].y; source type int16";
CM_ SG_ 2415921000 cHight_2 "source row 8; Upper_PointOutSignal[2].cHight; source type uint8";
CM_ SG_ 2415921000 SNS_Txindex_2 "source row 9; Upper_PointOutSignal[2].SNS_Txindex; source type uint8";
CM_ SG_ 2415921000 SNS_Rxindex_2 "source row 10; Upper_PointOutSignal[2].SNS_Rxindex; source type uint8";
CM_ SG_ 2415921000 ObjID_3 "source row 5; Upper_PointOutSignal[3].ObjID; source type uint16";
CM_ SG_ 2415921000 x_3 "source row 6; Upper_PointOutSignal[3].x; source type int16";
CM_ SG_ 2415921000 y_3 "source row 7; Upper_PointOutSignal[3].y; source type int16";
CM_ SG_ 2415921000 cHight_3 "source row 8; Upper_PointOutSignal[3].cHight; source type uint8";
CM_ SG_ 2415921000 SNS_Txindex_3 "source row 9; Upper_PointOutSignal[3].SNS_Txindex; source type uint8";
CM_ SG_ 2415921000 SNS_Rxindex_3 "source row 10; Upper_PointOutSignal[3].SNS_Rxindex; source type uint8";
CM_ SG_ 2415921000 ObjID_4 "source row 5; Upper_PointOutSignal[4].ObjID; source type uint16";
CM_ SG_ 2415921000 x_4 "source row 6; Upper_PointOutSignal[4].x; source type int16";
CM_ SG_ 2415921000 y_4 "source row 7; Upper_PointOutSignal[4].y; source type int16";
CM_ SG_ 2415921000 cHight_4 "source row 8; Upper_PointOutSignal[4].cHight; source type uint8";
CM_ SG_ 2415921000 SNS_Txindex_4 "source row 9; Upper_PointOutSignal[4].SNS_Txindex; source type uint8";
CM_ SG_ 2415921000 SNS_Rxindex_4 "source row 10; Upper_PointOutSignal[4].SNS_Rxindex; source type uint8";
CM_ SG_ 2415921000 ObjID_5 "source row 5; Upper_PointOutSignal[5].ObjID; source type uint16";
CM_ SG_ 2415921000 x_5 "source row 6; Upper_PointOutSignal[5].x; source type int16";
CM_ SG_ 2415921000 y_5 "source row 7; Upper_PointOutSignal[5].y; source type int16";
CM_ SG_ 2415921000 cHight_5 "source row 8; Upper_PointOutSignal[5].cHight; source type uint8";
CM_ SG_ 2415921000 SNS_Txindex_5 "source row 9; Upper_PointOutSignal[5].SNS_Txindex; source type uint8";
CM_ SG_ 2415921000 SNS_Rxindex_5 "source row 10; Upper_PointOutSignal[5].SNS_Rxindex; source type uint8";
CM_ SG_ 2415921001 ObjID_6 "source row 5; Upper_PointOutSignal[6].ObjID; source type uint16";
CM_ SG_ 2415921001 x_6 "source row 6; Upper_PointOutSignal[6].x; source type int16";
CM_ SG_ 2415921001 y_6 "source row 7; Upper_PointOutSignal[6].y; source type int16";
CM_ SG_ 2415921001 cHight_6 "source row 8; Upper_PointOutSignal[6].cHight; source type uint8";
CM_ SG_ 2415921001 SNS_Txindex_6 "source row 9; Upper_PointOutSignal[6].SNS_Txindex; source type uint8";
CM_ SG_ 2415921001 SNS_Rxindex_6 "source row 10; Upper_PointOutSignal[6].SNS_Rxindex; source type uint8";
CM_ SG_ 2415921001 ObjID_7 "source row 5; Upper_PointOutSignal[7].ObjID; source type uint16";
CM_ SG_ 2415921001 x_7 "source row 6; Upper_PointOutSignal[7].x; source type int16";
CM_ SG_ 2415921001 y_7 "source row 7; Upper_PointOutSignal[7].y; source type int16";
CM_ SG_ 2415921001 cHight_7 "source row 8; Upper_PointOutSignal[7].cHight; source type uint8";
CM_ SG_ 2415921001 SNS_Txindex_7 "source row 9; Upper_PointOutSignal[7].SNS_Txindex; source type uint8";
CM_ SG_ 2415921001 SNS_Rxindex_7 "source row 10; Upper_PointOutSignal[7].SNS_Rxindex; source type uint8";
CM_ SG_ 2415921001 ObjID_8 "source row 5; Upper_PointOutSignal[8].ObjID; source type uint16";
CM_ SG_ 2415921001 x_8 "source row 6; Upper_PointOutSignal[8].x; source type int16";
CM_ SG_ 2415921001 y_8 "source row 7; Upper_PointOutSignal[8].y; source type int16";
CM_ SG_ 2415921001 cHight_8 "source row 8; Upper_PointOutSignal[8].cHight; source type uint8";
CM_ SG_ 2415921001 SNS_Txindex_8 "source row 9; Upper_PointOutSignal[8].SNS_Txindex; source type uint8";
CM_ SG_ 2415921001 SNS_Rxindex_8 "source row 10; Upper_PointOutSignal[8].SNS_Rxindex; source type uint8";
CM_ SG_ 2415921001 ObjID_9 "source row 5; Upper_PointOutSignal[9].ObjID; source type uint16";
CM_ SG_ 2415921001 x_9 "source row 6; Upper_PointOutSignal[9].x; source type int16";
CM_ SG_ 2415921001 y_9 "source row 7; Upper_PointOutSignal[9].y; source type int16";
CM_ SG_ 2415921001 cHight_9 "source row 8; Upper_PointOutSignal[9].cHight; source type uint8";
CM_ SG_ 2415921001 SNS_Txindex_9 "source row 9; Upper_PointOutSignal[9].SNS_Txindex; source type uint8";
CM_ SG_ 2415921001 SNS_Rxindex_9 "source row 10; Upper_PointOutSignal[9].SNS_Rxindex; source type uint8";
CM_ SG_ 2415921001 ObjID_10 "source row 5; Upper_PointOutSignal[10].ObjID; source type uint16";
CM_ SG_ 2415921001 x_10 "source row 6; Upper_PointOutSignal[10].x; source type int16";
CM_ SG_ 2415921001 y_10 "source row 7; Upper_PointOutSignal[10].y; source type int16";
CM_ SG_ 2415921001 cHight_10 "source row 8; Upper_PointOutSignal[10].cHight; source type uint8";
CM_ SG_ 2415921001 SNS_Txindex_10 "source row 9; Upper_PointOutSignal[10].SNS_Txindex; source type uint8";
CM_ SG_ 2415921001 SNS_Rxindex_10 "source row 10; Upper_PointOutSignal[10].SNS_Rxindex; source type uint8";
CM_ SG_ 2415921001 ObjID_11 "source row 5; Upper_PointOutSignal[11].ObjID; source type uint16";
CM_ SG_ 2415921001 x_11 "source row 6; Upper_PointOutSignal[11].x; source type int16";
CM_ SG_ 2415921001 y_11 "source row 7; Upper_PointOutSignal[11].y; source type int16";
CM_ SG_ 2415921001 cHight_11 "source row 8; Upper_PointOutSignal[11].cHight; source type uint8";
CM_ SG_ 2415921001 SNS_Txindex_11 "source row 9; Upper_PointOutSignal[11].SNS_Txindex; source type uint8";
CM_ SG_ 2415921001 SNS_Rxindex_11 "source row 10; Upper_PointOutSignal[11].SNS_Rxindex; source type uint8";
CM_ SG_ 2415921002 ObjID_12 "source row 5; Upper_PointOutSignal[12].ObjID; source type uint16";
CM_ SG_ 2415921002 x_12 "source row 6; Upper_PointOutSignal[12].x; source type int16";
CM_ SG_ 2415921002 y_12 "source row 7; Upper_PointOutSignal[12].y; source type int16";
CM_ SG_ 2415921002 cHight_12 "source row 8; Upper_PointOutSignal[12].cHight; source type uint8";
CM_ SG_ 2415921002 SNS_Txindex_12 "source row 9; Upper_PointOutSignal[12].SNS_Txindex; source type uint8";
CM_ SG_ 2415921002 SNS_Rxindex_12 "source row 10; Upper_PointOutSignal[12].SNS_Rxindex; source type uint8";
CM_ SG_ 2415921002 ObjID_13 "source row 5; Upper_PointOutSignal[13].ObjID; source type uint16";
CM_ SG_ 2415921002 x_13 "source row 6; Upper_PointOutSignal[13].x; source type int16";
CM_ SG_ 2415921002 y_13 "source row 7; Upper_PointOutSignal[13].y; source type int16";
CM_ SG_ 2415921002 cHight_13 "source row 8; Upper_PointOutSignal[13].cHight; source type uint8";
CM_ SG_ 2415921002 SNS_Txindex_13 "source row 9; Upper_PointOutSignal[13].SNS_Txindex; source type uint8";
CM_ SG_ 2415921002 SNS_Rxindex_13 "source row 10; Upper_PointOutSignal[13].SNS_Rxindex; source type uint8";
CM_ SG_ 2415921002 ObjID_14 "source row 5; Upper_PointOutSignal[14].ObjID; source type uint16";
CM_ SG_ 2415921002 x_14 "source row 6; Upper_PointOutSignal[14].x; source type int16";
CM_ SG_ 2415921002 y_14 "source row 7; Upper_PointOutSignal[14].y; source type int16";
CM_ SG_ 2415921002 cHight_14 "source row 8; Upper_PointOutSignal[14].cHight; source type uint8";
CM_ SG_ 2415921002 SNS_Txindex_14 "source row 9; Upper_PointOutSignal[14].SNS_Txindex; source type uint8";
CM_ SG_ 2415921002 SNS_Rxindex_14 "source row 10; Upper_PointOutSignal[14].SNS_Rxindex; source type uint8";
CM_ SG_ 2415921002 ObjID_15 "source row 5; Upper_PointOutSignal[15].ObjID; source type uint16";
CM_ SG_ 2415921002 x_15 "source row 6; Upper_PointOutSignal[15].x; source type int16";
CM_ SG_ 2415921002 y_15 "source row 7; Upper_PointOutSignal[15].y; source type int16";
CM_ SG_ 2415921002 cHight_15 "source row 8; Upper_PointOutSignal[15].cHight; source type uint8";
CM_ SG_ 2415921002 SNS_Txindex_15 "source row 9; Upper_PointOutSignal[15].SNS_Txindex; source type uint8";
CM_ SG_ 2415921002 SNS_Rxindex_15 "source row 10; Upper_PointOutSignal[15].SNS_Rxindex; source type uint8";
CM_ SG_ 2415921002 ObjID_16 "source row 5; Upper_PointOutSignal[16].ObjID; source type uint16";
CM_ SG_ 2415921002 x_16 "source row 6; Upper_PointOutSignal[16].x; source type int16";
CM_ SG_ 2415921002 y_16 "source row 7; Upper_PointOutSignal[16].y; source type int16";
CM_ SG_ 2415921002 cHight_16 "source row 8; Upper_PointOutSignal[16].cHight; source type uint8";
CM_ SG_ 2415921002 SNS_Txindex_16 "source row 9; Upper_PointOutSignal[16].SNS_Txindex; source type uint8";
CM_ SG_ 2415921002 SNS_Rxindex_16 "source row 10; Upper_PointOutSignal[16].SNS_Rxindex; source type uint8";
CM_ SG_ 2415921002 ObjID_17 "source row 5; Upper_PointOutSignal[17].ObjID; source type uint16";
CM_ SG_ 2415921002 x_17 "source row 6; Upper_PointOutSignal[17].x; source type int16";
CM_ SG_ 2415921002 y_17 "source row 7; Upper_PointOutSignal[17].y; source type int16";
CM_ SG_ 2415921002 cHight_17 "source row 8; Upper_PointOutSignal[17].cHight; source type uint8";
CM_ SG_ 2415921002 SNS_Txindex_17 "source row 9; Upper_PointOutSignal[17].SNS_Txindex; source type uint8";
CM_ SG_ 2415921002 SNS_Rxindex_17 "source row 10; Upper_PointOutSignal[17].SNS_Rxindex; source type uint8";
CM_ SG_ 2415921003 ObjID_18 "source row 5; Upper_PointOutSignal[18].ObjID; source type uint16";
CM_ SG_ 2415921003 x_18 "source row 6; Upper_PointOutSignal[18].x; source type int16";
CM_ SG_ 2415921003 y_18 "source row 7; Upper_PointOutSignal[18].y; source type int16";
CM_ SG_ 2415921003 cHight_18 "source row 8; Upper_PointOutSignal[18].cHight; source type uint8";
CM_ SG_ 2415921003 SNS_Txindex_18 "source row 9; Upper_PointOutSignal[18].SNS_Txindex; source type uint8";
CM_ SG_ 2415921003 SNS_Rxindex_18 "source row 10; Upper_PointOutSignal[18].SNS_Rxindex; source type uint8";
CM_ SG_ 2415921003 ObjID_19 "source row 5; Upper_PointOutSignal[19].ObjID; source type uint16";
CM_ SG_ 2415921003 x_19 "source row 6; Upper_PointOutSignal[19].x; source type int16";
CM_ SG_ 2415921003 y_19 "source row 7; Upper_PointOutSignal[19].y; source type int16";
CM_ SG_ 2415921003 cHight_19 "source row 8; Upper_PointOutSignal[19].cHight; source type uint8";
CM_ SG_ 2415921003 SNS_Txindex_19 "source row 9; Upper_PointOutSignal[19].SNS_Txindex; source type uint8";
CM_ SG_ 2415921003 SNS_Rxindex_19 "source row 10; Upper_PointOutSignal[19].SNS_Rxindex; source type uint8";
CM_ SG_ 2415921003 ObjID_20 "source row 5; Upper_PointOutSignal[20].ObjID; source type uint16";
CM_ SG_ 2415921003 x_20 "source row 6; Upper_PointOutSignal[20].x; source type int16";
CM_ SG_ 2415921003 y_20 "source row 7; Upper_PointOutSignal[20].y; source type int16";
CM_ SG_ 2415921003 cHight_20 "source row 8; Upper_PointOutSignal[20].cHight; source type uint8";
CM_ SG_ 2415921003 SNS_Txindex_20 "source row 9; Upper_PointOutSignal[20].SNS_Txindex; source type uint8";
CM_ SG_ 2415921003 SNS_Rxindex_20 "source row 10; Upper_PointOutSignal[20].SNS_Rxindex; source type uint8";
CM_ SG_ 2415921003 ObjID_21 "source row 5; Upper_PointOutSignal[21].ObjID; source type uint16";
CM_ SG_ 2415921003 x_21 "source row 6; Upper_PointOutSignal[21].x; source type int16";
CM_ SG_ 2415921003 y_21 "source row 7; Upper_PointOutSignal[21].y; source type int16";
CM_ SG_ 2415921003 cHight_21 "source row 8; Upper_PointOutSignal[21].cHight; source type uint8";
CM_ SG_ 2415921003 SNS_Txindex_21 "source row 9; Upper_PointOutSignal[21].SNS_Txindex; source type uint8";
CM_ SG_ 2415921003 SNS_Rxindex_21 "source row 10; Upper_PointOutSignal[21].SNS_Rxindex; source type uint8";
CM_ SG_ 2415921003 ObjID_22 "source row 5; Upper_PointOutSignal[22].ObjID; source type uint16";
CM_ SG_ 2415921003 x_22 "source row 6; Upper_PointOutSignal[22].x; source type int16";
CM_ SG_ 2415921003 y_22 "source row 7; Upper_PointOutSignal[22].y; source type int16";
CM_ SG_ 2415921003 cHight_22 "source row 8; Upper_PointOutSignal[22].cHight; source type uint8";
CM_ SG_ 2415921003 SNS_Txindex_22 "source row 9; Upper_PointOutSignal[22].SNS_Txindex; source type uint8";
CM_ SG_ 2415921003 SNS_Rxindex_22 "source row 10; Upper_PointOutSignal[22].SNS_Rxindex; source type uint8";
CM_ SG_ 2415921003 ObjID_23 "source row 5; Upper_PointOutSignal[23].ObjID; source type uint16";
CM_ SG_ 2415921003 x_23 "source row 6; Upper_PointOutSignal[23].x; source type int16";
CM_ SG_ 2415921003 y_23 "source row 7; Upper_PointOutSignal[23].y; source type int16";
CM_ SG_ 2415921003 cHight_23 "source row 8; Upper_PointOutSignal[23].cHight; source type uint8";
CM_ SG_ 2415921003 SNS_Txindex_23 "source row 9; Upper_PointOutSignal[23].SNS_Txindex; source type uint8";
CM_ SG_ 2415921003 SNS_Rxindex_23 "source row 10; Upper_PointOutSignal[23].SNS_Rxindex; source type uint8";
CM_ SG_ 2415921004 ObjID_24 "source row 5; Upper_PointOutSignal[24].ObjID; source type uint16";
CM_ SG_ 2415921004 x_24 "source row 6; Upper_PointOutSignal[24].x; source type int16";
CM_ SG_ 2415921004 y_24 "source row 7; Upper_PointOutSignal[24].y; source type int16";
CM_ SG_ 2415921004 cHight_24 "source row 8; Upper_PointOutSignal[24].cHight; source type uint8";
CM_ SG_ 2415921004 SNS_Txindex_24 "source row 9; Upper_PointOutSignal[24].SNS_Txindex; source type uint8";
CM_ SG_ 2415921004 SNS_Rxindex_24 "source row 10; Upper_PointOutSignal[24].SNS_Rxindex; source type uint8";
CM_ SG_ 2415921004 ObjID_25 "source row 5; Upper_PointOutSignal[25].ObjID; source type uint16";
CM_ SG_ 2415921004 x_25 "source row 6; Upper_PointOutSignal[25].x; source type int16";
CM_ SG_ 2415921004 y_25 "source row 7; Upper_PointOutSignal[25].y; source type int16";
CM_ SG_ 2415921004 cHight_25 "source row 8; Upper_PointOutSignal[25].cHight; source type uint8";
CM_ SG_ 2415921004 SNS_Txindex_25 "source row 9; Upper_PointOutSignal[25].SNS_Txindex; source type uint8";
CM_ SG_ 2415921004 SNS_Rxindex_25 "source row 10; Upper_PointOutSignal[25].SNS_Rxindex; source type uint8";
CM_ SG_ 2415921004 ObjID_26 "source row 5; Upper_PointOutSignal[26].ObjID; source type uint16";
CM_ SG_ 2415921004 x_26 "source row 6; Upper_PointOutSignal[26].x; source type int16";
CM_ SG_ 2415921004 y_26 "source row 7; Upper_PointOutSignal[26].y; source type int16";
CM_ SG_ 2415921004 cHight_26 "source row 8; Upper_PointOutSignal[26].cHight; source type uint8";
CM_ SG_ 2415921004 SNS_Txindex_26 "source row 9; Upper_PointOutSignal[26].SNS_Txindex; source type uint8";
CM_ SG_ 2415921004 SNS_Rxindex_26 "source row 10; Upper_PointOutSignal[26].SNS_Rxindex; source type uint8";
CM_ SG_ 2415921004 ObjID_27 "source row 5; Upper_PointOutSignal[27].ObjID; source type uint16";
CM_ SG_ 2415921004 x_27 "source row 6; Upper_PointOutSignal[27].x; source type int16";
CM_ SG_ 2415921004 y_27 "source row 7; Upper_PointOutSignal[27].y; source type int16";
CM_ SG_ 2415921004 cHight_27 "source row 8; Upper_PointOutSignal[27].cHight; source type uint8";
CM_ SG_ 2415921004 SNS_Txindex_27 "source row 9; Upper_PointOutSignal[27].SNS_Txindex; source type uint8";
CM_ SG_ 2415921004 SNS_Rxindex_27 "source row 10; Upper_PointOutSignal[27].SNS_Rxindex; source type uint8";
CM_ SG_ 2415921004 ObjID_28 "source row 5; Upper_PointOutSignal[28].ObjID; source type uint16";
CM_ SG_ 2415921004 x_28 "source row 6; Upper_PointOutSignal[28].x; source type int16";
CM_ SG_ 2415921004 y_28 "source row 7; Upper_PointOutSignal[28].y; source type int16";
CM_ SG_ 2415921004 cHight_28 "source row 8; Upper_PointOutSignal[28].cHight; source type uint8";
CM_ SG_ 2415921004 SNS_Txindex_28 "source row 9; Upper_PointOutSignal[28].SNS_Txindex; source type uint8";
CM_ SG_ 2415921004 SNS_Rxindex_28 "source row 10; Upper_PointOutSignal[28].SNS_Rxindex; source type uint8";
CM_ SG_ 2415921004 ObjID_29 "source row 5; Upper_PointOutSignal[29].ObjID; source type uint16";
CM_ SG_ 2415921004 x_29 "source row 6; Upper_PointOutSignal[29].x; source type int16";
CM_ SG_ 2415921004 y_29 "source row 7; Upper_PointOutSignal[29].y; source type int16";
CM_ SG_ 2415921004 cHight_29 "source row 8; Upper_PointOutSignal[29].cHight; source type uint8";
CM_ SG_ 2415921004 SNS_Txindex_29 "source row 9; Upper_PointOutSignal[29].SNS_Txindex; source type uint8";
CM_ SG_ 2415921004 SNS_Rxindex_29 "source row 10; Upper_PointOutSignal[29].SNS_Rxindex; source type uint8";
CM_ SG_ 2415921005 ObjID_30 "source row 5; Upper_PointOutSignal[30].ObjID; source type uint16";
CM_ SG_ 2415921005 x_30 "source row 6; Upper_PointOutSignal[30].x; source type int16";
CM_ SG_ 2415921005 y_30 "source row 7; Upper_PointOutSignal[30].y; source type int16";
CM_ SG_ 2415921005 cHight_30 "source row 8; Upper_PointOutSignal[30].cHight; source type uint8";
CM_ SG_ 2415921005 SNS_Txindex_30 "source row 9; Upper_PointOutSignal[30].SNS_Txindex; source type uint8";
CM_ SG_ 2415921005 SNS_Rxindex_30 "source row 10; Upper_PointOutSignal[30].SNS_Rxindex; source type uint8";
CM_ SG_ 2415921005 ObjID_31 "source row 5; Upper_PointOutSignal[31].ObjID; source type uint16";
CM_ SG_ 2415921005 x_31 "source row 6; Upper_PointOutSignal[31].x; source type int16";
CM_ SG_ 2415921005 y_31 "source row 7; Upper_PointOutSignal[31].y; source type int16";
CM_ SG_ 2415921005 cHight_31 "source row 8; Upper_PointOutSignal[31].cHight; source type uint8";
CM_ SG_ 2415921005 SNS_Txindex_31 "source row 9; Upper_PointOutSignal[31].SNS_Txindex; source type uint8";
CM_ SG_ 2415921005 SNS_Rxindex_31 "source row 10; Upper_PointOutSignal[31].SNS_Rxindex; source type uint8";
CM_ SG_ 2415921005 ObjID_32 "source row 5; Upper_PointOutSignal[32].ObjID; source type uint16";
CM_ SG_ 2415921005 x_32 "source row 6; Upper_PointOutSignal[32].x; source type int16";
CM_ SG_ 2415921005 y_32 "source row 7; Upper_PointOutSignal[32].y; source type int16";
CM_ SG_ 2415921005 cHight_32 "source row 8; Upper_PointOutSignal[32].cHight; source type uint8";
CM_ SG_ 2415921005 SNS_Txindex_32 "source row 9; Upper_PointOutSignal[32].SNS_Txindex; source type uint8";
CM_ SG_ 2415921005 SNS_Rxindex_32 "source row 10; Upper_PointOutSignal[32].SNS_Rxindex; source type uint8";
CM_ SG_ 2415921005 ObjID_33 "source row 5; Upper_PointOutSignal[33].ObjID; source type uint16";
CM_ SG_ 2415921005 x_33 "source row 6; Upper_PointOutSignal[33].x; source type int16";
CM_ SG_ 2415921005 y_33 "source row 7; Upper_PointOutSignal[33].y; source type int16";
CM_ SG_ 2415921005 cHight_33 "source row 8; Upper_PointOutSignal[33].cHight; source type uint8";
CM_ SG_ 2415921005 SNS_Txindex_33 "source row 9; Upper_PointOutSignal[33].SNS_Txindex; source type uint8";
CM_ SG_ 2415921005 SNS_Rxindex_33 "source row 10; Upper_PointOutSignal[33].SNS_Rxindex; source type uint8";
CM_ SG_ 2415921005 ObjID_34 "source row 5; Upper_PointOutSignal[34].ObjID; source type uint16";
CM_ SG_ 2415921005 x_34 "source row 6; Upper_PointOutSignal[34].x; source type int16";
CM_ SG_ 2415921005 y_34 "source row 7; Upper_PointOutSignal[34].y; source type int16";
CM_ SG_ 2415921005 cHight_34 "source row 8; Upper_PointOutSignal[34].cHight; source type uint8";
CM_ SG_ 2415921005 SNS_Txindex_34 "source row 9; Upper_PointOutSignal[34].SNS_Txindex; source type uint8";
CM_ SG_ 2415921005 SNS_Rxindex_34 "source row 10; Upper_PointOutSignal[34].SNS_Rxindex; source type uint8";
CM_ SG_ 2415921005 ObjID_35 "source row 5; Upper_PointOutSignal[35].ObjID; source type uint16";
CM_ SG_ 2415921005 x_35 "source row 6; Upper_PointOutSignal[35].x; source type int16";
CM_ SG_ 2415921005 y_35 "source row 7; Upper_PointOutSignal[35].y; source type int16";
CM_ SG_ 2415921005 cHight_35 "source row 8; Upper_PointOutSignal[35].cHight; source type uint8";
CM_ SG_ 2415921005 SNS_Txindex_35 "source row 9; Upper_PointOutSignal[35].SNS_Txindex; source type uint8";
CM_ SG_ 2415921005 SNS_Rxindex_35 "source row 10; Upper_PointOutSignal[35].SNS_Rxindex; source type uint8";
CM_ SG_ 2415921006 ObjID_36 "source row 5; Upper_PointOutSignal[36].ObjID; source type uint16";
CM_ SG_ 2415921006 x_36 "source row 6; Upper_PointOutSignal[36].x; source type int16";
CM_ SG_ 2415921006 y_36 "source row 7; Upper_PointOutSignal[36].y; source type int16";
CM_ SG_ 2415921006 cHight_36 "source row 8; Upper_PointOutSignal[36].cHight; source type uint8";
CM_ SG_ 2415921006 SNS_Txindex_36 "source row 9; Upper_PointOutSignal[36].SNS_Txindex; source type uint8";
CM_ SG_ 2415921006 SNS_Rxindex_36 "source row 10; Upper_PointOutSignal[36].SNS_Rxindex; source type uint8";
CM_ SG_ 2415921006 ObjID_37 "source row 5; Upper_PointOutSignal[37].ObjID; source type uint16";
CM_ SG_ 2415921006 x_37 "source row 6; Upper_PointOutSignal[37].x; source type int16";
CM_ SG_ 2415921006 y_37 "source row 7; Upper_PointOutSignal[37].y; source type int16";
CM_ SG_ 2415921006 cHight_37 "source row 8; Upper_PointOutSignal[37].cHight; source type uint8";
CM_ SG_ 2415921006 SNS_Txindex_37 "source row 9; Upper_PointOutSignal[37].SNS_Txindex; source type uint8";
CM_ SG_ 2415921006 SNS_Rxindex_37 "source row 10; Upper_PointOutSignal[37].SNS_Rxindex; source type uint8";
CM_ SG_ 2415921006 ObjID_38 "source row 5; Upper_PointOutSignal[38].ObjID; source type uint16";
CM_ SG_ 2415921006 x_38 "source row 6; Upper_PointOutSignal[38].x; source type int16";
CM_ SG_ 2415921006 y_38 "source row 7; Upper_PointOutSignal[38].y; source type int16";
CM_ SG_ 2415921006 cHight_38 "source row 8; Upper_PointOutSignal[38].cHight; source type uint8";
CM_ SG_ 2415921006 SNS_Txindex_38 "source row 9; Upper_PointOutSignal[38].SNS_Txindex; source type uint8";
CM_ SG_ 2415921006 SNS_Rxindex_38 "source row 10; Upper_PointOutSignal[38].SNS_Rxindex; source type uint8";
CM_ SG_ 2415921006 ObjID_39 "source row 5; Upper_PointOutSignal[39].ObjID; source type uint16";
CM_ SG_ 2415921006 x_39 "source row 6; Upper_PointOutSignal[39].x; source type int16";
CM_ SG_ 2415921006 y_39 "source row 7; Upper_PointOutSignal[39].y; source type int16";
CM_ SG_ 2415921006 cHight_39 "source row 8; Upper_PointOutSignal[39].cHight; source type uint8";
CM_ SG_ 2415921006 SNS_Txindex_39 "source row 9; Upper_PointOutSignal[39].SNS_Txindex; source type uint8";
CM_ SG_ 2415921006 SNS_Rxindex_39 "source row 10; Upper_PointOutSignal[39].SNS_Rxindex; source type uint8";
CM_ SG_ 2415921006 ObjID_40 "source row 5; Upper_PointOutSignal[40].ObjID; source type uint16";
CM_ SG_ 2415921006 x_40 "source row 6; Upper_PointOutSignal[40].x; source type int16";
CM_ SG_ 2415921006 y_40 "source row 7; Upper_PointOutSignal[40].y; source type int16";
CM_ SG_ 2415921006 cHight_40 "source row 8; Upper_PointOutSignal[40].cHight; source type uint8";
CM_ SG_ 2415921006 SNS_Txindex_40 "source row 9; Upper_PointOutSignal[40].SNS_Txindex; source type uint8";
CM_ SG_ 2415921006 SNS_Rxindex_40 "source row 10; Upper_PointOutSignal[40].SNS_Rxindex; source type uint8";
CM_ SG_ 2415921006 ObjID_41 "source row 5; Upper_PointOutSignal[41].ObjID; source type uint16";
CM_ SG_ 2415921006 x_41 "source row 6; Upper_PointOutSignal[41].x; source type int16";
CM_ SG_ 2415921006 y_41 "source row 7; Upper_PointOutSignal[41].y; source type int16";
CM_ SG_ 2415921006 cHight_41 "source row 8; Upper_PointOutSignal[41].cHight; source type uint8";
CM_ SG_ 2415921006 SNS_Txindex_41 "source row 9; Upper_PointOutSignal[41].SNS_Txindex; source type uint8";
CM_ SG_ 2415921006 SNS_Rxindex_41 "source row 10; Upper_PointOutSignal[41].SNS_Rxindex; source type uint8";
CM_ SG_ 2415921007 ObjID_42 "source row 5; Upper_PointOutSignal[42].ObjID; source type uint16";
CM_ SG_ 2415921007 x_42 "source row 6; Upper_PointOutSignal[42].x; source type int16";
CM_ SG_ 2415921007 y_42 "source row 7; Upper_PointOutSignal[42].y; source type int16";
CM_ SG_ 2415921007 cHight_42 "source row 8; Upper_PointOutSignal[42].cHight; source type uint8";
CM_ SG_ 2415921007 SNS_Txindex_42 "source row 9; Upper_PointOutSignal[42].SNS_Txindex; source type uint8";
CM_ SG_ 2415921007 SNS_Rxindex_42 "source row 10; Upper_PointOutSignal[42].SNS_Rxindex; source type uint8";
CM_ SG_ 2415921007 ObjID_43 "source row 5; Upper_PointOutSignal[43].ObjID; source type uint16";
CM_ SG_ 2415921007 x_43 "source row 6; Upper_PointOutSignal[43].x; source type int16";
CM_ SG_ 2415921007 y_43 "source row 7; Upper_PointOutSignal[43].y; source type int16";
CM_ SG_ 2415921007 cHight_43 "source row 8; Upper_PointOutSignal[43].cHight; source type uint8";
CM_ SG_ 2415921007 SNS_Txindex_43 "source row 9; Upper_PointOutSignal[43].SNS_Txindex; source type uint8";
CM_ SG_ 2415921007 SNS_Rxindex_43 "source row 10; Upper_PointOutSignal[43].SNS_Rxindex; source type uint8";
CM_ SG_ 2415921007 ObjID_44 "source row 5; Upper_PointOutSignal[44].ObjID; source type uint16";
CM_ SG_ 2415921007 x_44 "source row 6; Upper_PointOutSignal[44].x; source type int16";
CM_ SG_ 2415921007 y_44 "source row 7; Upper_PointOutSignal[44].y; source type int16";
CM_ SG_ 2415921007 cHight_44 "source row 8; Upper_PointOutSignal[44].cHight; source type uint8";
CM_ SG_ 2415921007 SNS_Txindex_44 "source row 9; Upper_PointOutSignal[44].SNS_Txindex; source type uint8";
CM_ SG_ 2415921007 SNS_Rxindex_44 "source row 10; Upper_PointOutSignal[44].SNS_Rxindex; source type uint8";
CM_ SG_ 2415921007 ObjID_45 "source row 5; Upper_PointOutSignal[45].ObjID; source type uint16";
CM_ SG_ 2415921007 x_45 "source row 6; Upper_PointOutSignal[45].x; source type int16";
CM_ SG_ 2415921007 y_45 "source row 7; Upper_PointOutSignal[45].y; source type int16";
CM_ SG_ 2415921007 cHight_45 "source row 8; Upper_PointOutSignal[45].cHight; source type uint8";
CM_ SG_ 2415921007 SNS_Txindex_45 "source row 9; Upper_PointOutSignal[45].SNS_Txindex; source type uint8";
CM_ SG_ 2415921007 SNS_Rxindex_45 "source row 10; Upper_PointOutSignal[45].SNS_Rxindex; source type uint8";
CM_ SG_ 2415921007 ObjID_46 "source row 5; Upper_PointOutSignal[46].ObjID; source type uint16";
CM_ SG_ 2415921007 x_46 "source row 6; Upper_PointOutSignal[46].x; source type int16";
CM_ SG_ 2415921007 y_46 "source row 7; Upper_PointOutSignal[46].y; source type int16";
CM_ SG_ 2415921007 cHight_46 "source row 8; Upper_PointOutSignal[46].cHight; source type uint8";
CM_ SG_ 2415921007 SNS_Txindex_46 "source row 9; Upper_PointOutSignal[46].SNS_Txindex; source type uint8";
CM_ SG_ 2415921007 SNS_Rxindex_46 "source row 10; Upper_PointOutSignal[46].SNS_Rxindex; source type uint8";
CM_ SG_ 2415921007 ObjID_47 "source row 5; Upper_PointOutSignal[47].ObjID; source type uint16";
CM_ SG_ 2415921007 x_47 "source row 6; Upper_PointOutSignal[47].x; source type int16";
CM_ SG_ 2415921007 y_47 "source row 7; Upper_PointOutSignal[47].y; source type int16";
CM_ SG_ 2415921007 cHight_47 "source row 8; Upper_PointOutSignal[47].cHight; source type uint8";
CM_ SG_ 2415921007 SNS_Txindex_47 "source row 9; Upper_PointOutSignal[47].SNS_Txindex; source type uint8";
CM_ SG_ 2415921007 SNS_Rxindex_47 "source row 10; Upper_PointOutSignal[47].SNS_Rxindex; source type uint8";
CM_ SG_ 2415921008 ObjID_48 "source row 5; Upper_PointOutSignal[48].ObjID; source type uint16";
CM_ SG_ 2415921008 x_48 "source row 6; Upper_PointOutSignal[48].x; source type int16";
CM_ SG_ 2415921008 y_48 "source row 7; Upper_PointOutSignal[48].y; source type int16";
CM_ SG_ 2415921008 cHight_48 "source row 8; Upper_PointOutSignal[48].cHight; source type uint8";
CM_ SG_ 2415921008 SNS_Txindex_48 "source row 9; Upper_PointOutSignal[48].SNS_Txindex; source type uint8";
CM_ SG_ 2415921008 SNS_Rxindex_48 "source row 10; Upper_PointOutSignal[48].SNS_Rxindex; source type uint8";
CM_ SG_ 2415921008 ObjID_49 "source row 5; Upper_PointOutSignal[49].ObjID; source type uint16";
CM_ SG_ 2415921008 x_49 "source row 6; Upper_PointOutSignal[49].x; source type int16";
CM_ SG_ 2415921008 y_49 "source row 7; Upper_PointOutSignal[49].y; source type int16";
CM_ SG_ 2415921008 cHight_49 "source row 8; Upper_PointOutSignal[49].cHight; source type uint8";
CM_ SG_ 2415921008 SNS_Txindex_49 "source row 9; Upper_PointOutSignal[49].SNS_Txindex; source type uint8";
CM_ SG_ 2415921008 SNS_Rxindex_49 "source row 10; Upper_PointOutSignal[49].SNS_Rxindex; source type uint8";
CM_ SG_ 2415921008 ObjID_50 "source row 5; Upper_PointOutSignal[50].ObjID; source type uint16";
CM_ SG_ 2415921008 x_50 "source row 6; Upper_PointOutSignal[50].x; source type int16";
CM_ SG_ 2415921008 y_50 "source row 7; Upper_PointOutSignal[50].y; source type int16";
CM_ SG_ 2415921008 cHight_50 "source row 8; Upper_PointOutSignal[50].cHight; source type uint8";
CM_ SG_ 2415921008 SNS_Txindex_50 "source row 9; Upper_PointOutSignal[50].SNS_Txindex; source type uint8";
CM_ SG_ 2415921008 SNS_Rxindex_50 "source row 10; Upper_PointOutSignal[50].SNS_Rxindex; source type uint8";
CM_ SG_ 2415921008 ObjID_51 "source row 5; Upper_PointOutSignal[51].ObjID; source type uint16";
CM_ SG_ 2415921008 x_51 "source row 6; Upper_PointOutSignal[51].x; source type int16";
CM_ SG_ 2415921008 y_51 "source row 7; Upper_PointOutSignal[51].y; source type int16";
CM_ SG_ 2415921008 cHight_51 "source row 8; Upper_PointOutSignal[51].cHight; source type uint8";
CM_ SG_ 2415921008 SNS_Txindex_51 "source row 9; Upper_PointOutSignal[51].SNS_Txindex; source type uint8";
CM_ SG_ 2415921008 SNS_Rxindex_51 "source row 10; Upper_PointOutSignal[51].SNS_Rxindex; source type uint8";
CM_ SG_ 2415921008 ObjID_52 "source row 5; Upper_PointOutSignal[52].ObjID; source type uint16";
CM_ SG_ 2415921008 x_52 "source row 6; Upper_PointOutSignal[52].x; source type int16";
CM_ SG_ 2415921008 y_52 "source row 7; Upper_PointOutSignal[52].y; source type int16";
CM_ SG_ 2415921008 cHight_52 "source row 8; Upper_PointOutSignal[52].cHight; source type uint8";
CM_ SG_ 2415921008 SNS_Txindex_52 "source row 9; Upper_PointOutSignal[52].SNS_Txindex; source type uint8";
CM_ SG_ 2415921008 SNS_Rxindex_52 "source row 10; Upper_PointOutSignal[52].SNS_Rxindex; source type uint8";
CM_ SG_ 2415921008 ObjID_53 "source row 5; Upper_PointOutSignal[53].ObjID; source type uint16";
CM_ SG_ 2415921008 x_53 "source row 6; Upper_PointOutSignal[53].x; source type int16";
CM_ SG_ 2415921008 y_53 "source row 7; Upper_PointOutSignal[53].y; source type int16";
CM_ SG_ 2415921008 cHight_53 "source row 8; Upper_PointOutSignal[53].cHight; source type uint8";
CM_ SG_ 2415921008 SNS_Txindex_53 "source row 9; Upper_PointOutSignal[53].SNS_Txindex; source type uint8";
CM_ SG_ 2415921008 SNS_Rxindex_53 "source row 10; Upper_PointOutSignal[53].SNS_Rxindex; source type uint8";
CM_ SG_ 2415921009 ObjID_54 "source row 5; Upper_PointOutSignal[54].ObjID; source type uint16";
CM_ SG_ 2415921009 x_54 "source row 6; Upper_PointOutSignal[54].x; source type int16";
CM_ SG_ 2415921009 y_54 "source row 7; Upper_PointOutSignal[54].y; source type int16";
CM_ SG_ 2415921009 cHight_54 "source row 8; Upper_PointOutSignal[54].cHight; source type uint8";
CM_ SG_ 2415921009 SNS_Txindex_54 "source row 9; Upper_PointOutSignal[54].SNS_Txindex; source type uint8";
CM_ SG_ 2415921009 SNS_Rxindex_54 "source row 10; Upper_PointOutSignal[54].SNS_Rxindex; source type uint8";
CM_ SG_ 2415921009 ObjID_55 "source row 5; Upper_PointOutSignal[55].ObjID; source type uint16";
CM_ SG_ 2415921009 x_55 "source row 6; Upper_PointOutSignal[55].x; source type int16";
CM_ SG_ 2415921009 y_55 "source row 7; Upper_PointOutSignal[55].y; source type int16";
CM_ SG_ 2415921009 cHight_55 "source row 8; Upper_PointOutSignal[55].cHight; source type uint8";
CM_ SG_ 2415921009 SNS_Txindex_55 "source row 9; Upper_PointOutSignal[55].SNS_Txindex; source type uint8";
CM_ SG_ 2415921009 SNS_Rxindex_55 "source row 10; Upper_PointOutSignal[55].SNS_Rxindex; source type uint8";
CM_ SG_ 2415921009 ObjID_56 "source row 5; Upper_PointOutSignal[56].ObjID; source type uint16";
CM_ SG_ 2415921009 x_56 "source row 6; Upper_PointOutSignal[56].x; source type int16";
CM_ SG_ 2415921009 y_56 "source row 7; Upper_PointOutSignal[56].y; source type int16";
CM_ SG_ 2415921009 cHight_56 "source row 8; Upper_PointOutSignal[56].cHight; source type uint8";
CM_ SG_ 2415921009 SNS_Txindex_56 "source row 9; Upper_PointOutSignal[56].SNS_Txindex; source type uint8";
CM_ SG_ 2415921009 SNS_Rxindex_56 "source row 10; Upper_PointOutSignal[56].SNS_Rxindex; source type uint8";
CM_ SG_ 2415921009 ObjID_57 "source row 5; Upper_PointOutSignal[57].ObjID; source type uint16";
CM_ SG_ 2415921009 x_57 "source row 6; Upper_PointOutSignal[57].x; source type int16";
CM_ SG_ 2415921009 y_57 "source row 7; Upper_PointOutSignal[57].y; source type int16";
CM_ SG_ 2415921009 cHight_57 "source row 8; Upper_PointOutSignal[57].cHight; source type uint8";
CM_ SG_ 2415921009 SNS_Txindex_57 "source row 9; Upper_PointOutSignal[57].SNS_Txindex; source type uint8";
CM_ SG_ 2415921009 SNS_Rxindex_57 "source row 10; Upper_PointOutSignal[57].SNS_Rxindex; source type uint8";
CM_ SG_ 2415921009 ObjID_58 "source row 5; Upper_PointOutSignal[58].ObjID; source type uint16";
CM_ SG_ 2415921009 x_58 "source row 6; Upper_PointOutSignal[58].x; source type int16";
CM_ SG_ 2415921009 y_58 "source row 7; Upper_PointOutSignal[58].y; source type int16";
CM_ SG_ 2415921009 cHight_58 "source row 8; Upper_PointOutSignal[58].cHight; source type uint8";
CM_ SG_ 2415921009 SNS_Txindex_58 "source row 9; Upper_PointOutSignal[58].SNS_Txindex; source type uint8";
CM_ SG_ 2415921009 SNS_Rxindex_58 "source row 10; Upper_PointOutSignal[58].SNS_Rxindex; source type uint8";
CM_ SG_ 2415921009 ObjID_59 "source row 5; Upper_PointOutSignal[59].ObjID; source type uint16";
CM_ SG_ 2415921009 x_59 "source row 6; Upper_PointOutSignal[59].x; source type int16";
CM_ SG_ 2415921009 y_59 "source row 7; Upper_PointOutSignal[59].y; source type int16";
CM_ SG_ 2415921009 cHight_59 "source row 8; Upper_PointOutSignal[59].cHight; source type uint8";
CM_ SG_ 2415921009 SNS_Txindex_59 "source row 9; Upper_PointOutSignal[59].SNS_Txindex; source type uint8";
CM_ SG_ 2415921009 SNS_Rxindex_59 "source row 10; Upper_PointOutSignal[59].SNS_Rxindex; source type uint8";
CM_ SG_ 2415921010 ObjID_60 "source row 5; Upper_PointOutSignal[60].ObjID; source type uint16";
CM_ SG_ 2415921010 x_60 "source row 6; Upper_PointOutSignal[60].x; source type int16";
CM_ SG_ 2415921010 y_60 "source row 7; Upper_PointOutSignal[60].y; source type int16";
CM_ SG_ 2415921010 cHight_60 "source row 8; Upper_PointOutSignal[60].cHight; source type uint8";
CM_ SG_ 2415921010 SNS_Txindex_60 "source row 9; Upper_PointOutSignal[60].SNS_Txindex; source type uint8";
CM_ SG_ 2415921010 SNS_Rxindex_60 "source row 10; Upper_PointOutSignal[60].SNS_Rxindex; source type uint8";
CM_ SG_ 2415921010 ObjID_61 "source row 5; Upper_PointOutSignal[61].ObjID; source type uint16";
CM_ SG_ 2415921010 x_61 "source row 6; Upper_PointOutSignal[61].x; source type int16";
CM_ SG_ 2415921010 y_61 "source row 7; Upper_PointOutSignal[61].y; source type int16";
CM_ SG_ 2415921010 cHight_61 "source row 8; Upper_PointOutSignal[61].cHight; source type uint8";
CM_ SG_ 2415921010 SNS_Txindex_61 "source row 9; Upper_PointOutSignal[61].SNS_Txindex; source type uint8";
CM_ SG_ 2415921010 SNS_Rxindex_61 "source row 10; Upper_PointOutSignal[61].SNS_Rxindex; source type uint8";
CM_ SG_ 2415921010 ObjID_62 "source row 5; Upper_PointOutSignal[62].ObjID; source type uint16";
CM_ SG_ 2415921010 x_62 "source row 6; Upper_PointOutSignal[62].x; source type int16";
CM_ SG_ 2415921010 y_62 "source row 7; Upper_PointOutSignal[62].y; source type int16";
CM_ SG_ 2415921010 cHight_62 "source row 8; Upper_PointOutSignal[62].cHight; source type uint8";
CM_ SG_ 2415921010 SNS_Txindex_62 "source row 9; Upper_PointOutSignal[62].SNS_Txindex; source type uint8";
CM_ SG_ 2415921010 SNS_Rxindex_62 "source row 10; Upper_PointOutSignal[62].SNS_Rxindex; source type uint8";
CM_ SG_ 2415921010 ObjID_63 "source row 5; Upper_PointOutSignal[63].ObjID; source type uint16";
CM_ SG_ 2415921010 x_63 "source row 6; Upper_PointOutSignal[63].x; source type int16";
CM_ SG_ 2415921010 y_63 "source row 7; Upper_PointOutSignal[63].y; source type int16";
CM_ SG_ 2415921010 cHight_63 "source row 8; Upper_PointOutSignal[63].cHight; source type uint8";
CM_ SG_ 2415921010 SNS_Txindex_63 "source row 9; Upper_PointOutSignal[63].SNS_Txindex; source type uint8";
CM_ SG_ 2415921010 SNS_Rxindex_63 "source row 10; Upper_PointOutSignal[63].SNS_Rxindex; source type uint8";
CM_ SG_ 2415921010 ObjID_64 "source row 5; Upper_PointOutSignal[64].ObjID; source type uint16";
CM_ SG_ 2415921010 x_64 "source row 6; Upper_PointOutSignal[64].x; source type int16";
CM_ SG_ 2415921010 y_64 "source row 7; Upper_PointOutSignal[64].y; source type int16";
CM_ SG_ 2415921010 cHight_64 "source row 8; Upper_PointOutSignal[64].cHight; source type uint8";
CM_ SG_ 2415921010 SNS_Txindex_64 "source row 9; Upper_PointOutSignal[64].SNS_Txindex; source type uint8";
CM_ SG_ 2415921010 SNS_Rxindex_64 "source row 10; Upper_PointOutSignal[64].SNS_Rxindex; source type uint8";
CM_ SG_ 2415921010 ObjID_65 "source row 5; Upper_PointOutSignal[65].ObjID; source type uint16";
CM_ SG_ 2415921010 x_65 "source row 6; Upper_PointOutSignal[65].x; source type int16";
CM_ SG_ 2415921010 y_65 "source row 7; Upper_PointOutSignal[65].y; source type int16";
CM_ SG_ 2415921010 cHight_65 "source row 8; Upper_PointOutSignal[65].cHight; source type uint8";
CM_ SG_ 2415921010 SNS_Txindex_65 "source row 9; Upper_PointOutSignal[65].SNS_Txindex; source type uint8";
CM_ SG_ 2415921010 SNS_Rxindex_65 "source row 10; Upper_PointOutSignal[65].SNS_Rxindex; source type uint8";
CM_ SG_ 2415921011 ObjID_66 "source row 5; Upper_PointOutSignal[66].ObjID; source type uint16";
CM_ SG_ 2415921011 x_66 "source row 6; Upper_PointOutSignal[66].x; source type int16";
CM_ SG_ 2415921011 y_66 "source row 7; Upper_PointOutSignal[66].y; source type int16";
CM_ SG_ 2415921011 cHight_66 "source row 8; Upper_PointOutSignal[66].cHight; source type uint8";
CM_ SG_ 2415921011 SNS_Txindex_66 "source row 9; Upper_PointOutSignal[66].SNS_Txindex; source type uint8";
CM_ SG_ 2415921011 SNS_Rxindex_66 "source row 10; Upper_PointOutSignal[66].SNS_Rxindex; source type uint8";
CM_ SG_ 2415921011 ObjID_67 "source row 5; Upper_PointOutSignal[67].ObjID; source type uint16";
CM_ SG_ 2415921011 x_67 "source row 6; Upper_PointOutSignal[67].x; source type int16";
CM_ SG_ 2415921011 y_67 "source row 7; Upper_PointOutSignal[67].y; source type int16";
CM_ SG_ 2415921011 cHight_67 "source row 8; Upper_PointOutSignal[67].cHight; source type uint8";
CM_ SG_ 2415921011 SNS_Txindex_67 "source row 9; Upper_PointOutSignal[67].SNS_Txindex; source type uint8";
CM_ SG_ 2415921011 SNS_Rxindex_67 "source row 10; Upper_PointOutSignal[67].SNS_Rxindex; source type uint8";
CM_ SG_ 2415921011 ObjID_68 "source row 5; Upper_PointOutSignal[68].ObjID; source type uint16";
CM_ SG_ 2415921011 x_68 "source row 6; Upper_PointOutSignal[68].x; source type int16";
CM_ SG_ 2415921011 y_68 "source row 7; Upper_PointOutSignal[68].y; source type int16";
CM_ SG_ 2415921011 cHight_68 "source row 8; Upper_PointOutSignal[68].cHight; source type uint8";
CM_ SG_ 2415921011 SNS_Txindex_68 "source row 9; Upper_PointOutSignal[68].SNS_Txindex; source type uint8";
CM_ SG_ 2415921011 SNS_Rxindex_68 "source row 10; Upper_PointOutSignal[68].SNS_Rxindex; source type uint8";
CM_ SG_ 2415921011 ObjID_69 "source row 5; Upper_PointOutSignal[69].ObjID; source type uint16";
CM_ SG_ 2415921011 x_69 "source row 6; Upper_PointOutSignal[69].x; source type int16";
CM_ SG_ 2415921011 y_69 "source row 7; Upper_PointOutSignal[69].y; source type int16";
CM_ SG_ 2415921011 cHight_69 "source row 8; Upper_PointOutSignal[69].cHight; source type uint8";
CM_ SG_ 2415921011 SNS_Txindex_69 "source row 9; Upper_PointOutSignal[69].SNS_Txindex; source type uint8";
CM_ SG_ 2415921011 SNS_Rxindex_69 "source row 10; Upper_PointOutSignal[69].SNS_Rxindex; source type uint8";
CM_ SG_ 2415921011 ObjID_70 "source row 5; Upper_PointOutSignal[70].ObjID; source type uint16";
CM_ SG_ 2415921011 x_70 "source row 6; Upper_PointOutSignal[70].x; source type int16";
CM_ SG_ 2415921011 y_70 "source row 7; Upper_PointOutSignal[70].y; source type int16";
CM_ SG_ 2415921011 cHight_70 "source row 8; Upper_PointOutSignal[70].cHight; source type uint8";
CM_ SG_ 2415921011 SNS_Txindex_70 "source row 9; Upper_PointOutSignal[70].SNS_Txindex; source type uint8";
CM_ SG_ 2415921011 SNS_Rxindex_70 "source row 10; Upper_PointOutSignal[70].SNS_Rxindex; source type uint8";
CM_ SG_ 2415921011 ObjID_71 "source row 5; Upper_PointOutSignal[71].ObjID; source type uint16";
CM_ SG_ 2415921011 x_71 "source row 6; Upper_PointOutSignal[71].x; source type int16";
CM_ SG_ 2415921011 y_71 "source row 7; Upper_PointOutSignal[71].y; source type int16";
CM_ SG_ 2415921011 cHight_71 "source row 8; Upper_PointOutSignal[71].cHight; source type uint8";
CM_ SG_ 2415921011 SNS_Txindex_71 "source row 9; Upper_PointOutSignal[71].SNS_Txindex; source type uint8";
CM_ SG_ 2415921011 SNS_Rxindex_71 "source row 10; Upper_PointOutSignal[71].SNS_Rxindex; source type uint8";
CM_ SG_ 2415921012 ObjID_72 "source row 5; Upper_PointOutSignal[72].ObjID; source type uint16";
CM_ SG_ 2415921012 x_72 "source row 6; Upper_PointOutSignal[72].x; source type int16";
CM_ SG_ 2415921012 y_72 "source row 7; Upper_PointOutSignal[72].y; source type int16";
CM_ SG_ 2415921012 cHight_72 "source row 8; Upper_PointOutSignal[72].cHight; source type uint8";
CM_ SG_ 2415921012 SNS_Txindex_72 "source row 9; Upper_PointOutSignal[72].SNS_Txindex; source type uint8";
CM_ SG_ 2415921012 SNS_Rxindex_72 "source row 10; Upper_PointOutSignal[72].SNS_Rxindex; source type uint8";
CM_ SG_ 2415921012 ObjID_73 "source row 5; Upper_PointOutSignal[73].ObjID; source type uint16";
CM_ SG_ 2415921012 x_73 "source row 6; Upper_PointOutSignal[73].x; source type int16";
CM_ SG_ 2415921012 y_73 "source row 7; Upper_PointOutSignal[73].y; source type int16";
CM_ SG_ 2415921012 cHight_73 "source row 8; Upper_PointOutSignal[73].cHight; source type uint8";
CM_ SG_ 2415921012 SNS_Txindex_73 "source row 9; Upper_PointOutSignal[73].SNS_Txindex; source type uint8";
CM_ SG_ 2415921012 SNS_Rxindex_73 "source row 10; Upper_PointOutSignal[73].SNS_Rxindex; source type uint8";
CM_ SG_ 2415921012 ObjID_74 "source row 5; Upper_PointOutSignal[74].ObjID; source type uint16";
CM_ SG_ 2415921012 x_74 "source row 6; Upper_PointOutSignal[74].x; source type int16";
CM_ SG_ 2415921012 y_74 "source row 7; Upper_PointOutSignal[74].y; source type int16";
CM_ SG_ 2415921012 cHight_74 "source row 8; Upper_PointOutSignal[74].cHight; source type uint8";
CM_ SG_ 2415921012 SNS_Txindex_74 "source row 9; Upper_PointOutSignal[74].SNS_Txindex; source type uint8";
CM_ SG_ 2415921012 SNS_Rxindex_74 "source row 10; Upper_PointOutSignal[74].SNS_Rxindex; source type uint8";
CM_ SG_ 2415921012 ObjID_75 "source row 5; Upper_PointOutSignal[75].ObjID; source type uint16";
CM_ SG_ 2415921012 x_75 "source row 6; Upper_PointOutSignal[75].x; source type int16";
CM_ SG_ 2415921012 y_75 "source row 7; Upper_PointOutSignal[75].y; source type int16";
CM_ SG_ 2415921012 cHight_75 "source row 8; Upper_PointOutSignal[75].cHight; source type uint8";
CM_ SG_ 2415921012 SNS_Txindex_75 "source row 9; Upper_PointOutSignal[75].SNS_Txindex; source type uint8";
CM_ SG_ 2415921012 SNS_Rxindex_75 "source row 10; Upper_PointOutSignal[75].SNS_Rxindex; source type uint8";
CM_ SG_ 2415921012 ObjID_76 "source row 5; Upper_PointOutSignal[76].ObjID; source type uint16";
CM_ SG_ 2415921012 x_76 "source row 6; Upper_PointOutSignal[76].x; source type int16";
CM_ SG_ 2415921012 y_76 "source row 7; Upper_PointOutSignal[76].y; source type int16";
CM_ SG_ 2415921012 cHight_76 "source row 8; Upper_PointOutSignal[76].cHight; source type uint8";
CM_ SG_ 2415921012 SNS_Txindex_76 "source row 9; Upper_PointOutSignal[76].SNS_Txindex; source type uint8";
CM_ SG_ 2415921012 SNS_Rxindex_76 "source row 10; Upper_PointOutSignal[76].SNS_Rxindex; source type uint8";
CM_ SG_ 2415921012 ObjID_77 "source row 5; Upper_PointOutSignal[77].ObjID; source type uint16";
CM_ SG_ 2415921012 x_77 "source row 6; Upper_PointOutSignal[77].x; source type int16";
CM_ SG_ 2415921012 y_77 "source row 7; Upper_PointOutSignal[77].y; source type int16";
CM_ SG_ 2415921012 cHight_77 "source row 8; Upper_PointOutSignal[77].cHight; source type uint8";
CM_ SG_ 2415921012 SNS_Txindex_77 "source row 9; Upper_PointOutSignal[77].SNS_Txindex; source type uint8";
CM_ SG_ 2415921012 SNS_Rxindex_77 "source row 10; Upper_PointOutSignal[77].SNS_Rxindex; source type uint8";
CM_ SG_ 2415921013 ObjID_78 "source row 5; Upper_PointOutSignal[78].ObjID; source type uint16";
CM_ SG_ 2415921013 x_78 "source row 6; Upper_PointOutSignal[78].x; source type int16";
CM_ SG_ 2415921013 y_78 "source row 7; Upper_PointOutSignal[78].y; source type int16";
CM_ SG_ 2415921013 cHight_78 "source row 8; Upper_PointOutSignal[78].cHight; source type uint8";
CM_ SG_ 2415921013 SNS_Txindex_78 "source row 9; Upper_PointOutSignal[78].SNS_Txindex; source type uint8";
CM_ SG_ 2415921013 SNS_Rxindex_78 "source row 10; Upper_PointOutSignal[78].SNS_Rxindex; source type uint8";
CM_ SG_ 2415921013 ObjID_79 "source row 5; Upper_PointOutSignal[79].ObjID; source type uint16";
CM_ SG_ 2415921013 x_79 "source row 6; Upper_PointOutSignal[79].x; source type int16";
CM_ SG_ 2415921013 y_79 "source row 7; Upper_PointOutSignal[79].y; source type int16";
CM_ SG_ 2415921013 cHight_79 "source row 8; Upper_PointOutSignal[79].cHight; source type uint8";
CM_ SG_ 2415921013 SNS_Txindex_79 "source row 9; Upper_PointOutSignal[79].SNS_Txindex; source type uint8";
CM_ SG_ 2415921013 SNS_Rxindex_79 "source row 10; Upper_PointOutSignal[79].SNS_Rxindex; source type uint8";
CM_ SG_ 2415921014 cNum_0 "source row 12; Upper_LineOutSignal[0].cNum; source type uint8";
CM_ SG_ 2415921014 cHight_0 "source row 13; Upper_LineOutSignal[0].cHight; source type uint8";
CM_ SG_ 2415921014 cObjType_0 "source row 14; Upper_LineOutSignal[0].cObjType; source type uint8";
CM_ SG_ 2415921014 wStartx_0 "source row 15; Upper_LineOutSignal[0].wStartx; source type int16";
CM_ SG_ 2415921014 wStarty_0 "source row 16; Upper_LineOutSignal[0].wStarty; source type int16";
CM_ SG_ 2415921014 wEndx_0 "source row 17; Upper_LineOutSignal[0].wEndx; source type int16";
CM_ SG_ 2415921014 wEndy_0 "source row 18; Upper_LineOutSignal[0].wEndy; source type int16";
CM_ SG_ 2415921014 wDist_0 "source row 19; Upper_LineOutSignal[0].wDist; source type uint16";
CM_ SG_ 2415921014 cNum_1 "source row 12; Upper_LineOutSignal[1].cNum; source type uint8";
CM_ SG_ 2415921014 cHight_1 "source row 13; Upper_LineOutSignal[1].cHight; source type uint8";
CM_ SG_ 2415921014 cObjType_1 "source row 14; Upper_LineOutSignal[1].cObjType; source type uint8";
CM_ SG_ 2415921014 wStartx_1 "source row 15; Upper_LineOutSignal[1].wStartx; source type int16";
CM_ SG_ 2415921014 wStarty_1 "source row 16; Upper_LineOutSignal[1].wStarty; source type int16";
CM_ SG_ 2415921014 wEndx_1 "source row 17; Upper_LineOutSignal[1].wEndx; source type int16";
CM_ SG_ 2415921014 wEndy_1 "source row 18; Upper_LineOutSignal[1].wEndy; source type int16";
CM_ SG_ 2415921014 wDist_1 "source row 19; Upper_LineOutSignal[1].wDist; source type uint16";
CM_ SG_ 2415921014 cNum_2 "source row 12; Upper_LineOutSignal[2].cNum; source type uint8";
CM_ SG_ 2415921014 cHight_2 "source row 13; Upper_LineOutSignal[2].cHight; source type uint8";
CM_ SG_ 2415921014 cObjType_2 "source row 14; Upper_LineOutSignal[2].cObjType; source type uint8";
CM_ SG_ 2415921014 wStartx_2 "source row 15; Upper_LineOutSignal[2].wStartx; source type int16";
CM_ SG_ 2415921014 wStarty_2 "source row 16; Upper_LineOutSignal[2].wStarty; source type int16";
CM_ SG_ 2415921014 wEndx_2 "source row 17; Upper_LineOutSignal[2].wEndx; source type int16";
CM_ SG_ 2415921014 wEndy_2 "source row 18; Upper_LineOutSignal[2].wEndy; source type int16";
CM_ SG_ 2415921014 wDist_2 "source row 19; Upper_LineOutSignal[2].wDist; source type uint16";
CM_ SG_ 2415921014 cNum_3 "source row 12; Upper_LineOutSignal[3].cNum; source type uint8";
CM_ SG_ 2415921014 cHight_3 "source row 13; Upper_LineOutSignal[3].cHight; source type uint8";
CM_ SG_ 2415921014 cObjType_3 "source row 14; Upper_LineOutSignal[3].cObjType; source type uint8";
CM_ SG_ 2415921014 wStartx_3 "source row 15; Upper_LineOutSignal[3].wStartx; source type int16";
CM_ SG_ 2415921014 wStarty_3 "source row 16; Upper_LineOutSignal[3].wStarty; source type int16";
CM_ SG_ 2415921014 wEndx_3 "source row 17; Upper_LineOutSignal[3].wEndx; source type int16";
CM_ SG_ 2415921014 wEndy_3 "source row 18; Upper_LineOutSignal[3].wEndy; source type int16";
CM_ SG_ 2415921014 wDist_3 "source row 19; Upper_LineOutSignal[3].wDist; source type uint16";
CM_ SG_ 2415921015 cNum_4 "source row 12; Upper_LineOutSignal[4].cNum; source type uint8";
CM_ SG_ 2415921015 cHight_4 "source row 13; Upper_LineOutSignal[4].cHight; source type uint8";
CM_ SG_ 2415921015 cObjType_4 "source row 14; Upper_LineOutSignal[4].cObjType; source type uint8";
CM_ SG_ 2415921015 wStartx_4 "source row 15; Upper_LineOutSignal[4].wStartx; source type int16";
CM_ SG_ 2415921015 wStarty_4 "source row 16; Upper_LineOutSignal[4].wStarty; source type int16";
CM_ SG_ 2415921015 wEndx_4 "source row 17; Upper_LineOutSignal[4].wEndx; source type int16";
CM_ SG_ 2415921015 wEndy_4 "source row 18; Upper_LineOutSignal[4].wEndy; source type int16";
CM_ SG_ 2415921015 wDist_4 "source row 19; Upper_LineOutSignal[4].wDist; source type uint16";
CM_ SG_ 2415921015 cNum_5 "source row 12; Upper_LineOutSignal[5].cNum; source type uint8";
CM_ SG_ 2415921015 cHight_5 "source row 13; Upper_LineOutSignal[5].cHight; source type uint8";
CM_ SG_ 2415921015 cObjType_5 "source row 14; Upper_LineOutSignal[5].cObjType; source type uint8";
CM_ SG_ 2415921015 wStartx_5 "source row 15; Upper_LineOutSignal[5].wStartx; source type int16";
CM_ SG_ 2415921015 wStarty_5 "source row 16; Upper_LineOutSignal[5].wStarty; source type int16";
CM_ SG_ 2415921015 wEndx_5 "source row 17; Upper_LineOutSignal[5].wEndx; source type int16";
CM_ SG_ 2415921015 wEndy_5 "source row 18; Upper_LineOutSignal[5].wEndy; source type int16";
CM_ SG_ 2415921015 wDist_5 "source row 19; Upper_LineOutSignal[5].wDist; source type uint16";
CM_ SG_ 2415921015 cNum_6 "source row 12; Upper_LineOutSignal[6].cNum; source type uint8";
CM_ SG_ 2415921015 cHight_6 "source row 13; Upper_LineOutSignal[6].cHight; source type uint8";
CM_ SG_ 2415921015 cObjType_6 "source row 14; Upper_LineOutSignal[6].cObjType; source type uint8";
CM_ SG_ 2415921015 wStartx_6 "source row 15; Upper_LineOutSignal[6].wStartx; source type int16";
CM_ SG_ 2415921015 wStarty_6 "source row 16; Upper_LineOutSignal[6].wStarty; source type int16";
CM_ SG_ 2415921015 wEndx_6 "source row 17; Upper_LineOutSignal[6].wEndx; source type int16";
CM_ SG_ 2415921015 wEndy_6 "source row 18; Upper_LineOutSignal[6].wEndy; source type int16";
CM_ SG_ 2415921015 wDist_6 "source row 19; Upper_LineOutSignal[6].wDist; source type uint16";
CM_ SG_ 2415921015 cNum_7 "source row 12; Upper_LineOutSignal[7].cNum; source type uint8";
CM_ SG_ 2415921015 cHight_7 "source row 13; Upper_LineOutSignal[7].cHight; source type uint8";
CM_ SG_ 2415921015 cObjType_7 "source row 14; Upper_LineOutSignal[7].cObjType; source type uint8";
CM_ SG_ 2415921015 wStartx_7 "source row 15; Upper_LineOutSignal[7].wStartx; source type int16";
CM_ SG_ 2415921015 wStarty_7 "source row 16; Upper_LineOutSignal[7].wStarty; source type int16";
CM_ SG_ 2415921015 wEndx_7 "source row 17; Upper_LineOutSignal[7].wEndx; source type int16";
CM_ SG_ 2415921015 wEndy_7 "source row 18; Upper_LineOutSignal[7].wEndy; source type int16";
CM_ SG_ 2415921015 wDist_7 "source row 19; Upper_LineOutSignal[7].wDist; source type uint16";
CM_ SG_ 2415921016 cNum_8 "source row 12; Upper_LineOutSignal[8].cNum; source type uint8";
CM_ SG_ 2415921016 cHight_8 "source row 13; Upper_LineOutSignal[8].cHight; source type uint8";
CM_ SG_ 2415921016 cObjType_8 "source row 14; Upper_LineOutSignal[8].cObjType; source type uint8";
CM_ SG_ 2415921016 wStartx_8 "source row 15; Upper_LineOutSignal[8].wStartx; source type int16";
CM_ SG_ 2415921016 wStarty_8 "source row 16; Upper_LineOutSignal[8].wStarty; source type int16";
CM_ SG_ 2415921016 wEndx_8 "source row 17; Upper_LineOutSignal[8].wEndx; source type int16";
CM_ SG_ 2415921016 wEndy_8 "source row 18; Upper_LineOutSignal[8].wEndy; source type int16";
CM_ SG_ 2415921016 wDist_8 "source row 19; Upper_LineOutSignal[8].wDist; source type uint16";
CM_ SG_ 2415921016 cNum_9 "source row 12; Upper_LineOutSignal[9].cNum; source type uint8";
CM_ SG_ 2415921016 cHight_9 "source row 13; Upper_LineOutSignal[9].cHight; source type uint8";
CM_ SG_ 2415921016 cObjType_9 "source row 14; Upper_LineOutSignal[9].cObjType; source type uint8";
CM_ SG_ 2415921016 wStartx_9 "source row 15; Upper_LineOutSignal[9].wStartx; source type int16";
CM_ SG_ 2415921016 wStarty_9 "source row 16; Upper_LineOutSignal[9].wStarty; source type int16";
CM_ SG_ 2415921016 wEndx_9 "source row 17; Upper_LineOutSignal[9].wEndx; source type int16";
CM_ SG_ 2415921016 wEndy_9 "source row 18; Upper_LineOutSignal[9].wEndy; source type int16";
CM_ SG_ 2415921016 wDist_9 "source row 19; Upper_LineOutSignal[9].wDist; source type uint16";
CM_ SG_ 2415921016 cNum_10 "source row 12; Upper_LineOutSignal[10].cNum; source type uint8";
CM_ SG_ 2415921016 cHight_10 "source row 13; Upper_LineOutSignal[10].cHight; source type uint8";
CM_ SG_ 2415921016 cObjType_10 "source row 14; Upper_LineOutSignal[10].cObjType; source type uint8";
CM_ SG_ 2415921016 wStartx_10 "source row 15; Upper_LineOutSignal[10].wStartx; source type int16";
CM_ SG_ 2415921016 wStarty_10 "source row 16; Upper_LineOutSignal[10].wStarty; source type int16";
CM_ SG_ 2415921016 wEndx_10 "source row 17; Upper_LineOutSignal[10].wEndx; source type int16";
CM_ SG_ 2415921016 wEndy_10 "source row 18; Upper_LineOutSignal[10].wEndy; source type int16";
CM_ SG_ 2415921016 wDist_10 "source row 19; Upper_LineOutSignal[10].wDist; source type uint16";
CM_ SG_ 2415921016 cNum_11 "source row 12; Upper_LineOutSignal[11].cNum; source type uint8";
CM_ SG_ 2415921016 cHight_11 "source row 13; Upper_LineOutSignal[11].cHight; source type uint8";
CM_ SG_ 2415921016 cObjType_11 "source row 14; Upper_LineOutSignal[11].cObjType; source type uint8";
CM_ SG_ 2415921016 wStartx_11 "source row 15; Upper_LineOutSignal[11].wStartx; source type int16";
CM_ SG_ 2415921016 wStarty_11 "source row 16; Upper_LineOutSignal[11].wStarty; source type int16";
CM_ SG_ 2415921016 wEndx_11 "source row 17; Upper_LineOutSignal[11].wEndx; source type int16";
CM_ SG_ 2415921016 wEndy_11 "source row 18; Upper_LineOutSignal[11].wEndy; source type int16";
CM_ SG_ 2415921016 wDist_11 "source row 19; Upper_LineOutSignal[11].wDist; source type uint16";
CM_ SG_ 2415921017 cNum_12 "source row 12; Upper_LineOutSignal[12].cNum; source type uint8";
CM_ SG_ 2415921017 cHight_12 "source row 13; Upper_LineOutSignal[12].cHight; source type uint8";
CM_ SG_ 2415921017 cObjType_12 "source row 14; Upper_LineOutSignal[12].cObjType; source type uint8";
CM_ SG_ 2415921017 wStartx_12 "source row 15; Upper_LineOutSignal[12].wStartx; source type int16";
CM_ SG_ 2415921017 wStarty_12 "source row 16; Upper_LineOutSignal[12].wStarty; source type int16";
CM_ SG_ 2415921017 wEndx_12 "source row 17; Upper_LineOutSignal[12].wEndx; source type int16";
CM_ SG_ 2415921017 wEndy_12 "source row 18; Upper_LineOutSignal[12].wEndy; source type int16";
CM_ SG_ 2415921017 wDist_12 "source row 19; Upper_LineOutSignal[12].wDist; source type uint16";
CM_ SG_ 2415921017 cNum_13 "source row 12; Upper_LineOutSignal[13].cNum; source type uint8";
CM_ SG_ 2415921017 cHight_13 "source row 13; Upper_LineOutSignal[13].cHight; source type uint8";
CM_ SG_ 2415921017 cObjType_13 "source row 14; Upper_LineOutSignal[13].cObjType; source type uint8";
CM_ SG_ 2415921017 wStartx_13 "source row 15; Upper_LineOutSignal[13].wStartx; source type int16";
CM_ SG_ 2415921017 wStarty_13 "source row 16; Upper_LineOutSignal[13].wStarty; source type int16";
CM_ SG_ 2415921017 wEndx_13 "source row 17; Upper_LineOutSignal[13].wEndx; source type int16";
CM_ SG_ 2415921017 wEndy_13 "source row 18; Upper_LineOutSignal[13].wEndy; source type int16";
CM_ SG_ 2415921017 wDist_13 "source row 19; Upper_LineOutSignal[13].wDist; source type uint16";
CM_ SG_ 2415921017 cNum_14 "source row 12; Upper_LineOutSignal[14].cNum; source type uint8";
CM_ SG_ 2415921017 cHight_14 "source row 13; Upper_LineOutSignal[14].cHight; source type uint8";
CM_ SG_ 2415921017 cObjType_14 "source row 14; Upper_LineOutSignal[14].cObjType; source type uint8";
CM_ SG_ 2415921017 wStartx_14 "source row 15; Upper_LineOutSignal[14].wStartx; source type int16";
CM_ SG_ 2415921017 wStarty_14 "source row 16; Upper_LineOutSignal[14].wStarty; source type int16";
CM_ SG_ 2415921017 wEndx_14 "source row 17; Upper_LineOutSignal[14].wEndx; source type int16";
CM_ SG_ 2415921017 wEndy_14 "source row 18; Upper_LineOutSignal[14].wEndy; source type int16";
CM_ SG_ 2415921017 wDist_14 "source row 19; Upper_LineOutSignal[14].wDist; source type uint16";
CM_ SG_ 2415921017 cNum_15 "source row 12; Upper_LineOutSignal[15].cNum; source type uint8";
CM_ SG_ 2415921017 cHight_15 "source row 13; Upper_LineOutSignal[15].cHight; source type uint8";
CM_ SG_ 2415921017 cObjType_15 "source row 14; Upper_LineOutSignal[15].cObjType; source type uint8";
CM_ SG_ 2415921017 wStartx_15 "source row 15; Upper_LineOutSignal[15].wStartx; source type int16";
CM_ SG_ 2415921017 wStarty_15 "source row 16; Upper_LineOutSignal[15].wStarty; source type int16";
CM_ SG_ 2415921017 wEndx_15 "source row 17; Upper_LineOutSignal[15].wEndx; source type int16";
CM_ SG_ 2415921017 wEndy_15 "source row 18; Upper_LineOutSignal[15].wEndy; source type int16";
CM_ SG_ 2415921017 wDist_15 "source row 19; Upper_LineOutSignal[15].wDist; source type uint16";
CM_ SG_ 2415921018 cNum_16 "source row 12; Upper_LineOutSignal[16].cNum; source type uint8";
CM_ SG_ 2415921018 cHight_16 "source row 13; Upper_LineOutSignal[16].cHight; source type uint8";
CM_ SG_ 2415921018 cObjType_16 "source row 14; Upper_LineOutSignal[16].cObjType; source type uint8";
CM_ SG_ 2415921018 wStartx_16 "source row 15; Upper_LineOutSignal[16].wStartx; source type int16";
CM_ SG_ 2415921018 wStarty_16 "source row 16; Upper_LineOutSignal[16].wStarty; source type int16";
CM_ SG_ 2415921018 wEndx_16 "source row 17; Upper_LineOutSignal[16].wEndx; source type int16";
CM_ SG_ 2415921018 wEndy_16 "source row 18; Upper_LineOutSignal[16].wEndy; source type int16";
CM_ SG_ 2415921018 wDist_16 "source row 19; Upper_LineOutSignal[16].wDist; source type uint16";
CM_ SG_ 2415921018 cNum_17 "source row 12; Upper_LineOutSignal[17].cNum; source type uint8";
CM_ SG_ 2415921018 cHight_17 "source row 13; Upper_LineOutSignal[17].cHight; source type uint8";
CM_ SG_ 2415921018 cObjType_17 "source row 14; Upper_LineOutSignal[17].cObjType; source type uint8";
CM_ SG_ 2415921018 wStartx_17 "source row 15; Upper_LineOutSignal[17].wStartx; source type int16";
CM_ SG_ 2415921018 wStarty_17 "source row 16; Upper_LineOutSignal[17].wStarty; source type int16";
CM_ SG_ 2415921018 wEndx_17 "source row 17; Upper_LineOutSignal[17].wEndx; source type int16";
CM_ SG_ 2415921018 wEndy_17 "source row 18; Upper_LineOutSignal[17].wEndy; source type int16";
CM_ SG_ 2415921018 wDist_17 "source row 19; Upper_LineOutSignal[17].wDist; source type uint16";
CM_ SG_ 2415921018 cNum_18 "source row 12; Upper_LineOutSignal[18].cNum; source type uint8";
CM_ SG_ 2415921018 cHight_18 "source row 13; Upper_LineOutSignal[18].cHight; source type uint8";
CM_ SG_ 2415921018 cObjType_18 "source row 14; Upper_LineOutSignal[18].cObjType; source type uint8";
CM_ SG_ 2415921018 wStartx_18 "source row 15; Upper_LineOutSignal[18].wStartx; source type int16";
CM_ SG_ 2415921018 wStarty_18 "source row 16; Upper_LineOutSignal[18].wStarty; source type int16";
CM_ SG_ 2415921018 wEndx_18 "source row 17; Upper_LineOutSignal[18].wEndx; source type int16";
CM_ SG_ 2415921018 wEndy_18 "source row 18; Upper_LineOutSignal[18].wEndy; source type int16";
CM_ SG_ 2415921018 wDist_18 "source row 19; Upper_LineOutSignal[18].wDist; source type uint16";
CM_ SG_ 2415921018 cNum_19 "source row 12; Upper_LineOutSignal[19].cNum; source type uint8";
CM_ SG_ 2415921018 cHight_19 "source row 13; Upper_LineOutSignal[19].cHight; source type uint8";
CM_ SG_ 2415921018 cObjType_19 "source row 14; Upper_LineOutSignal[19].cObjType; source type uint8";
CM_ SG_ 2415921018 wStartx_19 "source row 15; Upper_LineOutSignal[19].wStartx; source type int16";
CM_ SG_ 2415921018 wStarty_19 "source row 16; Upper_LineOutSignal[19].wStarty; source type int16";
CM_ SG_ 2415921018 wEndx_19 "source row 17; Upper_LineOutSignal[19].wEndx; source type int16";
CM_ SG_ 2415921018 wEndy_19 "source row 18; Upper_LineOutSignal[19].wEndy; source type int16";
CM_ SG_ 2415921018 wDist_19 "source row 19; Upper_LineOutSignal[19].wDist; source type uint16";
CM_ SG_ 2415921019 GearLever "source row 21; Upper_StatusOutSignal.GearLever; source type uint8";
CM_ SG_ 2415921019 Temp "source row 22; Upper_StatusOutSignal.Temp; source type uint16";
CM_ SG_ 2415921019 Speed "source row 23; Upper_StatusOutSignal.Speed; source type float32";
CM_ SG_ 2415921019 TimeStamp "source row 24; Upper_StatusOutSignal.TimeStamp; source type uint64";
CM_ SG_ 2415921020 odo_x "source row 26; Upper_OdoOutSignal.odo_x; source type float32";
CM_ SG_ 2415921020 odo_y "source row 27; Upper_OdoOutSignal.odo_y; source type float32";
CM_ SG_ 2415921020 odo_ang "source row 28; Upper_OdoOutSignal.odo_ang; source type float32";
CM_ SG_ 2415921021 samefreq_front_Cnt "source row 57; Upper_RawDataOutSignal.samefreq_front_Cnt; source type uint16";
CM_ SG_ 2415921021 samefreq_rear_Cnt "source row 58; Upper_RawDataOutSignal.samefreq_rear_Cnt; source type uint16";
CM_ SG_ 2415921021 samefreq_front_Flag "source row 59; Upper_RawDataOutSignal.samefreq_front_Flag; source type uint8";
CM_ SG_ 2415921021 samefreq_rear_Flag "source row 60; Upper_RawDataOutSignal.samefreq_rear_Flag; source type uint8";
CM_ SG_ 2415921021 rawdata_info_0_mode "source row 62; Upper_RawDataOutSignal.rawdata_info[0].mode; source type uint8";
CM_ SG_ 2415921021 rawdata_info_0_de "source row 63; Upper_RawDataOutSignal.rawdata_info[0].de; source type uint16";
CM_ SG_ 2415921021 rawdata_info_0_de_peak "source row 64; Upper_RawDataOutSignal.rawdata_info[0].de_peak; source type uint16";
CM_ SG_ 2415921021 rawdata_info_0_de_width "source row 65; Upper_RawDataOutSignal.rawdata_info[0].de_width; source type uint16";
CM_ SG_ 2415921021 rawdata_info_0_ce_left "source row 66; Upper_RawDataOutSignal.rawdata_info[0].ce_left; source type uint16";
CM_ SG_ 2415921021 rawdata_info_0_ce_left_peak "source row 67; Upper_RawDataOutSignal.rawdata_info[0].ce_left_peak; source type uint16";
CM_ SG_ 2415921021 rawdata_info_0_ce_left_width "source row 68; Upper_RawDataOutSignal.rawdata_info[0].ce_left_width; source type uint16";
CM_ SG_ 2415921021 rawdata_info_0_ce_right "source row 69; Upper_RawDataOutSignal.rawdata_info[0].ce_right; source type uint16";
CM_ SG_ 2415921021 rawdata_info_0_ce_right_peak "source row 70; Upper_RawDataOutSignal.rawdata_info[0].ce_right_peak; source type uint16";
CM_ SG_ 2415921021 rawdata_info_0_ce_right_width "source row 71; Upper_RawDataOutSignal.rawdata_info[0].ce_right_width; source type uint16";
CM_ SG_ 2415921021 rawdata_info_1_mode "source row 62; Upper_RawDataOutSignal.rawdata_info[1].mode; source type uint8";
CM_ SG_ 2415921021 rawdata_info_1_de "source row 63; Upper_RawDataOutSignal.rawdata_info[1].de; source type uint16";
CM_ SG_ 2415921021 rawdata_info_1_de_peak "source row 64; Upper_RawDataOutSignal.rawdata_info[1].de_peak; source type uint16";
CM_ SG_ 2415921021 rawdata_info_1_de_width "source row 65; Upper_RawDataOutSignal.rawdata_info[1].de_width; source type uint16";
CM_ SG_ 2415921021 rawdata_info_1_ce_left "source row 66; Upper_RawDataOutSignal.rawdata_info[1].ce_left; source type uint16";
CM_ SG_ 2415921021 rawdata_info_1_ce_left_peak "source row 67; Upper_RawDataOutSignal.rawdata_info[1].ce_left_peak; source type uint16";
CM_ SG_ 2415921021 rawdata_info_1_ce_left_width "source row 68; Upper_RawDataOutSignal.rawdata_info[1].ce_left_width; source type uint16";
CM_ SG_ 2415921021 rawdata_info_1_ce_right "source row 69; Upper_RawDataOutSignal.rawdata_info[1].ce_right; source type uint16";
CM_ SG_ 2415921021 rawdata_info_1_ce_right_peak "source row 70; Upper_RawDataOutSignal.rawdata_info[1].ce_right_peak; source type uint16";
CM_ SG_ 2415921021 rawdata_info_1_ce_right_width "source row 71; Upper_RawDataOutSignal.rawdata_info[1].ce_right_width; source type uint16";
CM_ SG_ 2415921022 rawdata_info_2_mode "source row 62; Upper_RawDataOutSignal.rawdata_info[2].mode; source type uint8";
CM_ SG_ 2415921022 rawdata_info_2_de "source row 63; Upper_RawDataOutSignal.rawdata_info[2].de; source type uint16";
CM_ SG_ 2415921022 rawdata_info_2_de_peak "source row 64; Upper_RawDataOutSignal.rawdata_info[2].de_peak; source type uint16";
CM_ SG_ 2415921022 rawdata_info_2_de_width "source row 65; Upper_RawDataOutSignal.rawdata_info[2].de_width; source type uint16";
CM_ SG_ 2415921022 rawdata_info_2_ce_left "source row 66; Upper_RawDataOutSignal.rawdata_info[2].ce_left; source type uint16";
CM_ SG_ 2415921022 rawdata_info_2_ce_left_peak "source row 67; Upper_RawDataOutSignal.rawdata_info[2].ce_left_peak; source type uint16";
CM_ SG_ 2415921022 rawdata_info_2_ce_left_width "source row 68; Upper_RawDataOutSignal.rawdata_info[2].ce_left_width; source type uint16";
CM_ SG_ 2415921022 rawdata_info_2_ce_right "source row 69; Upper_RawDataOutSignal.rawdata_info[2].ce_right; source type uint16";
CM_ SG_ 2415921022 rawdata_info_2_ce_right_peak "source row 70; Upper_RawDataOutSignal.rawdata_info[2].ce_right_peak; source type uint16";
CM_ SG_ 2415921022 rawdata_info_2_ce_right_width "source row 71; Upper_RawDataOutSignal.rawdata_info[2].ce_right_width; source type uint16";
CM_ SG_ 2415921022 rawdata_info_3_mode "source row 62; Upper_RawDataOutSignal.rawdata_info[3].mode; source type uint8";
CM_ SG_ 2415921022 rawdata_info_3_de "source row 63; Upper_RawDataOutSignal.rawdata_info[3].de; source type uint16";
CM_ SG_ 2415921022 rawdata_info_3_de_peak "source row 64; Upper_RawDataOutSignal.rawdata_info[3].de_peak; source type uint16";
CM_ SG_ 2415921022 rawdata_info_3_de_width "source row 65; Upper_RawDataOutSignal.rawdata_info[3].de_width; source type uint16";
CM_ SG_ 2415921022 rawdata_info_3_ce_left "source row 66; Upper_RawDataOutSignal.rawdata_info[3].ce_left; source type uint16";
CM_ SG_ 2415921022 rawdata_info_3_ce_left_peak "source row 67; Upper_RawDataOutSignal.rawdata_info[3].ce_left_peak; source type uint16";
CM_ SG_ 2415921022 rawdata_info_3_ce_left_width "source row 68; Upper_RawDataOutSignal.rawdata_info[3].ce_left_width; source type uint16";
CM_ SG_ 2415921022 rawdata_info_3_ce_right "source row 69; Upper_RawDataOutSignal.rawdata_info[3].ce_right; source type uint16";
CM_ SG_ 2415921022 rawdata_info_3_ce_right_peak "source row 70; Upper_RawDataOutSignal.rawdata_info[3].ce_right_peak; source type uint16";
CM_ SG_ 2415921022 rawdata_info_3_ce_right_width "source row 71; Upper_RawDataOutSignal.rawdata_info[3].ce_right_width; source type uint16";
CM_ SG_ 2415921022 rawdata_info_4_mode "source row 62; Upper_RawDataOutSignal.rawdata_info[4].mode; source type uint8";
CM_ SG_ 2415921022 rawdata_info_4_de "source row 63; Upper_RawDataOutSignal.rawdata_info[4].de; source type uint16";
CM_ SG_ 2415921022 rawdata_info_4_de_peak "source row 64; Upper_RawDataOutSignal.rawdata_info[4].de_peak; source type uint16";
CM_ SG_ 2415921022 rawdata_info_4_de_width "source row 65; Upper_RawDataOutSignal.rawdata_info[4].de_width; source type uint16";
CM_ SG_ 2415921022 rawdata_info_4_ce_left "source row 66; Upper_RawDataOutSignal.rawdata_info[4].ce_left; source type uint16";
CM_ SG_ 2415921022 rawdata_info_4_ce_left_peak "source row 67; Upper_RawDataOutSignal.rawdata_info[4].ce_left_peak; source type uint16";
CM_ SG_ 2415921022 rawdata_info_4_ce_left_width "source row 68; Upper_RawDataOutSignal.rawdata_info[4].ce_left_width; source type uint16";
CM_ SG_ 2415921022 rawdata_info_4_ce_right "source row 69; Upper_RawDataOutSignal.rawdata_info[4].ce_right; source type uint16";
CM_ SG_ 2415921022 rawdata_info_4_ce_right_peak "source row 70; Upper_RawDataOutSignal.rawdata_info[4].ce_right_peak; source type uint16";
CM_ SG_ 2415921022 rawdata_info_4_ce_right_width "source row 71; Upper_RawDataOutSignal.rawdata_info[4].ce_right_width; source type uint16";
CM_ SG_ 2415921023 rawdata_info_5_mode "source row 62; Upper_RawDataOutSignal.rawdata_info[5].mode; source type uint8";
CM_ SG_ 2415921023 rawdata_info_5_de "source row 63; Upper_RawDataOutSignal.rawdata_info[5].de; source type uint16";
CM_ SG_ 2415921023 rawdata_info_5_de_peak "source row 64; Upper_RawDataOutSignal.rawdata_info[5].de_peak; source type uint16";
CM_ SG_ 2415921023 rawdata_info_5_de_width "source row 65; Upper_RawDataOutSignal.rawdata_info[5].de_width; source type uint16";
CM_ SG_ 2415921023 rawdata_info_5_ce_left "source row 66; Upper_RawDataOutSignal.rawdata_info[5].ce_left; source type uint16";
CM_ SG_ 2415921023 rawdata_info_5_ce_left_peak "source row 67; Upper_RawDataOutSignal.rawdata_info[5].ce_left_peak; source type uint16";
CM_ SG_ 2415921023 rawdata_info_5_ce_left_width "source row 68; Upper_RawDataOutSignal.rawdata_info[5].ce_left_width; source type uint16";
CM_ SG_ 2415921023 rawdata_info_5_ce_right "source row 69; Upper_RawDataOutSignal.rawdata_info[5].ce_right; source type uint16";
CM_ SG_ 2415921023 rawdata_info_5_ce_right_peak "source row 70; Upper_RawDataOutSignal.rawdata_info[5].ce_right_peak; source type uint16";
CM_ SG_ 2415921023 rawdata_info_5_ce_right_width "source row 71; Upper_RawDataOutSignal.rawdata_info[5].ce_right_width; source type uint16";
CM_ SG_ 2415921023 rawdata_info_6_mode "source row 62; Upper_RawDataOutSignal.rawdata_info[6].mode; source type uint8";
CM_ SG_ 2415921023 rawdata_info_6_de "source row 63; Upper_RawDataOutSignal.rawdata_info[6].de; source type uint16";
CM_ SG_ 2415921023 rawdata_info_6_de_peak "source row 64; Upper_RawDataOutSignal.rawdata_info[6].de_peak; source type uint16";
CM_ SG_ 2415921023 rawdata_info_6_de_width "source row 65; Upper_RawDataOutSignal.rawdata_info[6].de_width; source type uint16";
CM_ SG_ 2415921023 rawdata_info_6_ce_left "source row 66; Upper_RawDataOutSignal.rawdata_info[6].ce_left; source type uint16";
CM_ SG_ 2415921023 rawdata_info_6_ce_left_peak "source row 67; Upper_RawDataOutSignal.rawdata_info[6].ce_left_peak; source type uint16";
CM_ SG_ 2415921023 rawdata_info_6_ce_left_width "source row 68; Upper_RawDataOutSignal.rawdata_info[6].ce_left_width; source type uint16";
CM_ SG_ 2415921023 rawdata_info_6_ce_right "source row 69; Upper_RawDataOutSignal.rawdata_info[6].ce_right; source type uint16";
CM_ SG_ 2415921023 rawdata_info_6_ce_right_peak "source row 70; Upper_RawDataOutSignal.rawdata_info[6].ce_right_peak; source type uint16";
CM_ SG_ 2415921023 rawdata_info_6_ce_right_width "source row 71; Upper_RawDataOutSignal.rawdata_info[6].ce_right_width; source type uint16";
CM_ SG_ 2415921023 rawdata_info_7_mode "source row 62; Upper_RawDataOutSignal.rawdata_info[7].mode; source type uint8";
CM_ SG_ 2415921023 rawdata_info_7_de "source row 63; Upper_RawDataOutSignal.rawdata_info[7].de; source type uint16";
CM_ SG_ 2415921023 rawdata_info_7_de_peak "source row 64; Upper_RawDataOutSignal.rawdata_info[7].de_peak; source type uint16";
CM_ SG_ 2415921023 rawdata_info_7_de_width "source row 65; Upper_RawDataOutSignal.rawdata_info[7].de_width; source type uint16";
CM_ SG_ 2415921023 rawdata_info_7_ce_left "source row 66; Upper_RawDataOutSignal.rawdata_info[7].ce_left; source type uint16";
CM_ SG_ 2415921023 rawdata_info_7_ce_left_peak "source row 67; Upper_RawDataOutSignal.rawdata_info[7].ce_left_peak; source type uint16";
CM_ SG_ 2415921023 rawdata_info_7_ce_left_width "source row 68; Upper_RawDataOutSignal.rawdata_info[7].ce_left_width; source type uint16";
CM_ SG_ 2415921023 rawdata_info_7_ce_right "source row 69; Upper_RawDataOutSignal.rawdata_info[7].ce_right; source type uint16";
CM_ SG_ 2415921023 rawdata_info_7_ce_right_peak "source row 70; Upper_RawDataOutSignal.rawdata_info[7].ce_right_peak; source type uint16";
CM_ SG_ 2415921023 rawdata_info_7_ce_right_width "source row 71; Upper_RawDataOutSignal.rawdata_info[7].ce_right_width; source type uint16";
CM_ SG_ 2415921024 rawdata_info_8_mode "source row 62; Upper_RawDataOutSignal.rawdata_info[8].mode; source type uint8";
CM_ SG_ 2415921024 rawdata_info_8_de "source row 63; Upper_RawDataOutSignal.rawdata_info[8].de; source type uint16";
CM_ SG_ 2415921024 rawdata_info_8_de_peak "source row 64; Upper_RawDataOutSignal.rawdata_info[8].de_peak; source type uint16";
CM_ SG_ 2415921024 rawdata_info_8_de_width "source row 65; Upper_RawDataOutSignal.rawdata_info[8].de_width; source type uint16";
CM_ SG_ 2415921024 rawdata_info_8_ce_left "source row 66; Upper_RawDataOutSignal.rawdata_info[8].ce_left; source type uint16";
CM_ SG_ 2415921024 rawdata_info_8_ce_left_peak "source row 67; Upper_RawDataOutSignal.rawdata_info[8].ce_left_peak; source type uint16";
CM_ SG_ 2415921024 rawdata_info_8_ce_left_width "source row 68; Upper_RawDataOutSignal.rawdata_info[8].ce_left_width; source type uint16";
CM_ SG_ 2415921024 rawdata_info_8_ce_right "source row 69; Upper_RawDataOutSignal.rawdata_info[8].ce_right; source type uint16";
CM_ SG_ 2415921024 rawdata_info_8_ce_right_peak "source row 70; Upper_RawDataOutSignal.rawdata_info[8].ce_right_peak; source type uint16";
CM_ SG_ 2415921024 rawdata_info_8_ce_right_width "source row 71; Upper_RawDataOutSignal.rawdata_info[8].ce_right_width; source type uint16";
CM_ SG_ 2415921024 rawdata_info_9_mode "source row 62; Upper_RawDataOutSignal.rawdata_info[9].mode; source type uint8";
CM_ SG_ 2415921024 rawdata_info_9_de "source row 63; Upper_RawDataOutSignal.rawdata_info[9].de; source type uint16";
CM_ SG_ 2415921024 rawdata_info_9_de_peak "source row 64; Upper_RawDataOutSignal.rawdata_info[9].de_peak; source type uint16";
CM_ SG_ 2415921024 rawdata_info_9_de_width "source row 65; Upper_RawDataOutSignal.rawdata_info[9].de_width; source type uint16";
CM_ SG_ 2415921024 rawdata_info_9_ce_left "source row 66; Upper_RawDataOutSignal.rawdata_info[9].ce_left; source type uint16";
CM_ SG_ 2415921024 rawdata_info_9_ce_left_peak "source row 67; Upper_RawDataOutSignal.rawdata_info[9].ce_left_peak; source type uint16";
CM_ SG_ 2415921024 rawdata_info_9_ce_left_width "source row 68; Upper_RawDataOutSignal.rawdata_info[9].ce_left_width; source type uint16";
CM_ SG_ 2415921024 rawdata_info_9_ce_right "source row 69; Upper_RawDataOutSignal.rawdata_info[9].ce_right; source type uint16";
CM_ SG_ 2415921024 rawdata_info_9_ce_right_peak "source row 70; Upper_RawDataOutSignal.rawdata_info[9].ce_right_peak; source type uint16";
CM_ SG_ 2415921024 rawdata_info_9_ce_right_width "source row 71; Upper_RawDataOutSignal.rawdata_info[9].ce_right_width; source type uint16";
CM_ SG_ 2415921024 rawdata_info_10_mode "source row 62; Upper_RawDataOutSignal.rawdata_info[10].mode; source type uint8";
CM_ SG_ 2415921024 rawdata_info_10_de "source row 63; Upper_RawDataOutSignal.rawdata_info[10].de; source type uint16";
CM_ SG_ 2415921024 rawdata_info_10_de_peak "source row 64; Upper_RawDataOutSignal.rawdata_info[10].de_peak; source type uint16";
CM_ SG_ 2415921024 rawdata_info_10_de_width "source row 65; Upper_RawDataOutSignal.rawdata_info[10].de_width; source type uint16";
CM_ SG_ 2415921024 rawdata_info_10_ce_left "source row 66; Upper_RawDataOutSignal.rawdata_info[10].ce_left; source type uint16";
CM_ SG_ 2415921024 rawdata_info_10_ce_left_peak "source row 67; Upper_RawDataOutSignal.rawdata_info[10].ce_left_peak; source type uint16";
CM_ SG_ 2415921024 rawdata_info_10_ce_left_width "source row 68; Upper_RawDataOutSignal.rawdata_info[10].ce_left_width; source type uint16";
CM_ SG_ 2415921024 rawdata_info_10_ce_right "source row 69; Upper_RawDataOutSignal.rawdata_info[10].ce_right; source type uint16";
CM_ SG_ 2415921024 rawdata_info_10_ce_right_peak "source row 70; Upper_RawDataOutSignal.rawdata_info[10].ce_right_peak; source type uint16";
CM_ SG_ 2415921024 rawdata_info_10_ce_right_width "source row 71; Upper_RawDataOutSignal.rawdata_info[10].ce_right_width; source type uint16";
CM_ SG_ 2415921025 rawdata_info_11_mode "source row 62; Upper_RawDataOutSignal.rawdata_info[11].mode; source type uint8";
CM_ SG_ 2415921025 rawdata_info_11_de "source row 63; Upper_RawDataOutSignal.rawdata_info[11].de; source type uint16";
CM_ SG_ 2415921025 rawdata_info_11_de_peak "source row 64; Upper_RawDataOutSignal.rawdata_info[11].de_peak; source type uint16";
CM_ SG_ 2415921025 rawdata_info_11_de_width "source row 65; Upper_RawDataOutSignal.rawdata_info[11].de_width; source type uint16";
CM_ SG_ 2415921025 rawdata_info_11_ce_left "source row 66; Upper_RawDataOutSignal.rawdata_info[11].ce_left; source type uint16";
CM_ SG_ 2415921025 rawdata_info_11_ce_left_peak "source row 67; Upper_RawDataOutSignal.rawdata_info[11].ce_left_peak; source type uint16";
CM_ SG_ 2415921025 rawdata_info_11_ce_left_width "source row 68; Upper_RawDataOutSignal.rawdata_info[11].ce_left_width; source type uint16";
CM_ SG_ 2415921025 rawdata_info_11_ce_right "source row 69; Upper_RawDataOutSignal.rawdata_info[11].ce_right; source type uint16";
CM_ SG_ 2415921025 rawdata_info_11_ce_right_peak "source row 70; Upper_RawDataOutSignal.rawdata_info[11].ce_right_peak; source type uint16";
CM_ SG_ 2415921025 rawdata_info_11_ce_right_width "source row 71; Upper_RawDataOutSignal.rawdata_info[11].ce_right_width; source type uint16";
CM_ SG_ 2415921026 pdc_sts "source row 73; Upper_PDCOutSignal.pdc_sts; source type uint8";
CM_ SG_ 2415921026 front_sts "source row 74; Upper_PDCOutSignal.front_sts; source type uint8";
CM_ SG_ 2415921026 rear_sts "source row 75; Upper_PDCOutSignal.rear_sts; source type uint8";
CM_ SG_ 2415921026 snspdc_info_0_dis "source row 77; Upper_PDCOutSignal.snspdc_info[0].dis; source type uint16";
CM_ SG_ 2415921026 snspdc_info_0_range "source row 78; Upper_PDCOutSignal.snspdc_info[0].range; source type uint8";
CM_ SG_ 2415921026 snspdc_info_0_fault "source row 79; Upper_PDCOutSignal.snspdc_info[0].fault; source type uint8";
CM_ SG_ 2415921026 snspdc_info_1_dis "source row 77; Upper_PDCOutSignal.snspdc_info[1].dis; source type uint16";
CM_ SG_ 2415921026 snspdc_info_1_range "source row 78; Upper_PDCOutSignal.snspdc_info[1].range; source type uint8";
CM_ SG_ 2415921026 snspdc_info_1_fault "source row 79; Upper_PDCOutSignal.snspdc_info[1].fault; source type uint8";
CM_ SG_ 2415921026 snspdc_info_2_dis "source row 77; Upper_PDCOutSignal.snspdc_info[2].dis; source type uint16";
CM_ SG_ 2415921026 snspdc_info_2_range "source row 78; Upper_PDCOutSignal.snspdc_info[2].range; source type uint8";
CM_ SG_ 2415921026 snspdc_info_2_fault "source row 79; Upper_PDCOutSignal.snspdc_info[2].fault; source type uint8";
CM_ SG_ 2415921026 snspdc_info_3_dis "source row 77; Upper_PDCOutSignal.snspdc_info[3].dis; source type uint16";
CM_ SG_ 2415921026 snspdc_info_3_range "source row 78; Upper_PDCOutSignal.snspdc_info[3].range; source type uint8";
CM_ SG_ 2415921026 snspdc_info_3_fault "source row 79; Upper_PDCOutSignal.snspdc_info[3].fault; source type uint8";
CM_ SG_ 2415921026 snspdc_info_4_dis "source row 77; Upper_PDCOutSignal.snspdc_info[4].dis; source type uint16";
CM_ SG_ 2415921026 snspdc_info_4_range "source row 78; Upper_PDCOutSignal.snspdc_info[4].range; source type uint8";
CM_ SG_ 2415921026 snspdc_info_4_fault "source row 79; Upper_PDCOutSignal.snspdc_info[4].fault; source type uint8";
CM_ SG_ 2415921026 snspdc_info_5_dis "source row 77; Upper_PDCOutSignal.snspdc_info[5].dis; source type uint16";
CM_ SG_ 2415921026 snspdc_info_5_range "source row 78; Upper_PDCOutSignal.snspdc_info[5].range; source type uint8";
CM_ SG_ 2415921026 snspdc_info_5_fault "source row 79; Upper_PDCOutSignal.snspdc_info[5].fault; source type uint8";
CM_ SG_ 2415921026 snspdc_info_6_dis "source row 77; Upper_PDCOutSignal.snspdc_info[6].dis; source type uint16";
CM_ SG_ 2415921026 snspdc_info_6_range "source row 78; Upper_PDCOutSignal.snspdc_info[6].range; source type uint8";
CM_ SG_ 2415921026 snspdc_info_6_fault "source row 79; Upper_PDCOutSignal.snspdc_info[6].fault; source type uint8";
CM_ SG_ 2415921026 snspdc_info_7_dis "source row 77; Upper_PDCOutSignal.snspdc_info[7].dis; source type uint16";
CM_ SG_ 2415921026 snspdc_info_7_range "source row 78; Upper_PDCOutSignal.snspdc_info[7].range; source type uint8";
CM_ SG_ 2415921026 snspdc_info_7_fault "source row 79; Upper_PDCOutSignal.snspdc_info[7].fault; source type uint8";
CM_ SG_ 2415921026 snspdc_info_8_dis "source row 77; Upper_PDCOutSignal.snspdc_info[8].dis; source type uint16";
CM_ SG_ 2415921026 snspdc_info_8_range "source row 78; Upper_PDCOutSignal.snspdc_info[8].range; source type uint8";
CM_ SG_ 2415921026 snspdc_info_8_fault "source row 79; Upper_PDCOutSignal.snspdc_info[8].fault; source type uint8";
CM_ SG_ 2415921026 snspdc_info_9_dis "source row 77; Upper_PDCOutSignal.snspdc_info[9].dis; source type uint16";
CM_ SG_ 2415921026 snspdc_info_9_range "source row 78; Upper_PDCOutSignal.snspdc_info[9].range; source type uint8";
CM_ SG_ 2415921026 snspdc_info_9_fault "source row 79; Upper_PDCOutSignal.snspdc_info[9].fault; source type uint8";
CM_ SG_ 2415921026 snspdc_info_10_dis "source row 77; Upper_PDCOutSignal.snspdc_info[10].dis; source type uint16";
CM_ SG_ 2415921026 snspdc_info_10_range "source row 78; Upper_PDCOutSignal.snspdc_info[10].range; source type uint8";
CM_ SG_ 2415921026 snspdc_info_10_fault "source row 79; Upper_PDCOutSignal.snspdc_info[10].fault; source type uint8";
CM_ SG_ 2415921026 snspdc_info_11_dis "source row 77; Upper_PDCOutSignal.snspdc_info[11].dis; source type uint16";
CM_ SG_ 2415921026 snspdc_info_11_range "source row 78; Upper_PDCOutSignal.snspdc_info[11].range; source type uint8";
CM_ SG_ 2415921026 snspdc_info_11_fault "source row 79; Upper_PDCOutSignal.snspdc_info[11].fault; source type uint8";
BA_DEF_  "BusType" STRING ;
BA_DEF_ BO_  "GenMsgCycleTime" INT 0 50000;
BA_DEF_ BO_  "GenMsgSendType" ENUM  "Cyclic","NotUsed","NotUsed","NotUsed","NotUsed","NotUsed","NotUsed","IfActive","NoMsgSendType","NotUsed","vector_leerstring";
BA_DEF_ BO_  "VFrameFormat" ENUM  "StandardCAN","ExtendedCAN","reserved","reserved","reserved","reserved","reserved","reserved","reserved","reserved","reserved","reserved","reserved","reserved","StandardCAN_FD","ExtendedCAN_FD";
BA_DEF_DEF_  "BusType" "CAN FD";
BA_DEF_DEF_  "GenMsgCycleTime" 50;
BA_DEF_DEF_  "GenMsgSendType" "Cyclic";
BA_DEF_DEF_  "VFrameFormat" "StandardCAN_FD";
BA_ "VFrameFormat" BO_ 2415921000 15;
BA_ "VFrameFormat" BO_ 2415921001 15;
BA_ "VFrameFormat" BO_ 2415921002 15;
BA_ "VFrameFormat" BO_ 2415921003 15;
BA_ "VFrameFormat" BO_ 2415921004 15;
BA_ "VFrameFormat" BO_ 2415921005 15;
BA_ "VFrameFormat" BO_ 2415921006 15;
BA_ "VFrameFormat" BO_ 2415921007 15;
BA_ "VFrameFormat" BO_ 2415921008 15;
BA_ "VFrameFormat" BO_ 2415921009 15;
BA_ "VFrameFormat" BO_ 2415921010 15;
BA_ "VFrameFormat" BO_ 2415921011 15;
BA_ "VFrameFormat" BO_ 2415921012 15;
BA_ "VFrameFormat" BO_ 2415921013 15;
BA_ "VFrameFormat" BO_ 2415921014 15;
BA_ "VFrameFormat" BO_ 2415921015 15;
BA_ "VFrameFormat" BO_ 2415921016 15;
BA_ "VFrameFormat" BO_ 2415921017 15;
BA_ "VFrameFormat" BO_ 2415921018 15;
BA_ "VFrameFormat" BO_ 2415921019 15;
BA_ "VFrameFormat" BO_ 2415921020 15;
BA_ "VFrameFormat" BO_ 2415921021 15;
BA_ "VFrameFormat" BO_ 2415921022 15;
BA_ "VFrameFormat" BO_ 2415921023 15;
BA_ "VFrameFormat" BO_ 2415921024 15;
BA_ "VFrameFormat" BO_ 2415921025 15;
BA_ "VFrameFormat" BO_ 2415921026 15;
VAL_ 2415921000 cHight_0 0 "LOW" 1 "HIGH" 2 "UNKNOWN";
VAL_ 2415921000 cHight_1 0 "LOW" 1 "HIGH" 2 "UNKNOWN";
VAL_ 2415921000 cHight_2 0 "LOW" 1 "HIGH" 2 "UNKNOWN";
VAL_ 2415921000 cHight_3 0 "LOW" 1 "HIGH" 2 "UNKNOWN";
VAL_ 2415921000 cHight_4 0 "LOW" 1 "HIGH" 2 "UNKNOWN";
VAL_ 2415921000 cHight_5 0 "LOW" 1 "HIGH" 2 "UNKNOWN";
VAL_ 2415921001 cHight_6 0 "LOW" 1 "HIGH" 2 "UNKNOWN";
VAL_ 2415921001 cHight_7 0 "LOW" 1 "HIGH" 2 "UNKNOWN";
VAL_ 2415921001 cHight_8 0 "LOW" 1 "HIGH" 2 "UNKNOWN";
VAL_ 2415921001 cHight_9 0 "LOW" 1 "HIGH" 2 "UNKNOWN";
VAL_ 2415921001 cHight_10 0 "LOW" 1 "HIGH" 2 "UNKNOWN";
VAL_ 2415921001 cHight_11 0 "LOW" 1 "HIGH" 2 "UNKNOWN";
VAL_ 2415921002 cHight_12 0 "LOW" 1 "HIGH" 2 "UNKNOWN";
VAL_ 2415921002 cHight_13 0 "LOW" 1 "HIGH" 2 "UNKNOWN";
VAL_ 2415921002 cHight_14 0 "LOW" 1 "HIGH" 2 "UNKNOWN";
VAL_ 2415921002 cHight_15 0 "LOW" 1 "HIGH" 2 "UNKNOWN";
VAL_ 2415921002 cHight_16 0 "LOW" 1 "HIGH" 2 "UNKNOWN";
VAL_ 2415921002 cHight_17 0 "LOW" 1 "HIGH" 2 "UNKNOWN";
VAL_ 2415921003 cHight_18 0 "LOW" 1 "HIGH" 2 "UNKNOWN";
VAL_ 2415921003 cHight_19 0 "LOW" 1 "HIGH" 2 "UNKNOWN";
VAL_ 2415921003 cHight_20 0 "LOW" 1 "HIGH" 2 "UNKNOWN";
VAL_ 2415921003 cHight_21 0 "LOW" 1 "HIGH" 2 "UNKNOWN";
VAL_ 2415921003 cHight_22 0 "LOW" 1 "HIGH" 2 "UNKNOWN";
VAL_ 2415921003 cHight_23 0 "LOW" 1 "HIGH" 2 "UNKNOWN";
VAL_ 2415921004 cHight_24 0 "LOW" 1 "HIGH" 2 "UNKNOWN";
VAL_ 2415921004 cHight_25 0 "LOW" 1 "HIGH" 2 "UNKNOWN";
VAL_ 2415921004 cHight_26 0 "LOW" 1 "HIGH" 2 "UNKNOWN";
VAL_ 2415921004 cHight_27 0 "LOW" 1 "HIGH" 2 "UNKNOWN";
VAL_ 2415921004 cHight_28 0 "LOW" 1 "HIGH" 2 "UNKNOWN";
VAL_ 2415921004 cHight_29 0 "LOW" 1 "HIGH" 2 "UNKNOWN";
VAL_ 2415921005 cHight_30 0 "LOW" 1 "HIGH" 2 "UNKNOWN";
VAL_ 2415921005 cHight_31 0 "LOW" 1 "HIGH" 2 "UNKNOWN";
VAL_ 2415921005 cHight_32 0 "LOW" 1 "HIGH" 2 "UNKNOWN";
VAL_ 2415921005 cHight_33 0 "LOW" 1 "HIGH" 2 "UNKNOWN";
VAL_ 2415921005 cHight_34 0 "LOW" 1 "HIGH" 2 "UNKNOWN";
VAL_ 2415921005 cHight_35 0 "LOW" 1 "HIGH" 2 "UNKNOWN";
VAL_ 2415921006 cHight_36 0 "LOW" 1 "HIGH" 2 "UNKNOWN";
VAL_ 2415921006 cHight_37 0 "LOW" 1 "HIGH" 2 "UNKNOWN";
VAL_ 2415921006 cHight_38 0 "LOW" 1 "HIGH" 2 "UNKNOWN";
VAL_ 2415921006 cHight_39 0 "LOW" 1 "HIGH" 2 "UNKNOWN";
VAL_ 2415921006 cHight_40 0 "LOW" 1 "HIGH" 2 "UNKNOWN";
VAL_ 2415921006 cHight_41 0 "LOW" 1 "HIGH" 2 "UNKNOWN";
VAL_ 2415921007 cHight_42 0 "LOW" 1 "HIGH" 2 "UNKNOWN";
VAL_ 2415921007 cHight_43 0 "LOW" 1 "HIGH" 2 "UNKNOWN";
VAL_ 2415921007 cHight_44 0 "LOW" 1 "HIGH" 2 "UNKNOWN";
VAL_ 2415921007 cHight_45 0 "LOW" 1 "HIGH" 2 "UNKNOWN";
VAL_ 2415921007 cHight_46 0 "LOW" 1 "HIGH" 2 "UNKNOWN";
VAL_ 2415921007 cHight_47 0 "LOW" 1 "HIGH" 2 "UNKNOWN";
VAL_ 2415921008 cHight_48 0 "LOW" 1 "HIGH" 2 "UNKNOWN";
VAL_ 2415921008 cHight_49 0 "LOW" 1 "HIGH" 2 "UNKNOWN";
VAL_ 2415921008 cHight_50 0 "LOW" 1 "HIGH" 2 "UNKNOWN";
VAL_ 2415921008 cHight_51 0 "LOW" 1 "HIGH" 2 "UNKNOWN";
VAL_ 2415921008 cHight_52 0 "LOW" 1 "HIGH" 2 "UNKNOWN";
VAL_ 2415921008 cHight_53 0 "LOW" 1 "HIGH" 2 "UNKNOWN";
VAL_ 2415921009 cHight_54 0 "LOW" 1 "HIGH" 2 "UNKNOWN";
VAL_ 2415921009 cHight_55 0 "LOW" 1 "HIGH" 2 "UNKNOWN";
VAL_ 2415921009 cHight_56 0 "LOW" 1 "HIGH" 2 "UNKNOWN";
VAL_ 2415921009 cHight_57 0 "LOW" 1 "HIGH" 2 "UNKNOWN";
VAL_ 2415921009 cHight_58 0 "LOW" 1 "HIGH" 2 "UNKNOWN";
VAL_ 2415921009 cHight_59 0 "LOW" 1 "HIGH" 2 "UNKNOWN";
VAL_ 2415921010 cHight_60 0 "LOW" 1 "HIGH" 2 "UNKNOWN";
VAL_ 2415921010 cHight_61 0 "LOW" 1 "HIGH" 2 "UNKNOWN";
VAL_ 2415921010 cHight_62 0 "LOW" 1 "HIGH" 2 "UNKNOWN";
VAL_ 2415921010 cHight_63 0 "LOW" 1 "HIGH" 2 "UNKNOWN";
VAL_ 2415921010 cHight_64 0 "LOW" 1 "HIGH" 2 "UNKNOWN";
VAL_ 2415921010 cHight_65 0 "LOW" 1 "HIGH" 2 "UNKNOWN";
VAL_ 2415921011 cHight_66 0 "LOW" 1 "HIGH" 2 "UNKNOWN";
VAL_ 2415921011 cHight_67 0 "LOW" 1 "HIGH" 2 "UNKNOWN";
VAL_ 2415921011 cHight_68 0 "LOW" 1 "HIGH" 2 "UNKNOWN";
VAL_ 2415921011 cHight_69 0 "LOW" 1 "HIGH" 2 "UNKNOWN";
VAL_ 2415921011 cHight_70 0 "LOW" 1 "HIGH" 2 "UNKNOWN";
VAL_ 2415921011 cHight_71 0 "LOW" 1 "HIGH" 2 "UNKNOWN";
VAL_ 2415921012 cHight_72 0 "LOW" 1 "HIGH" 2 "UNKNOWN";
VAL_ 2415921012 cHight_73 0 "LOW" 1 "HIGH" 2 "UNKNOWN";
VAL_ 2415921012 cHight_74 0 "LOW" 1 "HIGH" 2 "UNKNOWN";
VAL_ 2415921012 cHight_75 0 "LOW" 1 "HIGH" 2 "UNKNOWN";
VAL_ 2415921012 cHight_76 0 "LOW" 1 "HIGH" 2 "UNKNOWN";
VAL_ 2415921012 cHight_77 0 "LOW" 1 "HIGH" 2 "UNKNOWN";
VAL_ 2415921013 cHight_78 0 "LOW" 1 "HIGH" 2 "UNKNOWN";
VAL_ 2415921013 cHight_79 0 "LOW" 1 "HIGH" 2 "UNKNOWN";
VAL_ 2415921014 cHight_0 0 "LOW" 1 "HIGH" 2 "UNKNOWN";
VAL_ 2415921014 cObjType_0 0 "NONE" 1 "POINT" 2 "STRAIGHT0_CORNER" 3 "STRAIGHT1_CORNER" 4 "STRAIGHT2_CORNER";
VAL_ 2415921014 cHight_1 0 "LOW" 1 "HIGH" 2 "UNKNOWN";
VAL_ 2415921014 cObjType_1 0 "NONE" 1 "POINT" 2 "STRAIGHT0_CORNER" 3 "STRAIGHT1_CORNER" 4 "STRAIGHT2_CORNER";
VAL_ 2415921014 cHight_2 0 "LOW" 1 "HIGH" 2 "UNKNOWN";
VAL_ 2415921014 cObjType_2 0 "NONE" 1 "POINT" 2 "STRAIGHT0_CORNER" 3 "STRAIGHT1_CORNER" 4 "STRAIGHT2_CORNER";
VAL_ 2415921014 cHight_3 0 "LOW" 1 "HIGH" 2 "UNKNOWN";
VAL_ 2415921014 cObjType_3 0 "NONE" 1 "POINT" 2 "STRAIGHT0_CORNER" 3 "STRAIGHT1_CORNER" 4 "STRAIGHT2_CORNER";
VAL_ 2415921015 cHight_4 0 "LOW" 1 "HIGH" 2 "UNKNOWN";
VAL_ 2415921015 cObjType_4 0 "NONE" 1 "POINT" 2 "STRAIGHT0_CORNER" 3 "STRAIGHT1_CORNER" 4 "STRAIGHT2_CORNER";
VAL_ 2415921015 cHight_5 0 "LOW" 1 "HIGH" 2 "UNKNOWN";
VAL_ 2415921015 cObjType_5 0 "NONE" 1 "POINT" 2 "STRAIGHT0_CORNER" 3 "STRAIGHT1_CORNER" 4 "STRAIGHT2_CORNER";
VAL_ 2415921015 cHight_6 0 "LOW" 1 "HIGH" 2 "UNKNOWN";
VAL_ 2415921015 cObjType_6 0 "NONE" 1 "POINT" 2 "STRAIGHT0_CORNER" 3 "STRAIGHT1_CORNER" 4 "STRAIGHT2_CORNER";
VAL_ 2415921015 cHight_7 0 "LOW" 1 "HIGH" 2 "UNKNOWN";
VAL_ 2415921015 cObjType_7 0 "NONE" 1 "POINT" 2 "STRAIGHT0_CORNER" 3 "STRAIGHT1_CORNER" 4 "STRAIGHT2_CORNER";
VAL_ 2415921016 cHight_8 0 "LOW" 1 "HIGH" 2 "UNKNOWN";
VAL_ 2415921016 cObjType_8 0 "NONE" 1 "POINT" 2 "STRAIGHT0_CORNER" 3 "STRAIGHT1_CORNER" 4 "STRAIGHT2_CORNER";
VAL_ 2415921016 cHight_9 0 "LOW" 1 "HIGH" 2 "UNKNOWN";
VAL_ 2415921016 cObjType_9 0 "NONE" 1 "POINT" 2 "STRAIGHT0_CORNER" 3 "STRAIGHT1_CORNER" 4 "STRAIGHT2_CORNER";
VAL_ 2415921016 cHight_10 0 "LOW" 1 "HIGH" 2 "UNKNOWN";
VAL_ 2415921016 cObjType_10 0 "NONE" 1 "POINT" 2 "STRAIGHT0_CORNER" 3 "STRAIGHT1_CORNER" 4 "STRAIGHT2_CORNER";
VAL_ 2415921016 cHight_11 0 "LOW" 1 "HIGH" 2 "UNKNOWN";
VAL_ 2415921016 cObjType_11 0 "NONE" 1 "POINT" 2 "STRAIGHT0_CORNER" 3 "STRAIGHT1_CORNER" 4 "STRAIGHT2_CORNER";
VAL_ 2415921017 cHight_12 0 "LOW" 1 "HIGH" 2 "UNKNOWN";
VAL_ 2415921017 cObjType_12 0 "NONE" 1 "POINT" 2 "STRAIGHT0_CORNER" 3 "STRAIGHT1_CORNER" 4 "STRAIGHT2_CORNER";
VAL_ 2415921017 cHight_13 0 "LOW" 1 "HIGH" 2 "UNKNOWN";
VAL_ 2415921017 cObjType_13 0 "NONE" 1 "POINT" 2 "STRAIGHT0_CORNER" 3 "STRAIGHT1_CORNER" 4 "STRAIGHT2_CORNER";
VAL_ 2415921017 cHight_14 0 "LOW" 1 "HIGH" 2 "UNKNOWN";
VAL_ 2415921017 cObjType_14 0 "NONE" 1 "POINT" 2 "STRAIGHT0_CORNER" 3 "STRAIGHT1_CORNER" 4 "STRAIGHT2_CORNER";
VAL_ 2415921017 cHight_15 0 "LOW" 1 "HIGH" 2 "UNKNOWN";
VAL_ 2415921017 cObjType_15 0 "NONE" 1 "POINT" 2 "STRAIGHT0_CORNER" 3 "STRAIGHT1_CORNER" 4 "STRAIGHT2_CORNER";
VAL_ 2415921018 cHight_16 0 "LOW" 1 "HIGH" 2 "UNKNOWN";
VAL_ 2415921018 cObjType_16 0 "NONE" 1 "POINT" 2 "STRAIGHT0_CORNER" 3 "STRAIGHT1_CORNER" 4 "STRAIGHT2_CORNER";
VAL_ 2415921018 cHight_17 0 "LOW" 1 "HIGH" 2 "UNKNOWN";
VAL_ 2415921018 cObjType_17 0 "NONE" 1 "POINT" 2 "STRAIGHT0_CORNER" 3 "STRAIGHT1_CORNER" 4 "STRAIGHT2_CORNER";
VAL_ 2415921018 cHight_18 0 "LOW" 1 "HIGH" 2 "UNKNOWN";
VAL_ 2415921018 cObjType_18 0 "NONE" 1 "POINT" 2 "STRAIGHT0_CORNER" 3 "STRAIGHT1_CORNER" 4 "STRAIGHT2_CORNER";
VAL_ 2415921018 cHight_19 0 "LOW" 1 "HIGH" 2 "UNKNOWN";
VAL_ 2415921018 cObjType_19 0 "NONE" 1 "POINT" 2 "STRAIGHT0_CORNER" 3 "STRAIGHT1_CORNER" 4 "STRAIGHT2_CORNER";
VAL_ 2415921019 GearLever 0 "N" 1 "D" 2 "R" 3 "RESERVE";
VAL_ 2415921021 samefreq_front_Flag 0 "NONE" 1 "PRESENT";
VAL_ 2415921021 samefreq_rear_Flag 0 "NONE" 1 "PRESENT";
VAL_ 2415921021 rawdata_info_0_mode 0 "IDLE" 1 "FIXED_FREQ" 2 "UP_SWEEP" 3 "DOWN_SWEEP" 4 "READ_STATUS" 5 "IMPEDANCE_TEST";
VAL_ 2415921021 rawdata_info_1_mode 0 "IDLE" 1 "FIXED_FREQ" 2 "UP_SWEEP" 3 "DOWN_SWEEP" 4 "READ_STATUS" 5 "IMPEDANCE_TEST";
VAL_ 2415921022 rawdata_info_2_mode 0 "IDLE" 1 "FIXED_FREQ" 2 "UP_SWEEP" 3 "DOWN_SWEEP" 4 "READ_STATUS" 5 "IMPEDANCE_TEST";
VAL_ 2415921022 rawdata_info_3_mode 0 "IDLE" 1 "FIXED_FREQ" 2 "UP_SWEEP" 3 "DOWN_SWEEP" 4 "READ_STATUS" 5 "IMPEDANCE_TEST";
VAL_ 2415921022 rawdata_info_4_mode 0 "IDLE" 1 "FIXED_FREQ" 2 "UP_SWEEP" 3 "DOWN_SWEEP" 4 "READ_STATUS" 5 "IMPEDANCE_TEST";
VAL_ 2415921023 rawdata_info_5_mode 0 "IDLE" 1 "FIXED_FREQ" 2 "UP_SWEEP" 3 "DOWN_SWEEP" 4 "READ_STATUS" 5 "IMPEDANCE_TEST";
VAL_ 2415921023 rawdata_info_6_mode 0 "IDLE" 1 "FIXED_FREQ" 2 "UP_SWEEP" 3 "DOWN_SWEEP" 4 "READ_STATUS" 5 "IMPEDANCE_TEST";
VAL_ 2415921023 rawdata_info_7_mode 0 "IDLE" 1 "FIXED_FREQ" 2 "UP_SWEEP" 3 "DOWN_SWEEP" 4 "READ_STATUS" 5 "IMPEDANCE_TEST";
VAL_ 2415921024 rawdata_info_8_mode 0 "IDLE" 1 "FIXED_FREQ" 2 "UP_SWEEP" 3 "DOWN_SWEEP" 4 "READ_STATUS" 5 "IMPEDANCE_TEST";
VAL_ 2415921024 rawdata_info_9_mode 0 "IDLE" 1 "FIXED_FREQ" 2 "UP_SWEEP" 3 "DOWN_SWEEP" 4 "READ_STATUS" 5 "IMPEDANCE_TEST";
VAL_ 2415921024 rawdata_info_10_mode 0 "IDLE" 1 "FIXED_FREQ" 2 "UP_SWEEP" 3 "DOWN_SWEEP" 4 "READ_STATUS" 5 "IMPEDANCE_TEST";
VAL_ 2415921025 rawdata_info_11_mode 0 "IDLE" 1 "FIXED_FREQ" 2 "UP_SWEEP" 3 "DOWN_SWEEP" 4 "READ_STATUS" 5 "IMPEDANCE_TEST";
VAL_ 2415921026 snspdc_info_0_range 0 "NONE" 1 "RED" 2 "YELLOW" 3 "GREEN";
VAL_ 2415921026 snspdc_info_1_range 0 "NONE" 1 "RED" 2 "YELLOW" 3 "GREEN";
VAL_ 2415921026 snspdc_info_2_range 0 "NONE" 1 "RED" 2 "YELLOW" 3 "GREEN";
VAL_ 2415921026 snspdc_info_3_range 0 "NONE" 1 "RED" 2 "YELLOW" 3 "GREEN";
VAL_ 2415921026 snspdc_info_4_range 0 "NONE" 1 "RED" 2 "YELLOW" 3 "GREEN";
VAL_ 2415921026 snspdc_info_5_range 0 "NONE" 1 "RED" 2 "YELLOW" 3 "GREEN";
VAL_ 2415921026 snspdc_info_6_range 0 "NONE" 1 "RED" 2 "YELLOW" 3 "GREEN";
VAL_ 2415921026 snspdc_info_7_range 0 "NONE" 1 "RED" 2 "YELLOW" 3 "GREEN";
VAL_ 2415921026 snspdc_info_8_range 0 "NONE" 1 "RED" 2 "YELLOW" 3 "GREEN";
VAL_ 2415921026 snspdc_info_9_range 0 "NONE" 1 "RED" 2 "YELLOW" 3 "GREEN";
VAL_ 2415921026 snspdc_info_10_range 0 "NONE" 1 "RED" 2 "YELLOW" 3 "GREEN";
VAL_ 2415921026 snspdc_info_11_range 0 "NONE" 1 "RED" 2 "YELLOW" 3 "GREEN";
SIG_VALTYPE_ 2415921019 Speed : 1;
SIG_VALTYPE_ 2415921020 odo_x : 1;
SIG_VALTYPE_ 2415921020 odo_y : 1;
SIG_VALTYPE_ 2415921020 odo_ang : 1;
